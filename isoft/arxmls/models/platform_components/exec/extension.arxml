AUTOSAR XML (schema 00049)
package /ISOFT/PlatformComponents/exec
  sdg def Extension
    sdg-classes:
      5 x sdg class, all with category=ISOFT_EXTENSION:
        ExecIpcInfo: gid=iSOFT:exec:ExecIpcInfo, extends-meta-class=Process
          sdg primitive attribute IpcName: category=STRING, lower-multiplicity=0, upper-multiplicity=1, gid=iSOFT:exec:ExecIpcInfo:IpcName
        ClientIdInfo: gid=iSOFT:exec:ClientIdInfo, extends-meta-class=Process
          sdg primitive attribute ClientId: category=INTEGER, lower-multiplicity=0, upper-multiplicity=1, gid=iSOFT:exec:ClientIdInfo:ClientId, max=65535, min=1
        ExecDeterministicClient: gid=iSOFT:exec:ExecDeterministicClient, extends-meta-class=ProcessToMachineMapping
          attributes:
            sdg primitive attribute CycleTimeValue: category=FLOAT, lower-multiplicity=1, upper-multiplicity=1, gid=iSOFT:exec:ExecDeterministicClient:CycleTimeValue
            sdg primitive attribute NumberOfWorkers: category=INTEGER, lower-multiplicity=1, upper-multiplicity=1, gid=iSOFT:exec:ExecDeterministicClient:NumberOfWorkers, max=20, min=1
            sdg reference ExecDeterministicClientSubclass: lower-multiplicity=1, upper-multiplicity=1, dest-sdg=DeterministicSyncMaster
        DeterministicSyncMaster: gid=iSOFT:exec:DeterministicSyncMaster, extends-meta-class=ProcessToMachineMapping, caption=true
          attributes:
            sdg primitive attribute MaxRunCycleLoop: category=INTEGER, lower-multiplicity=1, upper-multiplicity=1, gid=iSOFT:exec:DeterministicSyncMaster:MaxRunCycleLoop, max=65535, min=1
            sdg aggregation with variation DeterministicSyncMasterSubclass: lower-multiplicity=1, upper-multiplicity=1, gid=iSOFT:exec:DeterministicSyncMasterSubclass:Attributes, variation=false, sub-sdg=DeterministicSyncMOutOfN
        DeterministicSyncMOutOfN
          sdg primitive attribute MinimumNumberOfRequests: category=INTEGER, lower-multiplicity=1, upper-multiplicity=1, gid=iSOFT:exec:DeterministicSyncMOutOfN:MinimumNumberOfRequests, max=10, min=1
          sdg primitive attribute NumberOfConnectedClients: category=INTEGER, lower-multiplicity=1, upper-multiplicity=1, gid=iSOFT:exec:DeterministicSyncMOutOfN:NumberOfConnectedClients, max=10, min=1

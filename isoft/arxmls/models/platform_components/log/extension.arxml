AUTOSAR XML (schema 00049)
package /ISOFT/PlatformComponents/log
  sdg def Extension
    sdg-classes:
      6 x sdg class, all with category=ISOFT_EXTENSION:
        LogDaemonEthernetConfiguration: gid=iSOFT:log:LogDaemonEthernetConfiguration, extends-meta-class=Machine
          attributes:
            sdg aggregation with variation LogDaemonEthernetConfigurationSubclass: lower-multiplicity=0, upper-multiplicity-infinite=true, gid=iSOFT:log:LogDaemonEthernetConfigurationSubclass:Attributes, variation=false, sub-sdg=EthernetConfigurationUnit
        EthernetConfigurationUnit
          attributes:
            sdg foreign reference Connector: lower-multiplicity=1, upper-multiplicity=1, gid=iSOFT:log:EthernetConfigurationUnit:Connector, dest-meta-class=CommunicationConnector
            sdg primitive attribute ServicePort: category=INTEGER, lower-multiplicity=1, upper-multiplicity=1, gid=iSOFT:log:EthernetConfigurationUnit:ServicePort, max=65534, min=1
        DltLogChannelToFileExtensionOperationMapping: gid=iSOFT:log:DltLogChannelToFileExtensionOperationMapping, extends-meta-class=Machine
          attributes:
            sdg foreign reference LogChannel: lower-multiplicity=1, upper-multiplicity-infinite=true, gid=iSOFT:log:DltLogChannelToFileExtensionOperationMapping:LogChannel, dest-meta-class=DltLogChannel
            sdg aggregation with variation DltLogChannelToFileExtensionOperationMappingSubclass: lower-multiplicity=1, upper-multiplicity=1, gid=iSOFT:log:DltLogChannelToFileExtensionOperationMappingSubclass:Attributes, variation=false, sub-sdg=LogFileExtensionOperation
        LogFileExtensionOperation
          attributes:
            sdg primitive attribute FileBuffer: category=INTEGER, lower-multiplicity=0, upper-multiplicity=1, gid=iSOFT:log:LogFileExtensionOperation:FileBuffer, max=18446744073709551615, min=0
            sdg primitive attribute PlainText: category=BOOLEAN, lower-multiplicity=0, upper-multiplicity=1, gid=iSOFT:log:LogFileExtensionOperation:PlainText
            sdg aggregation with variation LogFileExtensionOperationSubclass: lower-multiplicity=0, upper-multiplicity=1, gid=iSOFT:log:LogFileExtensionOperationSubclass:Attributes, variation=false, sub-sdg=LogFileRotateRule
        LogFileRotateRule
          sdg primitive attribute FileSize: category=INTEGER, lower-multiplicity=1, upper-multiplicity=1, gid=iSOFT:log:LogFileRotateRule:FileSize, max=18446744073709551615, min=0
          sdg primitive attribute FileCount: category=INTEGER, lower-multiplicity=1, upper-multiplicity=1, gid=iSOFT:log:LogFileRotateRule:FileCount, max=18446744073709551615, min=0
        DltMessageNamespace: gid=iSOFT:log:DltMessageNamespace, extends-meta-class=DltMessageCollectionSet
          sdg primitive attribute Namespace: category=STRING, lower-multiplicity=1, upper-multiplicity=1, gid=iSOFT:log:DltMessageNamespace:Namespace

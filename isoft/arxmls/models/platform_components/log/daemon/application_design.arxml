AUTOSAR XML (schema 00049)
package /ISOFT/PlatformComponents/log
  process design daemon_proc_design: executable=logd
package /ISOFT/PlatformComponents/log/exe
  executable logd: category=PLATFORM_LEVEL, logging-behavior=USES-LOGGING, reporting-behavior=REPORTS-EXECUTION-STATE
    root sw component prototype root_swc: application-type=dlt_daemon
package /ISOFT/PlatformComponents/log/swc
  adaptive application sw component type dlt_daemon

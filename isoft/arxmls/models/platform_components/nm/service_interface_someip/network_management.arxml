AUTOSAR XML (schema 00049)
package /ara/nm/nmSomeipDeployments
  someip service interface deployment NetworkState: service-interface=NetworkState, service-interface-id=60, service-interface-version={major-version=1, minor-version=0}
    4 x someip event deployment, all with transport-protocol=TCP:
      NotifyEtherStateChanged: event=NotifyEtherStateChanged, event-id=0x4021
      NotifyPresentNodeList: event=NotifyPresentNodeList, event-id=0x4022
      NotifyPassivePnRequest: event=NotifyPassivePnRequest, event-id=0x402E
      NotifyPassivePnRelease: event=NotifyPassivePnRelease, event-id=0x402F
    someip field deployment NetworkCurrentState: field=NetworkCurrentState
      get NetworkCurrentState_getter: method-id=0x4422, transport-protocol=TCP
      notifier NetworkCurrentState_notifier: event-id=0x4423, transport-protocol=TCP
    someip field deployment NetworkRequestedState: field=NetworkRequestedState
      get NetworkRequestedState_getter: method-id=0x4023, transport-protocol=TCP
      notifier NetworkRequestedState_notifier: event-id=0x4024, transport-protocol=TCP
      set NetworkRequestedState_setter: method-id=0x4025, transport-protocol=TCP
    9 x someip method deployment, all with transport-protocol=TCP:
      SetDefaultEtherIp: method=SetDefaultEtherIp, method-id=0x4026
      SetEtherStateMachineSate: method=SetEtherStateMachineSate, method-id=0x4027
      GetEtherStateMachineState: method=GetEtherStateMachineState, method-id=0x4028
      RequestDetectNode: method=RequestDetectNode, method-id=0x4029
      NotifyWakeup: method=NotifyWakeup, method-id=0x402A
      SetMessageCtrlType: method=SetMessageCtrlType, method-id=0x402B
      GetMessageCtrlType: method=GetMessageCtrlType, method-id=0x402C
      GetInitState: method=GetInitState, method-id=0x402D
      GetPassivePnRequestList: method=GetPassivePnRequestList, method-id=0x4030
    6 x someip event group:
      NetworkCurrentStateEventgroup1: event-group-id=1, event=NetworkCurrentState_notifier
      NetworkRequestedStateEventgroup: event-group-id=2, event=NetworkRequestedState_notifier
      NotifyPresentNodeList1: event-group-id=3, event=NotifyPresentNodeList
      NotifyEtherStateChanged1: event-group-id=4, event=NotifyEtherStateChanged
      NotifyPassivePnRequest1: event-group-id=5, event=NotifyPassivePnRequest
      NotifyPassivePnRelease1: event-group-id=6, event=NotifyPassivePnRelease

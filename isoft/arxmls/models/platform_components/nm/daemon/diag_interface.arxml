AUTOSAR XML (schema 00049)
package /ara/nm/DiagnosticPortInterface
  diagnostic data identifier generic interface DiagnosticDataIdentifierGenericInterface_nm
  diagnostic monitor interface DiagnosticMonitorInterface_nm

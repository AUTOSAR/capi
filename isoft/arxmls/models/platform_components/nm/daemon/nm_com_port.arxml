AUTOSAR XML (schema 00049)
package /ISOFT/PlatformComponents/nm/swc
  adaptive application sw component type nm
    provide port NetworkState_ln1: provided-interface=NetworkState
package /ISOFT/PlatformComponents/nm/exe
  executable nmd
    root sw component prototype network_manager_root: application-type=nm

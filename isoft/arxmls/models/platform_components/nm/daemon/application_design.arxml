AUTOSAR XML (schema 00049)
package /ISOFT/PlatformComponents/nm
  process design network_manager_design: executable=nmd
package /ISOFT/PlatformComponents/nm/exe
  executable nmd: category=PLATFORM_LEVEL, build-type=BUILD-TYPE-DEBUG, logging-behavior=USES-LOGGING, minimum-timer-granularity=1000.0, reporting-behavior=REPORTS-EXECUTION-STATE, version=1.0.0

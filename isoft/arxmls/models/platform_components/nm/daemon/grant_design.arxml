AUTOSAR XML (schema 00049)
package /ISOFT/PlatformComponents/nm
  com offer service grant design nmofferservicegrantdesign: process-design=network_manager_design, provided-service-port=network_manager_root.NetworkState_ln1

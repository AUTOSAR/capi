AUTOSAR XML (schema 00049)
package /NetworkErrors
  ap application error domain GenericErrors: value=45
    namespaces:
      symbol props ara
      symbol props nm
  ap application error GenericFailure: error-code=12, error-domain=GenericErrors  # Generic failure.
  ap application error InvalidConfiguration: error-code=5, error-domain=SpecificErrors  # Configuration is invalid.
  ap application error InvalidLogicNetworkParameter: error-code=6, error-domain=SpecificErrors  # LogicNetworkParameter is invalid.
  ap application error domain SpecificErrors: value=44
    namespaces:
      symbol props ara
      symbol props nm
package /NetworkStateServiceInterfaces
  service interface NetworkState: major-version=1, minor-version=0
    namespaces:
      symbol props ara
      symbol props nm
    events:
      4 x data:
        NotifyPresentNodeList: type=ByteArray
        NotifyEtherStateChanged: type=NMEtherStateChangedType
        NotifyPassivePnRequest: type=PassivePNInform
        NotifyPassivePnRelease: type=PassivePNInform
    field NetworkCurrentState: type=NetworkStateType, has-getter=true, has-notifier=true, has-setter=false  # PNC/VLAN/Physical Network is currently active or not.
    field NetworkRequestedState: type=NetworkStateType, has-getter=true, has-notifier=true, has-setter=true  # Request or Release PNC/VLAN/Physical Network to get active or to release.
    methods:
      9 x operation, all with possible-ap-error=GenericFailure:
        SetDefaultEtherIp
          arg ethIp: type=String, direction=IN
        SetEtherStateMachineSate
          arg ethIp: type=String, direction=IN
          arg ethState: type=NetworkStateType, direction=IN
        GetEtherStateMachineState
          arg ethIp: type=String, direction=IN
          arg ethState: type=NetworkStateType, direction=OUT
        RequestDetectNode
          arg ethIp: type=String, direction=IN
        NotifyWakeup
          arg ethIp: type=String, direction=IN
        SetMessageCtrlType
          arg ethIp: type=String, direction=IN
          arg ctrType: type=MessageCtrlType, direction=IN
        GetMessageCtrlType
          arg ethIp: type=String, direction=IN
          arg ctrType: type=MessageCtrlType, direction=OUT
        GetInitState
          arg stateCode: type=uint32_t, direction=OUT
        GetPassivePnRequestList
          arg ethIp: type=String, direction=IN
          arg pnList: type=String, direction=OUT

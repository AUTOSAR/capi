AUTOSAR XML (schema 00049)
package /ara/nm
  4 x std cpp implementation data type, all with type-emitter=TYPE_EMITTER_ARA:
    NetworkStateType: compu {0=kNoCom, 1=kFullCom, 2=kBusSleep, 3=kPrepareBusSleep, 4=kRepeatMessageState, 5=kNormalOperation, 6=kReadySleep}, type-reference=uint8_t
      namespaces:
        symbol props ara
        symbol props nm
    NMEtherStateChangedType: category=STRUCTURE
      namespaces:
        symbol props ara
        symbol props nm
      cpp implementation data type element EthIp: type-reference=String
      cpp implementation data type element currentState: type-reference=NetworkStateType
    MessageCtrlType: compu {0=kEnableAll, 1=kEnableReceive, 2=kEnableSend, 3=kDisableAll}, type-reference=uint8_t
      namespaces:
        symbol props ara
        symbol props nm
    PassivePNInform: category=STRUCTURE
      namespaces:
        symbol props ara
        symbol props nm
      cpp implementation data type element EthIp: type-reference=String
      cpp implementation data type element PnList: type-reference=String

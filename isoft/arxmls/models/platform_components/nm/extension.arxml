AUTOSAR XML (schema 00049)
package /ISOFT/PlatformComponents/nm
  sdg def Extension
    sdg-classes:
      5 x sdg class, all with category=ISOFT_EXTENSION:
        SystemCustomization: gid=iSOFT:nm:SystemCustomization, extends-meta-class=System
          sdg primitive attribute SkipTimerCheck: category=Boolean, lower-multiplicity=0, upper-multiplicity=1, gid=iSOFT:nm:SystemCustomization:SkipTimerCheck
        UdpNmNodeExtension: gid=iSOFT:nm:UdpNmNodeExtension, extends-meta-class=UdpNmNode
          sdg primitive attribute UserDataString: category=String, lower-multiplicity=0, upper-multiplicity=1, gid=iSOFT:nm:UdpNmNodeExtension:UserDataString
        UdpNmClusterExtension: gid=iSOFT:nm:UdpNmClusterExtension, extends-meta-class=UdpNmCluster
          10 x sdg primitive attribute, all with lower-multiplicity=0, upper-multiplicity=1:
            SendImmediateInRepeatMessage: category=Boolean, gid=iSOFT:nm:UdpNmClusterExtension:SendImmediateInRepeatMessage
            RepeatMessageRequestPnCheck: category=Boolean, gid=iSOFT:nm:UdpNmClusterExtension:RepeatMessageRequestPnCheck
            SetActiveWakeupBit: category=Boolean, gid=iSOFT:nm:UdpNmClusterExtension:SetActiveWakeupBit
            NmStateInUserDataOffset: category=INTEGER, gid=iSOFT:nm:UdpNmClusterExtension:NmStateInUserDataOffset
            BusSleepToRepeatMessageState: category=INTEGER, gid=iSOFT:nm:UdpNmClusterExtension:BusSleepToRepeatMessageState
            PrepareBusSleepToRepeatMessageState: category=INTEGER, gid=iSOFT:nm:UdpNmClusterExtension:PrepareBusSleepToRepeatMessageState
            RepeatMessageStateToNormalOperationState: category=INTEGER, gid=iSOFT:nm:UdpNmClusterExtension:RepeatMessageStateToNormalOperationState
            ReadySleepStateToNormalOperationState: category=INTEGER, gid=iSOFT:nm:UdpNmClusterExtension:ReadySleepStateToNormalOperationState
            ReadySleepStateToRepeatMessageState: category=INTEGER, gid=iSOFT:nm:UdpNmClusterExtension:ReadySleepStateToRepeatMessageState
            NormalOperationStateToRepeatMessageState: category=INTEGER, gid=iSOFT:nm:UdpNmClusterExtension:NormalOperationStateToRepeatMessageState
        NetworkHandleToUserProcessMapping: gid=iSOFT:nm:NetworkHandleToUserProcessMapping, extends-meta-class=NmInstantiation
          attributes:
            sdg aggregation with variation NetworkHandleToUserProcessMappingSubclass: lower-multiplicity=0, upper-multiplicity-infinite=true, gid=iSOFT:nm:NetworkHandleToUserProcessMappingSubclass:Attributes, variation=false, sub-sdg=NetworkHandleToUserProcessSubMapping
        NetworkHandleToUserProcessSubMapping
          attributes:
            sdg foreign reference NetworkHandle: lower-multiplicity=1, upper-multiplicity=1, gid=iSOFT:nm:NetworkHandleToUserProcessSubMapping:NetworkHandle, dest-meta-class=NmNetworkHandle
            sdg foreign reference UserProcess: lower-multiplicity=1, upper-multiplicity-infinite=true, gid=iSOFT:nm:NetworkHandleToUserProcessSubMapping:UserProcess, dest-meta-class=Process

AUTOSAR XML (schema 00049)
package /ISOFT/GenDef/Standardized_SecurityEvents_CanIf
  4 x security event definition:
    CANIF_SEV_ERRORSTATE_BUSOFF: id=22  # The CAN controller transitioned to state busoff.
    CANIF_SEV_ERRORSTATE_PASSIVE: id=21  # The CAN controller transitioned to state passive.
    CANIF_SEV_RX_ERROR_DETECTED: id=20  # A reception related error was detected. Depending on the context data this could indicate suspicious CAN activity.
    CANIF_SEV_TX_ERROR_DETECTED: id=19  # A transmission related error was detected. Depending on the context data this could indicate suspicious CAN activity.
package /ISOFT/GenDef/Standardized_SecurityEvents_Dcm
  21 x security event definition:
    DIAG_SEV_AUTHENTICATION_SUCCESSFUL: id=38  # Succesfully authenticated (via Authentication $29)
    DIAG_SEV_CERTIFICATE_FAILURE: id=36  # The tester tried an authentication with an invalid certficate.
    DIAG_SEV_CLEAR_DTC_SUCCESSFUL: id=39  # DTC information has been cleared by SID 0x14 ClearDTCInformation
    DIAG_SEV_COMMUNICATION_CONTROL_SWITCHED_OFF: id=25  # ECU communicationwas switched off with service CommunicationControl.
    DIAG_SEV_DTC_SETTING_SWITCHED_OFF: id=43  # DTC setting switched off with service 0x85 (ControlDTCSetting).
    DIAG_SEV_ECU_RESET: id=40  # ECU had been reset by SID 0x11 ResetECU
    DIAG_SEV_ECU_UNLOCK_SUCCESSFUL: id=37  # Successful unlocked the ECU (via Security Access $27), per Level
    DIAG_SEV_INCORRECT_MESSAGE_LENGTH_OR_FORMAT: id=28  # Received request message does not match the specified length or the format of the parameters is different from the specified ones for that service. NRC 0x13 (incorrectMessageLengthOrInvalidFormat) was returned.
    DIAG_SEV_NUMBER_OF_FAILED_AUTHENTICATION_ATTEMPTS_EXCEEDED: id=35  # Number of failed authentification attempts - OEM specific
    DIAG_SEV_REQUESTED_ACTIONS_REQUIRES_AUTHENTICATION: id=31  # A diagnostic request was received while the required authentication to executie this service is not given. NRC 0x34 (authenticationRequired) was returned.
    DIAG_SEV_REQUEST_DOWNLOAD: id=42  # A diagnsotic data download sequence was requested with SID 0x34.
    DIAG_SEV_REQUEST_OUT_OF_RANGE: id=30  # A diagnsotic request with a parameter that is our range of the allowed bounds wa received. A NRC 0x31 (requestOutOfRange) was returned.
    DIAG_SEV_REQUEST_SEQUENCE_ERROR: id=29  # A diagnostic service was received in the wrong sequence order. NRC 0x24 (requestSequenceError) was returned.
    DIAG_SEV_SECURITY_ACCESS_DENIED: id=24  # Tester has send an diagnostic request without meeting the servers security level requirements for that service. NRC 0x33 (securityAccessDenied) was returned.
    DIAG_SEV_SECURITY_ACCESS_INVALID_KEY: id=33  # Security Access failed because the tester has send an invalid key to the server. An NRC 0x35 (invalidKey) was returned.
    DIAG_SEV_SECURITY_ACCESS_NUMBER_OF_ATTEMPTS_EXCEEDED: id=32  # Security Access failed and the number of invalid attempts has been exceeded. NRC 0x36 (exceedNumberOfAttempts) was returned.
    DIAG_SEV_SECURITY_ACCESS_REQUIRED_TIME_DELAY_NOT_EXPIRED: id=34  # A further attempt to unlock the ECU was taken before the delay time had expired. NRC 0x37 (requiredTimeDelayNotExpired) was sent.
    DIAG_SEV_SERVICE_NOT_SUPPORTED: id=26  # A diagnostic service war requested that is not supported or not supported in the active session. NRC 0x11 (serviceNotSupported) or NRC 0x7F (serviceNotSupportedInActiveSession) was returned.
    DIAG_SEV_SUBFUNCTION_NOT_SUPPORTED: id=27  # A subfunction of a diagnostic service was requested that is not supported for the requested service.
    DIAG_SEV_WRITE_DATA: id=41  # Diagnostic data identifier have been written by SID 0x2E.
    DIAG_SEV_WRITE_INVALID_DATA: id=23  # Tester writes invalid data with service WriteDataByIdentifier.
package /ISOFT/GenDef/Standardized_SecurityEvents_EthIf
  4 x security event definition:
    ETHIF_SEV_DROP_ETH_MAC_COLLISIONN: id=18  # Ethernet datagram was dropped because local MAC was same as source MAC in an incoming frame.
    ETHIF_SEV_DROP_INV_VLAN: id=17  # An ethernet datagram was dropped due to an invalid CrtlIdx/VLAN.
    ETHIF_SEV_DROP_UNKNOWN_ETHERTYPE: id=15  # An ethernet datagram was dropped due the Ethertype in not known.
    ETHIF_SEV_DROP_VLAN_DOUBLE_TAG: id=16  # An ethernet datagram was dropped due to double VLAN tag.
package /ISOFT/GenDef/Standardized_SecurityEvents_IDSM
  4 x security event definition:
    IDSM_INTERNAL_EVENT_COMMUNICATION_ERROR: id=49  # The current rate exceeds a configured rate limitation.
    IDSM_INTERNAL_EVENT_NO_CONTEXT_DATA_BUFFER_AVAILABLE: id=47  # The context data of an incoming event cannot be stored because there are no more context data buffers available.
    IDSM_INTERNAL_EVENT_NO_EVENT_BUFFER_AVAILABLE: id=46  # A SEv cannot be handled because there are no more event buffers available to process the event.
    IDSM_INTERNAL_EVENT_TRAFFIC_LIMITATION_EXCEEDED: id=48  # The current traffic exceeds a configured traffic limitation.
package /ISOFT/GenDef/Standardized_SecurityEvents_KeyM
  5 x security event definition:
    KEYM_SEV_CERT_VERIF_FAILED: id=5  # A request to verify a certificate against a certificate chain was not successful.
    KEYM_SEV_INST_INTERMEDIATE_CERT_OP: id=3  # Attempt to install an intermediate certificate.
    KEYM_SEV_INST_ROOT_CERT_OP: id=1  # Attempt to install a root certificate.
    KEYM_SEV_UPD_INTERMEDIATE_CERT_OP: id=4  # Attempt to update an intermediate certificate.
    KEYM_SEV_UPD_ROOT_CERT_OP: id=2  # Attempt to update an existing root certificate.
package /ISOFT/GenDef/Standardized_SecurityEvents_SecOc
  security event definition SECOC_SEV_FRESHNESS_NOT_AVAILABLE: id=45  # Faild to get freshness value from FvM.
  security event definition SECOC_SEV_MAC_VERIFICATION_FAILED: id=44  # MAC verification of a received PDU failed.
package /ISOFT/GenDef/Standardized_SecurityEvents_SoAd
  5 x security event definition:
    SOAD_SEV_DROP_MSG_RX_UDP_LENGTH: id=7  # SoAd dropped a message. The message contains at least one PDU which violates stack configuration and was received via a UDP socket. The violation relates to the length of the PDUs compared to the overall length of the message.
    SOAD_SEV_DROP_MSG_RX_UDP_SOCKET: id=8  # SoAd received a UDP message which violates stack configuration and was dropped. No suitable socket connection matching to configuration was found.
    SOAD_SEV_DROP_PDU_RX_TCP: id=5  # SoAd dropped a PDU. The PDU violates stack configuration and was received via a TCP socket.
    SOAD_SEV_DROP_PDU_RX_UDP: id=6  # SoAd dropped a PDU. The PDU violates stack configuration and was received via a UDP socket.
    SOAD_SEV_REJECTED_TCP_CONNECTION: id=9  # SoAd rejected a TCP connection. The connection request violates stack configuration.
package /ISOFT/GenDef/Standardized_SecurityEvents_TcpIp
  5 x security event definition:
    TCPIP_SEV_ARP_IP_ADDR_CONFLICT: id=32770  # Received local IP address in ARP reply for different MAC.
    TCPIP_SEV_DROP_INV_IPV4_ADDR: id=32771  # Dropped datagram because of invalid IPV4 address.
    TCPIP_SEV_DROP_INV_IPV6_ADDR: id=32772  # Dropped datagram because of invalid IPV6 address.
    TCPIP_SEV_DROP_INV_PORT_TCP: id=32773  # Dropped TCP packet because of invalid destination TCP-Port.
    TCPIP_SEV_DROP_INV_PORT_UDP: id=32774  # Dropped UDP packet because of invalid destination UDP-Port.

AUTOSAR XML (schema 00049)
package /ISOFT/PlatformComponents/idsm
  sdg def Extension
    sdg-classes:
      sdg class Idsr: category=ISOFT_EXTENSION, gid=iSOFT:idsm:Idsr, extends-meta-class=IdsmModuleInstantiation
        attributes:
          sdg primitive attribute Port: category=INTEGER, lower-multiplicity=1, upper-multiplicity=1, gid=iSOFT:idsm:Idsr:Port, max=256, min=0
          sdg foreign reference IpAddr: lower-multiplicity=1, upper-multiplicity=1, gid=iSOFT:idsm:Idsr:IpAddr, dest-meta-class=NetworkEndpoint
      sdg class Limitation: category=ISOFT_EXTENSION, gid=iSOFT:idsm:Limitation, extends-meta-class=IdsmInstance
        sdg primitive attribute Event: category=INTEGER, lower-multiplicity=1, upper-multiplicity=1, gid=iSOFT:idsm:Limitation:Event, max=256, min=0
        sdg primitive attribute Context: category=INTEGER, lower-multiplicity=1, upper-multiplicity=1, gid=iSOFT:idsm:Limitation:Context, max=4096, min=0

AUTOSAR XML (schema 00049)
package /ara/idsm/CryptoInterface
  crypto key slot interface idsm_encode_signature
package /ara/idsm/DiagnosticPortInterface
  diagnostic data identifier generic interface DiagnosticDataIdentifierGenericInterface_common

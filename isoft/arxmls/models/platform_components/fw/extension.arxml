AUTOSAR XML (schema 00049)
package /ISOFT/PlatformComponents/fw
  sdg def Extension
    sdg-classes:
      sdg class FirewallStateSwitchInterface: category=ISOFT_EXTENSION, gid=iSOFT:fw:FirewallStateSwitchInterface, extends-meta-class=RPortPrototype
        attributes:
          sdg aggregation with variation firwallStatus: lower-multiplicity=0, upper-multiplicity-infinite=true, gid=iSOFT:fw:FirewallStateSwitchInterface:firewallStatus, sub-sdg=FirewallStatusEnum
      sdg class FirewallStatusEnum: category=ISOFT_EXTENSION, gid=iSOFT:fw:FirewallStatusEnum
        sdg primitive attribute fwStatusName: category=STRING, lower-multiplicity=1, upper-multiplicity=1, gid=iSOFT:fw:FirewallStatusEnum:fwStatusName
        sdg primitive attribute fwStatusValue: category=INTEGER, lower-multiplicity=1, upper-multiplicity=1, gid=iSOFT:fw:FirewallStatusEnum:fwStatusValue

AUTOSAR XML (schema 00049)
package /ISOFT/PlatformComponents/SecurityEventReportInterface
  security event report interface SecurityEventReport_fw
package /ISOFT/PlatformComponents/fw
  process design fwd_proc_design: executable=fwd
package /ISOFT/PlatformComponents/fw/exe
  executable fwd: category=PLATFORM_LEVEL, logging-behavior=USES-LOGGING, reporting-behavior=REPORTS-EXECUTION-STATE
    root sw component prototype fw_root_swc: application-type=fw_swc
package /ISOFT/PlatformComponents/fw/swc
  adaptive application sw component type fw_swc
    require port rPort_fw: required-interface=SecurityEventReport_fw

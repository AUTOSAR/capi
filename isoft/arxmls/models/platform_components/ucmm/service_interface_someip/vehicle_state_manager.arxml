AUTOSAR XML (schema 00049)
package /ara/ucm_master/deployment
  someip service interface deployment VehicleStateManagerSomeIp: service-interface=VehicleStateManager, service-interface-id=33, service-interface-version={major-version=1, minor-version=0}
    someip field deployment SafetyPolicy: field=SafetyPolicy
      get SafetyPolicy_getter: method-id=23001, transport-protocol=UDP
      notifier SafetyPolicy_notifier: event-id=23009, transport-protocol=UDP
    someip method deployment SafetyState: method=SafetyState, method-id=31017, transport-protocol=UDP
    someip event group SafetyPolicy_eventgroup: event-group-id=45304, event=SafetyPolicy_notifier

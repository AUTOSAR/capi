AUTOSAR XML (schema 00049)
package /ara/ucm_master/deployment
  someip service interface deployment VehicleDriverApplicationSomeIp: service-interface=VehicleDriverApplication, service-interface-id=32, service-interface-version={major-version=1, minor-version=0}
    4 x someip field deployment:
      ApprovalRequired: field=ApprovalRequired
        get ApprovalRequired_getter: method-id=23001, transport-protocol=UDP
        notifier ApprovalRequired_notifier: event-id=23002, transport-protocol=UDP
      CampaignState: field=CampaignState
        get CampaignState_getter: method-id=23003, transport-protocol=UDP
        notifier CampaignState_notifier: event-id=23004, transport-protocol=UDP
      SafetyPolicy: field=SafetyPolicy
        get SafetyPolicy_getter: method-id=23005, transport-protocol=UDP
        notifier SafetyPolicy_notifier: event-id=23006, transport-protocol=UDP
      SafetyState: field=SafetyState
        get SafetyState_getter: method-id=23007, transport-protocol=UDP
        notifier SafetyState_notifier: event-id=23008, transport-protocol=UDP
    8 x someip method deployment, all with transport-protocol=UDP:
      AllowCampaign: method=AllowCampaign, method-id=31010
      CancelCampaign: method=CancelCampaign, method-id=31009
      DriverApproval: method=DriverApproval, method-id=31011
      GetCampaignHistory: method=GetCampaignHistory, method-id=31012
      GetSwClusterDescription: method=GetSwClusterDescription, method-id=31013
      GetSwPackageDescription: method=GetSwPackageDescription, method-id=31014
      GetSwProcessProgress: method=GetSwProcessProgress, method-id=31015
      GetSwTransferProgress: method=GetSwTransferProgress, method-id=31016
    4 x someip event group:
      ApprovalRequired_eventgroup: event-group-id=45300, event=ApprovalRequired_notifier
      CampaignState_eventgroup: event-group-id=45301, event=CampaignState_notifier
      SafetyPolicy_eventgroup: event-group-id=45302, event=SafetyPolicy_notifier
      SafetyState_eventgroup: event-group-id=45303, event=SafetyState_notifier

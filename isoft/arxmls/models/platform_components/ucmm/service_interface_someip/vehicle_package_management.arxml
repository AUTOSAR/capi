AUTOSAR XML (schema 00049)
package /ara/ucm_master/deployment
  someip service interface deployment VehiclePackageManagementSomeIp: service-interface=VehiclePackageManagement, service-interface-id=31, service-interface-version={major-version=1, minor-version=0}
    someip field deployment RequestedPackage: field=RequestedPackage
      get RequestedPackage_getter: method-id=31006, transport-protocol=UDP
      notifier RequestedPackage_notifier: event-id=9433, transport-protocol=UDP
    someip field deployment SafetyState: field=SafetyState
      get SafetyState_getter: method-id=31007, transport-protocol=UDP
      notifier SafetyState_notifier: event-id=9434, transport-protocol=UDP
    someip field deployment TransferState: field=TransferState
      get TransferState_getter: method-id=31005, transport-protocol=UDP
      notifier TransferState_notifier: event-id=9432, transport-protocol=UDP
    11 x someip method deployment, all with transport-protocol=UDP:
      AllowCampaign: method=AllowCampaign, method-id=31110
      CancelCampaign: method=CancelCampaign, method-id=31109
      DeleteTransfer: method=DeleteTransfer, method-id=31111
      GetCampaignHistory: method=GetCampaignHistory, method-id=31112
      GetSwClusterInfo: method=GetSwClusterInfo, method-id=31113
      GetSwPackages: method=GetSwPackages, method-id=31114
      SwPackageInventory: method=SwPackageInventory, method-id=31115
      TransferData: method=TransferData, method-id=31118
      TransferExit: method=TransferExit, method-id=31119
      TransferStart: method=TransferStart, method-id=31120
      TransferVehiclePackage: method=TransferVehiclePackage, method-id=31121
    someip event group RequestedPackage_eventgroup: event-group-id=45401, event=RequestedPackage_notifier
    someip event group SafetyState_eventgroup: event-group-id=45402, event=SafetyState_notifier
    someip event group TransferState_eventgroup: event-group-id=45400, event=TransferState_notifier

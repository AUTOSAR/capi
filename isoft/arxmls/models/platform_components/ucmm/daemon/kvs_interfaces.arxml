AUTOSAR XML (schema 00049)
package /ara/ucm_master/PersistencyKeyValueDatabaseInterfaces
  persistency key value storage interface SwPackageTransferStatus: minimum-sustained-size=4096, redundancy-handlings=persistency-redundancy-m-out-of-n={m=3, n=5}, update-strategy=KEEP-EXISTING
  persistency key value storage interface CampaignHistory: minimum-sustained-size=4096, redundancy-handlings=persistency-redundancy-m-out-of-n={m=3, n=5}, update-strategy=KEEP-EXISTING

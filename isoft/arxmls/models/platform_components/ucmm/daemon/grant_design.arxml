AUTOSAR XML (schema 00049)
package /ISOFT/PlatformComponents/ucm_master
  com field grant design ucmm_ucmfieldgrantdesign: process-design=ucmm_design, role=GETTER
  com find service grant design ucmm_ucmfindservicegrantdesign: process-design=ucmm_design, required-service-port=ucmm_root.PackageManagementRPort
  com offer service grant design ucmm_ucmofferservicegrantdesign1: process-design=ucmm_design, provided-service-port=ucmm_root.VehicleDriverApplicationPPort
  com offer service grant design ucmm_ucmofferservicegrantdesign2: process-design=ucmm_design, provided-service-port=ucmm_root.VehiclePackageManagementPPort
  com offer service grant design ucmm_ucmofferservicegrantdesign3: process-design=ucmm_design, provided-service-port=ucmm_root.VehicleStateManagerPPort

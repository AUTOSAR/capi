AUTOSAR XML (schema 00049)
package /ara/ucm/pkgmgr/portinterfaces
  service interface VehicleStateManager: is-service=true
    namespaces:
      symbol props ara
      symbol props ucm
      symbol props vsm
    field SafetyPolicy: type=SafetyPolicyType, has-getter=true, has-notifier=true, has-setter=false  # Safety policy from the Vehicle Package to be computed by the Vehicle State Manager Adaptive Application.
    methods:
      operation SafetyState: fire-and-forget=false  # Method called by Vehicle State Manager Adaptive Application when safety state is changed
        arg SafetyPolicy: type=SafetyPolicyType, direction=IN  # Safety policy computed by the Vehicle State Manager Adaptive Application
        arg SafeToUpdate: type=bool, direction=IN  # Vehicle safety state

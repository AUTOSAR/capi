AUTOSAR XML (schema 00049)
package /ara/ucm/pkgmgr/portinterfaces
  service interface VehiclePackageManagement: is-service=true
    namespaces:
      symbol props ara
      symbol props ucm
      symbol props pkgmgr
    field TransferState: type=TransferStateType, has-getter=true, has-notifier=true, has-setter=false  # The current status of Campaign from an OTA Client perspective.
    field RequestedPackage: type=SwNameVersionType, has-getter=true, has-notifier=true, has-setter=false  # Software Package to be transfered to UCM Master
    field SafetyState: type=bool, has-getter=true, has-notifier=true, has-setter=false  # Vehicle state computed by the Vehicle State Manager Adaptive Application.
    methods:
      11 x operation, all with fire-and-forget=false:
        CancelCampaign: possible-ap-error=[CancelFailed, InvalidTransferId, OperationNotPermitted]  # This method aborts an ongoing campaign processing of a Vehicle Package.
          arg DisableCampaign: type=bool, direction=IN  # To forbid new campaign
        AllowCampaign  # To allow a new campaign to start
        DeleteTransfer: possible-ap-error=[InvalidTransferId, OperationNotPermitted]  # Delete a transferred Software or Vehicle Package.
          arg id: type=TransferIdType, direction=IN  # Transfer ID of the currently running request.
        GetCampaignHistory  # Getter method to retrieve all actions that have been performed by UCM Master.
          arg timestampGE: type=uint64_t, direction=IN  # Earliest timestamp (inclusive)
          arg timestampLT: type=uint64_t, direction=IN  # Latest timestamp (exclusive)
          arg CampaignHistory: type=CampaignHistoryVectorType, direction=OUT  # The history of all actions that have been performed by UCM Master.
        GetSwClusterInfo: possible-ap-error=OperationNotPermitted  # This method returns a list of SoftwareClusters that are in state kPresent.
          arg SwInfo: type=SwClusterInfoVectorType, direction=OUT  # List of installed SoftwareClusters that are in state kPresent.
        GetSwPackages  # This method returns the Software Packages that are part of current campaign handled by UCM Master.
          arg Packages: type=SwPackageInfoVectorType, direction=OUT  # List of Software Packages.
        SwPackageInventory: possible-ap-error=OperationNotPermitted
          arg AvailableSoftwarePackages: type=SwNameVersionVectorType, direction=IN  # List of available Software Packages in Backend corresponding to VIN.
          arg RequiredSoftwarePackages: type=SwNameVersionVectorType, direction=OUT  # List of Software Packages to be sent to UCM Master.
        TransferData: possible-ap-error=[IncorrectBlock, IncorrectBlockSize, AuthenticationFailed, BlockInconsistent, IncompatiblePackageVersion, IncorrectSize, InsufficientComputationPower, InsufficientMemory, InvalidTransferId, OperationNotPermitted, PackageInconsistent, TransferInterrupted]  # Block-wise transfer of a Software or Vehicle Package to UCM Master.
          arg id: type=TransferIdType, direction=IN  # Transfer ID.
          arg data: type=ByteVectorType, direction=IN  # Data block of the Software or Vehicle Package.
          arg blockCounter: type=uint64_t, direction=IN  # Block counter value of the current block.
        TransferExit: possible-ap-error=[AuthenticationFailed, IncompatiblePackageVersion, InsufficientData, InvalidPackageManifest, InvalidTransferId, MissingDependencies, OldVersion, OperationNotPermitted, PackageInconsistent]  # Finish the transfer of a Software or Vehicle Package to UCM Master.
          arg id: type=TransferIdType, direction=IN  # Transfer ID of the currently running request.
        TransferStart: possible-ap-error=[OperationNotPermitted, UnexpectedPackage, InsufficientComputationPower, InsufficientMemory]  # Start the transfer of a Software Package. The name of the Software Package to be transferred to UCM Master must be provided. UCM Master will generate a T ransfer ID for subsequent calls to T ransferData, TransferExit, DeleteT ransfer. Size of Software Package to be used to transfer to UCM subordinate is available in the Vehicle Package and its contained Software Package Manifests.
          arg SoftwarePackageName: type=SwNameType, direction=IN  # Software Package Short Name of the Software Package to be transferred.
          arg id: type=TransferIdType, direction=OUT  # Return TransferId.
          arg BlockSize: type=uint64_t, direction=OUT  # Size of the blocks to be received with TransferData method.
        TransferVehiclePackage: possible-ap-error=[OperationNotPermitted, InsufficientMemory, NewCampaignDisabled]  # Start the transfer of a Vehicle Package. The size of the Vehicle Package to be transferred to UCM Master must be provided. UCM Master will generate a Transfer ID for subsequent calls to TransferData, Transfer Exit, ProcessSwPackage, DeleteTransfer.
          arg size: type=uint64_t, direction=IN  # Size (in bytes) of the Vehicle Package to be transferred.
          arg id: type=TransferIdType, direction=OUT  # Return TransferId.
          arg BlockSize: type=uint64_t, direction=OUT  # Size of the blocks to be received with TransferData method.

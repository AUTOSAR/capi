AUTOSAR XML (schema 00049)
package /ISOFT/PlatformComponents/phm
  process design phm_daemon_design: executable=phmd
package /ISOFT/PlatformComponents/phm/exe
  executable phmd: category=PLATFORM_LEVEL, logging-behavior=USES-LOGGING, reporting-behavior=REPORTS-EXECUTION-STATE
    root sw component prototype swc_phm: application-type=phmd
package /ISOFT/PlatformComponents/phm/swc
  adaptive application sw component type phmd

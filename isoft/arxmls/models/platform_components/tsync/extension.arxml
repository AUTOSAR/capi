AUTOSAR XML (schema 00049)
package /ISOFT/PlatformComponents/tsync
  sdg def Extension
    sdg-classes:
      sdg class GlobalTimeDomainExtension: category=ISOFT_EXTENSION, gid=iSOFT:tsync:GlobalTimeDomainExtension, extends-meta-class=GlobalTimeDomain
        6 x sdg primitive attribute, all with lower-multiplicity=0, upper-multiplicity=1:
          GlobalTimePropagationDelay: category=FLOAT, gid=iSOFT:tsync:GlobalTimeDomainExtension:GlobalTimePropagationDelay
          MasterSlaveConflictDetection: category=BOOLEAN, gid=iSOFT:tsync:GlobalTimeDomainExtension:MasterSlaveConflictDetection
          CrcTimeFlagsTxSecured: category=INTEGER, gid=iSOFT:tsync:GlobalTimeDomainExtension:CrcTimeFlagsTxSecured
          GlobalTimeSequenceCounterJumpWidth: category=INTEGER, gid=iSOFT:tsync:GlobalTimeDomainExtension:GlobalTimeSequenceCounterJumpWidth
          UseSteadyClock: category=BOOLEAN, gid=iSOFT:tsync:GlobalTimeDomainExtension:UseSteadyClock
          TimeStampType: category=ENUMERATION, gid=iSOFT:tsync:GlobalTimeDomainExtension:TimeStampType, pattern=Software|Hardware

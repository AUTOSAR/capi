AUTOSAR XML (schema 00049)
package /ISOFT/PlatformComponents/tsync
  executable tsyncd: category=PLATFORM_LEVEL, build-type=BUILD-TYPE-DEBUG, logging-behavior=USES-LOGGING, minimum-timer-granularity=0.001, reporting-behavior=REPORTS-EXECUTION-STATE, version=1.0.0
    root sw component prototype root_swc: application-type=tsync_daemon
  process design tsync_daemon_proc_design: executable=tsyncd
package /ISOFT/PlatformComponents/tsync/AdaptiveApplicationSwComponentType
  adaptive application sw component type tsync_daemon
    provide/require port timesync_offsetprovider_file_port: provided-required-interface=timesync_offsetprovider_file_interface
    provide/require port timesync_provider_port: provided-required-interface=timesync_provider_kv_interface
package /ISOFT/PlatformComponents/tsync/PersistencyStorageInterface
  persistency file storage interface timesync_offsetprovider_file_interface: redundancy-handlings=persistency-redundancy-crc={algorithm-family=CRC_32P4, length=32}, max-number-of-files=32
  persistency key value storage interface timesync_provider_kv_interface: minimum-sustained-size=1024, redundancy=NONE, redundancy-handlings=persistency-redundancy-m-out-of-n={m=3, n=5}, update-strategy=KEEP-EXISTING

AUTOSAR XML (schema 00049)
package /ara/ucm/ApApplicationErrors
  35 x ap application error, all with error-domain=UCMErrorDomain:
    NewCampaignDisabled: error-code=31  # New campaigns are disabled, calling AllowCampaign will enable new campaigns.
    UnexpectedPackage: error-code=32  # The Software Package name does not correspond to the RequestedPackage field value.
    IncorrectBlock: error-code=2  # The block counter value is not as expected.
    IncorrectBlockSize: error-code=30  # The size of the block exceeds the provided block size from T ransfer Start or T ransferVehiclePackage.
    AuthenticationFailed: error-code=8  # Package authentication failed.
    BlockInconsistent: error-code=25  # Consistency check for transferred block failed.
    CancelFailed: error-code=16  # Cancel failed.
    IncompatibleDelta: error-code=29  # Delta package dependency check failed.
    IncompatiblePackageVersion: error-code=24  # The version of the Software or Vehicle Package to be processed is not compatible with the current version of UCM or UCM Master.
    IncorrectSize: error-code=3  # The size of the Software or Vehicle Package exceeds the provided size in T ransferStart.
    InsufficientComputationPower: error-code=28  # Insufficient computation power to perform the requested operation.
    InsufficientData: error-code=6  # TransferExit has been called but total transferred data size does not match expected data size provided with TransferStart call.
    InsufficientMemory: error-code=1  # Insufficient memory to perform operation.
    InvalidPackageManifest: error-code=13  # Package manifest could not be read.
    InvalidTransferId: error-code=4  # The Transfer ID is invalid.
    MissingDependencies: error-code=21  # Activate cannot be performed because of missing dependencies.
    NotAbleToRevertPackages: error-code=15  # RevertProcessedSwPackages failed.
    NotAbleToRollback: error-code=18  # Rollback failed.
    OldVersion: error-code=9  # Software Package version is too old.
    OperationNotPermitted: error-code=5  # The operation is not supported in the current context.
    PackageInconsistent: error-code=7  # Package integrity check failed.
    ProcessSwPackageCancelled: error-code=22  # The processing operation has been interrupted by a Cancel() call.
    ProcessedSoftwarePackageInconsistent: error-code=23  # The processed Software Package integrity check has failed.
    ServiceBusy: error-code=12  # Another processing is already ongoing and therefore the current processing request has to be rejected.
    TransferInterrupted: error-code=26  # Transfer has been interrupted.
    UpdateSessionRejected: error-code=33  # Start of an update session was rejected by State Management.
    PreActivationFailed: error-code=19  # Error during preActivation step.
    VerificationFailed: error-code=27  # Error during verification step.
    ResettingMachine: error-code=34  # Resetting machine during verification step.
    ErrorNoValidProcessing: error-code=20  # Activate cannot be performed because previous processing is invalid.
    GeneralMemoryError: error-code=11  # A general memory error occured.
    GeneralReject: error-code=10  # General reject.
    NothingToRevert: error-code=14  # RevertProcessedSwPackages has been called without prior processing of a Software Package.
    NothingToRollback: error-code=17  # Rollback cannot be performed due to no rollback data available.
    SoftwareClusterMissing: error-code=37  # The Software Cluster is not present in the Machine.
  ap application error domain UCMErrorDomain: value=42
    namespaces:
      symbol props ara
      symbol props ucm
      symbol props pkgmgr
package /ara/ucm/datatypes/ImplementationDataTypes
  42 x std cpp implementation data type, all with type-emitter=TYPE_EMITTER_ARA:
    SwNameType: category=STRING  # SoftwareCluster (SoftwarePackage) name.
      namespaces:
        symbol props ara
        symbol props ucm
        symbol props pkgmgr
    SwNameVectorType: category=VECTOR, cpp-template-argument=SwNameType  # Represents a dynamic size array of Software Cluster names.
      namespaces:
        symbol props ara
        symbol props ucm
        symbol props pkgmgr
    SwNameVersionType: category=STRUCTURE  # Represents the information of a Software Package (Software Cluster) name and version.
      namespaces:
        symbol props ara
        symbol props ucm
        symbol props pkgmgr
      cpp implementation data type element Name: type-reference=SwNameType  # Software name
      cpp implementation data type element Version: type-reference=StrongRevisionLabelString  # Software version
    SwNameVersionVectorType: category=VECTOR, cpp-template-argument{inplace=false, template-type=SwNameVersionType}  # Represents a dynamic size array of Software Name and Version
      namespaces:
        symbol props ara
        symbol props ucm
        symbol props pkgmgr
    UCMIdentifierType: category=STRING  # UCM Module Instantiation Identifier.
      namespaces:
        symbol props ara
        symbol props ucm
        symbol props pkgmgr
    TransferStateType:  # Represents the state of an update from OTA Client perspective.
      compu {0x00=kIdle (UCM Master is ready to start a software update campaign.), 0x01=kTransferring (Vehicle or Software Packages are being transferred.), 0x02=kUpdating (Software Clusters are being updated in the vehicle.), 0x03=kCancelling (An error occurred, campaign is being cancelled, reverting changes.), 0x04=kSyncing (UCM master is providing the list of installed SWCLs (GetSwClusterInfo) or computing the list of SWCLs to install (SwPackageInventory).)}
      range raw 0x00..0x04
      type-reference=uint8_t
      namespaces:
        symbol props ara
        symbol props ucm
        symbol props pkgmgr
    CampaignStateType:  # Represents the status of Campaign.
      compu {0x00=kIdle (UCM Master is ready to start a software update campaign.), 0x01=kSyncing (UCM master is providing the list of installed SWCLs (GetSwClusterInfo) or computing the list of SWCLs to install (SwPackageInventory).), 0x02=kVehiclePackageTransferring (A vehicle package is being transferred to UCM Master.), 0x03=kSoftwarePackage_Transferring (UCM Master is transferring software packages to the UCM subordinates.), 0x04=kProcessing (The processing of software packages on UCM subordinates is ongoing. The transferring of software packages may still occur.), 0x05=kActivating (The activation of SWCLs on UCM subordinates is ongoing.), 0x06=kVehicleChecking (UCM Master is performing post-activation checks (OEM specific).), 0x07=kCancelling (UCM Master is rolling-back the activated SWCLs on the UCM subordinates.), 0x08=kCorruptedStatusFile (The status file is corrupted.)}
      range raw 0x00..0x08
      type-reference=uint8_t
      namespaces:
        symbol props ara
        symbol props ucm
        symbol props pkgmgr
    ActionType: compu {0x00=kUpdate (Update of a SoftwareCluster.), 0x01=kInstall (Installation of a new SoftwareCluster.), 0x02=kRemove (Removal of a SoftwareCluster.)}, range raw 0x00..0x02, type-reference=uint8_t  # Represents the UCM action.
      namespaces:
        symbol props ara
        symbol props ucm
        symbol props pkgmgr
    ActivateOptionType: compu {0x00=kWaitForReboot (The installation has no immediate consequences in terms of other software on the target.), 0x01=kRestartApplication (Restart the application software on the target Machine.), 0x02=kReboot (Reboot the whole Machine.)}, range raw 0x00..0x02, type-reference=uint8_t  # Represents the option parameter type of the Activate method.
      namespaces:
        symbol props ara
        symbol props ucm
        symbol props pkgmgr
    ByteVectorType: category=VECTOR, cpp-template-argument=uint8_t  # Byte vector representing raw data.
      namespaces:
        symbol props ara
        symbol props ucm
        symbol props pkgmgr
    GetHistoryType: category=STRUCTURE  # Time refers to the activation time of the software cluster. It is represented in milliseconds of UCM’s action resolution since 01.01.1970 (UTC).
      namespaces:
        symbol props ara
        symbol props ucm
        symbol props pkgmgr
      5 x cpp implementation data type element:
        Time: type-reference=uint64_t  # Date and time of UCM’s action resolution.
        Name: type-reference=SwNameType  # Name of the SoftwareCluster
        Version: type-reference=StrongRevisionLabelString  # Version of the SoftwareCluster
        Action: type-reference=ActionType  # What action was performed by UCM
        Resolution: type-reference=ResultType  # What action was performed by UCM
    GetHistoryVectorType: category=VECTOR, cpp-template-argument{inplace=false, template-type=GetHistoryType}  # Represents a list of UCM actions
      namespaces:
        symbol props ara
        symbol props ucm
        symbol props pkgmgr
    UCMStepErrorType: category=STRUCTURE  # UCM Error.
      namespaces:
        symbol props ara
        symbol props ucm
        symbol props pkgmgr
      cpp implementation data type element ucmId: type-reference=UCMIdentifierType  # ----------
      cpp implementation data type element softwarePackageStep: type-reference=SoftwarePackageStepType  # ----------
      cpp implementation data type element returnedError: type-reference=uint8_t  # ----------
    UCMStepErrorVectorType: category=VECTOR, cpp-template-argument{inplace=false, template-type=UCMStepErrorType}  # Vector of UCM’s errors
      namespaces:
        symbol props ara
        symbol props ucm
        symbol props pkgmgr
    UCMHistoryType: category=STRUCTURE  # History of an UCM.
      namespaces:
        symbol props ara
        symbol props ucm
        symbol props pkgmgr
      cpp implementation data type element ucmId: type-reference=UCMIdentifierType  # ----------
      cpp implementation data type element historyVector: type-reference=HistoryVectorType  # ----------
    UCMHistoryVectorType: category=VECTOR, cpp-template-argument{inplace=false, template-type=UCMHistoryType}  # Vector of UCM sub histories
      namespaces:
        symbol props ara
        symbol props ucm
        symbol props pkgmgr
    CampaignResultType: category=STRUCTURE  # Campaign Resolution.
      namespaces:
        symbol props ara
        symbol props ucm
        symbol props pkgmgr
      5 x cpp implementation data type element:
        campaignResolution: type-reference={inplace=false, type-reference=UCMMasterResolutionVectorType}  # ----------
        UCMStepError: type-reference={inplace=false, type-reference=UCMStepErrorVectorType}  # ----------
        campaignStartTime: type-reference=uint64_t  # ----------
        campaignResolutionTime: type-reference=uint64_t  # ----------
        driverNotified: type-reference=bool  # ----------
    HistoryVectorType: category=STRUCTURE  # History of an UCM.
      namespaces:
        symbol props ara
        symbol props ucm
        symbol props pkgmgr
      cpp implementation data type element id: type-reference=UCMIdentifierType  # ----------
      cpp implementation data type element HistoryVector: type-reference=GetHistoryVectorType  # ----------
    CampaignHistoryVectorType: category=VECTOR, cpp-template-argument{inplace=false, template-type=CampaignHistoryType}  # Represents a list of Campaign history.
      namespaces:
        symbol props ara
        symbol props ucm
        symbol props pkgmgr
    CampaignHistoryType: category=STRUCTURE  # Campaign history.
      namespaces:
        symbol props ara
        symbol props ucm
        symbol props pkgmgr
      cpp implementation data type element campaignResult: type-reference=CampaignResultType  # ----------
      cpp implementation data type element historyVector: type-reference=UCMHistoryVectorType  # ----------
      cpp implementation data type element repository: type-reference=String  # ----------
    LogEntryType: category=STRUCTURE  # Represents a single log message with a log level.
      namespaces:
        symbol props ara
        symbol props ucm
        symbol props pkgmgr
      cpp implementation data type element LogLevel: type-reference={inplace=false, type-reference=LogLevelType}  # The log level of the log message.
      cpp implementation data type element Message: type-reference={inplace=false, type-reference=LogMessageType}  # The log message.
    LogLevelType:  # Represents the severity of the log messages.
      compu {0x00=kOff (Logging is deactivated.), 0x01=kFatal (Only fatal messages are logged.), 0x02=kError (Only messages up to error level are logged.), 0x03=kWarning (Only messages up to warning level are logged.), 0x04=kInfo (Only messages up to info level are logged.), 0x05=kDebug (Only messages up to debug level are logged.), 0x06=kVerbose (Only messages up to verbose level are logged.)}
      range raw 0x00..0x06
      type-reference=uint8_t
      namespaces:
        symbol props ara
        symbol props ucm
        symbol props pkgmgr
    LogMessageType: category=STRING  # Represents a string data type for the log message
      namespaces:
        symbol props ara
        symbol props ucm
        symbol props pkgmgr
    LogVectorType: category=VECTOR, cpp-template-argument{inplace=false, template-type=LogEntryType}  # Represents a list of log messages.
      namespaces:
        symbol props ara
        symbol props ucm
        symbol props pkgmgr
    PackageManagerStatusType:  # Represents the state of UCM.
      compu {0x00=kIdle (UCM is ready to start processing if software packages are present.), 0x01=kReady (UCM has processed one or several packages and waits for additional packages, activation or reversion of processed packages.), 0x02=kProcessing (UCM is currently in the middle of processing a Software Package, i.e. a client has called ProcessSwPackage.), 0x03=kActivating (UCM is performing the dependency check and preparing the activation of the processed Software packages.), 0x04=kActivated (Software changes introduced with processed Software Packages has been activated and executed.), 0x05=kRollingBack (UCM is reverting changes introduced with processed packages.), 0x06=kRolledBack (Software changes introduced with processed Software Packages has been deactivated and original software is executed.), 0x07=kCleaningUp (Making sure that the system is in a clean state.), 0x08=kVerifying (UCM (via State Management) is checking that the processed packages have been properly restarted.), 0x09=kExceptionRollingBack (UCM is reverting changes introduced with processed packages after uncontrolled reset.), 0x0A=kExceptionCleaningUp (Making sure that the system is in a clean state after uncontrolled reset.)}
      range raw 0x00..0x08
      type-reference=uint8_t
      namespaces:
        symbol props ara
        symbol props ucm
        symbol props pkgmgr
    ResultType: compu {0x00=kSuccessfull (UCM’s action was successful.), 0x01=kFailed (UCM’s action failed.)}, range raw 0x00..0x01, type-reference=uint8_t  # Represents the result of UCM action.
      namespaces:
        symbol props ara
        symbol props ucm
        symbol props pkgmgr
    StrongRevisionLabelString: category=STRING  # Represents a generic string data type
      namespaces:
        symbol props ara
        symbol props ucm
        symbol props pkgmgr
    SwClusterInfoType: category=STRUCTURE  # Represents the information of a SoftwareCluster.
      namespaces:
        symbol props ara
        symbol props ucm
        symbol props pkgmgr
      cpp implementation data type element Name: type-reference=SwNameType  # Name of the SoftwareCluster
      cpp implementation data type element Version: type-reference=StrongRevisionLabelString  # SoftwareCluster version
      cpp implementation data type element State: type-reference=SwClusterStateType  # State of the SoftwareCluster
    SwClusterInfoVectorType: category=VECTOR, cpp-template-argument{inplace=false, template-type=SwClusterInfoType}  # Represents a dynamic size array of SoftwareClusters
      namespaces:
        symbol props ara
        symbol props ucm
        symbol props pkgmgr
    SwDescType: category=STRUCTURE  # Contains general information related to SoftwareCluster that can be used by Vehicle Driver Application or Human Interface.
      namespaces:
        symbol props ara
        symbol props ucm
        symbol props pkgmgr
      6 x cpp implementation data type element:
        Name: type-reference=SwNameType  # SoftwareCluster name
        Version: type-reference=StrongRevisionLabelString  # SoftwareCluster version
        TypeApproval: type-reference=String  # TypeApproval carries the homologation information that may be specific for a given country.
        License: type-reference=String  # License has the full text of a license of the enclosing SoftwareCluster.
        ReleaseNotes: type-reference=String  # ReleaseNotes for the explanations of changes since the previous version.
        Size: type-reference=uint64_t
    SwDescVectorType: category=VECTOR, cpp-template-argument{inplace=false, template-type=SwDescType}  # Represents a dynamic size array of SoftwareCluster description
      namespaces:
        symbol props ara
        symbol props ucm
        symbol props pkgmgr
    SwClusterStateType: compu {0x00=kPresent (State of a SoftwareCluster that is installed on the adaptive platform and installation has finished.), 0x01=kAdded (State of a SoftwareCluster that has been newly installed.), 0x02=kUpdated (State of a SoftwareCluster that has been updated.), 0x03=kRemoved (State of a SoftwareCluster that has been removed.)}, range raw 0x00..0x03, type-reference=uint8_t  # Represents the state of a SoftwareCluster on the adaptive platform.
      namespaces:
        symbol props ara
        symbol props ucm
        symbol props pkgmgr
    SwInfoName: category=STRING  # SoftwareCluster name.
      namespaces:
        symbol props ara
        symbol props ucm
        symbol props pkgmgr
    SwPackageInfoType: category=STRUCTURE  # Represents the information of a Software Package.
      namespaces:
        symbol props ara
        symbol props ucm
        symbol props pkgmgr
      6 x cpp implementation data type element:
        Name: type-reference=SwNameType  # SoftwarePackage name.
        Version: type-reference=StrongRevisionLabelString  # SoftwarePackage version
        TransferID: type-reference=TransferIdType  # TransferID of the Software Package
        ConsecutiveBytesReceived: type-reference=uint64_t  # Received Software Package size (in bytes)
        ConsecutiveBlocksReceived: type-reference=uint64_t  # Received Software Package Block number
        State: type-reference=SwPackageStateType  # State of the Software Package
    SwPackageInfoVectorType: category=VECTOR, cpp-template-argument{inplace=false, template-type=SwPackageInfoType}  # Represents a dynamic size array of Software Packages
      namespaces:
        symbol props ara
        symbol props ucm
        symbol props pkgmgr
    SwPackageStateType:  # Represents the state of a Software Package on the Platform.
      compu {0x00=kTransferring (Software package is being transferred, i.e. not completely received.), 0x01=kTransferred (Software package is completely transferred and ready to be processed.), 0x02=kProcessing (Software package is currently being processed.), 0x03=kProcessed (Software package processing finished.), 0x04=kProcessingStream (Software package is being processed from a stream.)}
      range raw 0x00..0x04
      type-reference=uint8_t
      namespaces:
        symbol props ara
        symbol props ucm
        symbol props pkgmgr
    SoftwarePackageStepType: compu {0x00=kTransfer (Software Package transfer.), 0x01=kProcess (Software Package processing.), 0x02=kPreActivate (Software Cluster pre activation.), 0x03=kVerify (Software Cluster verification.)}, range raw 0x00..0x03, type-reference=uint8_t  # .
      namespaces:
        symbol props ara
        symbol props ucm
        symbol props pkgmgr
    UCMMasterResolutionType:  # .
      compu {0x00=kSuccess (Successful campaign), 0x01=kUCMError (UCM error), 0x02=kInvalidVehiclePackageManifest (Vehicle Package manifest is invalid), 0x03=kSubordinateNotAvailableOnTheNetwork (UCM subordinate not reachable), 0x04=kVehicleStateManagerCommunicationError (Communication error with Vehicle State Manager), 0x05=kVehicleDriverInterfaceCommunicationError (Communication error with Vehicle Driver Interface), 0x06=kCampaignCancelled (Campaign was cancelled)}
      range raw 0x00..0x06
      type-reference=uint8_t
      namespaces:
        symbol props ara
        symbol props ucm
        symbol props pkgmgr
    UCMMasterResolutionVectorType: category=VECTOR, cpp-template-argument{inplace=false, template-type=UCMMasterResolutionType}  # Vector of V-UCM errors
      namespaces:
        symbol props ara
        symbol props ucm
        symbol props pkgmgr
    TransferIdType: category=ARRAY, array-size=16, cpp-template-argument=uint8_t  # Represents a handle identifier used to reference a particular transfer request.
      namespaces:
        symbol props ara
        symbol props ucm
        symbol props pkgmgr
    BlockSizeType: type-reference=uint32_t  # Represents the size of a data block handled by TransferData method.
      namespaces:
        symbol props ara
        symbol props ucm
        symbol props pkgmgr
    SafetyPolicyType: category=STRING  # The type of the Safety Policy.
      namespaces:
        symbol props ara
        symbol props ucm
        symbol props pkgmgr

AUTOSAR XML (schema 00049)
package /ara/ucm/pkgmgr/portinterfaces
  service interface PackageManagement
    namespaces:
      symbol props ara
      symbol props ucm
      symbol props pkgmgr
    field CurrentStatus: type=PackageManagerStatusType, has-getter=true, has-notifier=true, has-setter=false
    methods:
      17 x operation, all with fire-and-forget=false:
        Activate: possible-ap-error=[PreActivationFailed, ErrorNoValidProcessing, MissingDependencies, OperationNotPermitted, UpdateSessionRejected, VerificationFailed]  # This method activates the processed components.
        Cancel: possible-ap-error=[CancelFailed, OperationNotPermitted, InvalidTransferId]  # This method aborts an ongoing processing of a Software Package.
          arg id: type=TransferIdType, direction=IN  # The Transfer ID.
        DeleteTransfer: possible-ap-error=[GeneralReject, GeneralMemoryError, InvalidTransferId, OperationNotPermitted]  # Delete a transferred Software Package.
          arg id: type=TransferIdType, direction=IN  # Transfer ID of the currently running request.
        Finish: possible-ap-error=[GeneralReject, OperationNotPermitted]  # This method finishes the processing for the current set of processed Software Packages. It does a cleanup of all data of the processing including the sources of the Software Packages.
        GetHistory
          arg history: type=GetHistoryVectorType, direction=OUT
          arg timestampGE: type=uint64_t, direction=IN
          arg timestampLT: type=uint64_t, direction=IN
        GetId
          arg id: type=UCMIdentifierType, direction=OUT
        GetSwClusterChangeInfo
          arg SwInfo: type=SwClusterInfoVectorType, direction=OUT
        GetSwClusterInfo
          arg SwInfo: type=SwClusterInfoVectorType, direction=OUT
        GetSwPackages
          arg Packages: type=SwPackageInfoVectorType, direction=OUT
        GetSwClusterDescription  # This method returns the general information of the Software Clusters present in the platform
          arg SwCluster: type=SwDescVectorType, direction=OUT  # List of SoftwareClusters present in the platform.
        GetSwProcessProgress: possible-ap-error=InvalidTransferId  # Get the progress (0 - 100%) of the currently processed Software Package.
          arg id: type=TransferIdType, direction=IN  # The Transfer ID of the Software Package.
          arg progress: type=uint8_t, direction=OUT  # The progress of the current package processing (0% - 100%). 0x00 ... 0x64, 0xFF for "‘No information available"’
        ProcessSwPackage: possible-ap-error=[ServiceBusy, InvalidPackageManifest, IncompatibleDelta, ProcessedSoftwarePackageInconsistent, InsufficientMemory, InvalidTransferId, OperationNotPermitted, ProcessSwPackageCancelled, AuthenticationFailed, SoftwareClusterMissing, IncompatiblePackageVersion]  # Process a previously transferred Software Package.
          arg id: type=TransferIdType, direction=IN  # The Transfer ID of this Software Package.
        RevertProcessedSwPackages: possible-ap-error=[NothingToRevert, NotAbleToRevertPackages, OperationNotPermitted]  # Revert the changes done by processing (ProcessSwPackage) of one or several software packages.
        Rollback: possible-ap-error=[NothingToRollback, NotAbleToRollback, OperationNotPermitted]  # Rollback the system to the state before the packages were processed.
        TransferData: possible-ap-error=[AuthenticationFailed, IncorrectBlock, IncorrectBlockSize, BlockInconsistent, IncorrectSize, InsufficientMemory, InvalidTransferId, IncompatiblePackageVersion, OperationNotPermitted, PackageInconsistent]  # Block-wise transfer of a Software Package to UCM.
          arg id: type=TransferIdType, direction=IN  # Transfer ID.
          arg data: type=ByteVectorType, direction=IN  # Data block of the Software Package.
          arg blockCounter: type=uint64_t, direction=IN  # Block counter value of the current block.
        TransferExit: possible-ap-error=[InsufficientData, PackageInconsistent, AuthenticationFailed, OldVersion, InvalidTransferId, IncompatiblePackageVersion, MissingDependencies, InvalidPackageManifest, OperationNotPermitted]  # Finish the transfer of a Software Package to UCM.
          arg id: type=TransferIdType, direction=IN  # Transfer ID of the currently running request.
        TransferStart: possible-ap-error=InsufficientMemory  # Start the transfer of a Software Package. The size of the Software Package to be transferred to UCM must be provided. UCM will generate a Transfer ID for subsequent calls to TransferData, TransferExit, ProcessSwPackage, DeleteTransfer.
          arg size: type=uint64_t, direction=IN  # Size (in bytes) of the Software Package to be transferred.
          arg id: type=TransferIdType, direction=OUT  # Return TransferId.
          arg blockSize: type=BlockSizeType, direction=OUT  # Return the size of the blocks to be used inside TransferData method.

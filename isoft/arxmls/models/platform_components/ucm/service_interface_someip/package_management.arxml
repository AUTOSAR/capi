AUTOSAR XML (schema 00049)
package /ara/ucm/deployment
  someip service interface deployment PackageManagementSomeIp: service-interface=PackageManagement, service-interface-id=30, service-interface-version={major-version=1, minor-version=0}
    someip field deployment CurrentStatus: field=CurrentStatus
      get CurrentStatus_getter: method-id=30005, transport-protocol=UDP
      notifier CurrentStatus_notifier: event-id=8438, transport-protocol=TCP
    17 x someip method deployment:
      Activate: method=Activate, method-id=30140, transport-protocol=UDP
      Cancel: method=Cancel, method-id=30120, transport-protocol=UDP
      DeleteTransfer: method=DeleteTransfer, method-id=30080, transport-protocol=UDP
      Finish: method=Finish, method-id=30150, transport-protocol=UDP
      GetHistory: method=GetHistory, method-id=30200, transport-protocol=UDP
      GetId: method=GetId, method-id=30180, transport-protocol=UDP
      GetSwClusterChangeInfo: method=GetSwClusterChangeInfo, method-id=30000, transport-protocol=UDP
      GetSwClusterDescription: method=GetSwClusterDescription, method-id=30030, transport-protocol=UDP
      GetSwClusterInfo: method=GetSwClusterInfo, method-id=29900, transport-protocol=UDP
      GetSwPackages: method=GetSwPackages, method-id=30020, transport-protocol=UDP
      GetSwProcessProgress: method=GetSwProcessProgress, method-id=30110, transport-protocol=UDP
      ProcessSwPackage: method=ProcessSwPackage, method-id=30090, transport-protocol=UDP
      RevertProcessedSwPackages: method=RevertProcessedSwPackages, method-id=30100, transport-protocol=UDP
      Rollback: method=Rollback, method-id=30130, transport-protocol=UDP
      TransferData: method=TransferData, method-id=30060, transport-protocol=TCP
      TransferExit: method=TransferExit, method-id=30070, transport-protocol=UDP
      TransferStart: method=TransferStart, method-id=30050, transport-protocol=UDP
    someip event group CurrentStatus_eventgroup: event-group-id=44404, event=CurrentStatus_notifier

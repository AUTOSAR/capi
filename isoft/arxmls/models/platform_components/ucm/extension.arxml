AUTOSAR XML (schema 00049)
package /ISOFT/PlatformComponents/ucm
  sdg def Extension
    sdg-classes:
      sdg class SoftwareCluster: category=ISOFT_EXTENSION, gid=iSOFT:ucm:SoftwareCluster, extends-meta-class=SoftwareCluster
        sdg primitive attribute ExtraPackageDir: category=STRING, lower-multiplicity=0, upper-multiplicity=1, gid=iSOFT:ucm:SoftwareCluster:ExtraPackageDir
      sdg class SoftwarePackage: category=ISOFT_EXTENSION, gid=iSOFT:ucm:SoftwarePackage, extends-meta-class=SoftwarePackage
        sdg primitive attribute ActivationAction: category=ENUMERATION, lower-multiplicity=0, upper-multiplicity=1, gid=iSOFT:ucm:SoftwarePackage:ActivationAction, pattern=nothing|reboot|restartApplication
        sdg primitive attribute BasePackagePath: category=STRING, lower-multiplicity=0, upper-multiplicity=1, gid=iSOFT:ucm:SoftwarePackage:BasePackagePath
      sdg class CryptoCertificate: category=ISOFT_EXTENSION, gid=iSOFT:ucm:CryptoCertificate, extends-meta-class=CryptoCertificate
        sdg primitive attribute Path: category=STRING, lower-multiplicity=1, upper-multiplicity=1, gid=iSOFT:ucm:CryptoCertificate:Path

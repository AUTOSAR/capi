AUTOSAR XML (schema 00049)
package /ara/ucm/PersistencyKeyValueDatabaseInterfaces
  persistency key value storage interface SwPackageTransferStatus: minimum-sustained-size=4096, redundancy=REDUNDANT, redundancy-handlings=persistency-redundancy-m-out-of-n={m=3, n=5}, update-strategy=KEEP-EXISTING

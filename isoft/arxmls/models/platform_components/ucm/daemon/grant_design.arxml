AUTOSAR XML (schema 00049)
package /ISOFT/PlatformComponents/ucm
  com offer service grant design ucm_ota_ucmm_offerservicegrantdesign: process-design=package_manager_design, provided-service-port=package_manager_root.PackageManagement
  com find service grant design ucm_sm_findservicegrantdesign: process-design=package_manager_design, required-service-port=package_manager_root.UpdateRequestRPort
  6 x com method grant design:
    ucm_sm_methodgrantdesign1: method=package_manager_root.UpdateRequestRPort.StartUpdateSession
    ucm_sm_methodgrantdesign2: process-design=package_manager_design, method=package_manager_root.UpdateRequestRPort.StopUpdateSession
    ucm_sm_methodgrantdesign3: process-design=package_manager_design, method=package_manager_root.UpdateRequestRPort.ResetMachine
    ucm_sm_methodgrantdesign4: process-design=package_manager_design, method=package_manager_root.UpdateRequestRPort.PrepareUpdate
    ucm_sm_methodgrantdesign5: process-design=package_manager_design, method=package_manager_root.UpdateRequestRPort.VerifyUpdate
    ucm_sm_methodgrantdesign6: method=package_manager_root.UpdateRequestRPort.PrepareRollback

AUTOSAR XML (schema 00049)
package /ISOFT/PlatformComponents/crypto
  sdg def Extension
    sdg-classes:
      sdg class KeySlot: gid=iSOFT:crypto:KeySlot, extends-meta-class=CryptoKeySlot
        sdg primitive attribute FileName: category=STRING, lower-multiplicity=0, upper-multiplicity-infinite=1, gid=iSOFT:crypto:KeySlot:FileName

AUTOSAR XML (schema 00049)
package /ISOFT/PlatformComponents/crypto
  adaptive application sw component type swc_type_crypto
    provide/require port prPort_kvStorage_keySlot: provided-required-interface=cryptod_kvStorage_interface_keySlot
  executable cryptod: category=PLATFORM_LEVEL, build-type=BUILD-TYPE-DEBUG, logging-behavior=USES-LOGGING, minimum-timer-granularity=0.001, reporting-behavior=REPORTS-EXECUTION-STATE, version=1.0.0
    root sw component prototype cryptod_swc_root: application-type=swc_type_crypto
  process design crypto_proc_design: executable=cryptod

AUTOSAR XML (schema 00049)
package /ISOFT/PlatformComponents/crypto
  persistency key value storage interface cryptod_kvStorage_interface_keySlot: minimum-sustained-size=4096, redundancy-handlings=persistency-redundancy-m-out-of-n={m=3, n=5}, update-strategy=KEEP-EXISTING

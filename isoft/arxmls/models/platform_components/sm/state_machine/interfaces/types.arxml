AUTOSAR XML (schema 00049)
package /ara/sm/datatypes/ImplementationDataTypes
  std cpp implementation data type TransitionRequestType: type-emitter=TYPE_EMITTER_ARA, type-reference=uint32_t  # A value which represents the requested state in the StateMachine.
    namespaces:
      symbol props ara
      symbol props sm

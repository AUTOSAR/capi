AUTOSAR XML (schema 00049)
package /ara/sm/Errors
  7 x ap application error, all with error-domain=SM:
    Canceled: error-code=14  # The request was replaced by a newer one and therefore it was cancelled.
    InvalidValue: error-code=10  # The provided value is not mapped to any transition.
    RecoveryTransitionOngoing: error-code=12  # Request will not be carried out, because currently recovery is ongoing.
    TransitionFailed: error-code=13  # During transition to the requested state an error occurred.
    TransitionNotAllowed: error-code=11  # Requested transition is not possible from current StateMachine state.
    InTransitionToSameState: error-code=15  # A transition to the requested state is already ongoing.
    NotWorking: error-code=16  # The StateMachine is not working.

AUTOSAR XML (schema 00049)
package /ara/sm/AAInterfaces
  service interface StateMachineService: major-version=1, minor-version=0
    namespaces:
      symbol props ara
      symbol props sm
    methods:
      operation RequestState: fire-and-forget=false, possible-ap-error=[Canceled, InvalidValue, RecoveryTransitionOngoing, TransitionFailed, TransitionNotAllowed, AlreadyInState, InTransitionToSameState, NotWorking]  # Has to be called by a SMControlApplication to request a change in the referenced StateMachine.
        arg TransitionRequest: type=TransitionRequestType, direction=IN  # Represents the requested state in the StateMachine.

AUTOSAR XML (schema 00049)
package /SomeipDeployments
  someip service interface deployment TriggerOut_StateMachine: service-interface=TriggerOut_StateMachine, service-interface-id=56, service-interface-version={major-version=1, minor-version=0}
    someip field deployment Notifier: field=Notifier
      get Notifier_getter: method-id=17401, transport-protocol=UDP
      notifier Notifier_notifier: event-id=17402, transport-protocol=TCP
    someip method deployment SM_PlaceholderFunction: method=PlaceholderFunction, method-id=17404, transport-protocol=UDP
    someip event group Notifier_eventgroup: event-group-id=17405, event=Notifier_notifier

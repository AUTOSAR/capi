AUTOSAR XML (schema 00049)
package /SomeipDeployments
  someip service interface deployment StateMachineService: service-interface=StateMachineService, service-interface-id=57, service-interface-version={major-version=1, minor-version=0}
    someip method deployment RequestState: method=RequestState, method-id=1901, transport-protocol=UDP

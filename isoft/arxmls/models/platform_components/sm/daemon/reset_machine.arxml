AUTOSAR XML (schema 00049)
package /ResetMachineApp
  process design ResetMachineDesign: executable=ResetMachine
package /ResetMachineApp/exe
  executable ResetMachine: category=APPLICATION_LEVEL, logging-behavior=USES-LOGGING, reporting-behavior=DOES-NOT-REPORT-EXECUTION-STATE
    root sw component prototype client: application-type=ResetMachine
package /ResetMachineApp/swc
  adaptive application sw component type ResetMachine

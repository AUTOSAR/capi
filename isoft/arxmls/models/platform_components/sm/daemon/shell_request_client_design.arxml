AUTOSAR XML (schema 00049)
package /ara/sm_shell_request_client/executables
  executable shell_request_client: category=APPLICATION_LEVEL, logging-behavior=USES-LOGGING, minimum-timer-granularity=1000.0, reporting-behavior=REPORTS-EXECUTION-STATE, version=1.0.0
    root sw component prototype shell_request_client_root: application-type=shell_request_client
package /ara/sm_shell_request_client/processes
  process design shell_request_client_design: executable=shell_request_client
package /ara/sm_shell_request_client/software_components
  adaptive application sw component type shell_request_client
    require port ShellRequestRPort: required-interface=ShellRequest

AUTOSAR XML (schema 00049)
package /ShutdownApp
  process design ShutdownDesign: executable=shutdown
package /ShutdownApp/exe
  executable shutdown: category=APPLICATION_LEVEL, logging-behavior=USES-LOGGING, reporting-behavior=DOES-NOT-REPORT-EXECUTION-STATE
    root sw component prototype client: application-type=Shutdown
package /ShutdownApp/swc
  adaptive application sw component type Shutdown

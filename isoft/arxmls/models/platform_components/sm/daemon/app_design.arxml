AUTOSAR XML (schema 00049)
package /ISOFT/PlatformComponents/sm
  process design state_manager_instance_design: executable=smd
package /ISOFT/PlatformComponents/sm/exe
  executable smd: category=APPLICATION_LEVEL, logging-behavior=USES-LOGGING, minimum-timer-granularity=1000.0, reporting-behavior=REPORTS-EXECUTION-STATE
    root sw component prototype state_manager: application-type=sm
package /ISOFT/PlatformComponents/sm/swc
  adaptive application sw component type sm

AUTOSAR XML (schema 00049)
package /ara/sm/Errors
  14 x ap application error, all with error-domain=SM:
    Rejected: error-code=5  # Requested operation was rejected due to State Managements/machines internal state.
    PrepareFailed: error-code=7  # Preparation step of update failed.
    VerifyFailed: error-code=6  # Verification step of update failed.
    RollbackFailed: error-code=8  # Rollback step of update failed.
    FGNameIllegal: error-code=102  # The name of the function group can't be found.
    FGStateIllegal: error-code=103  # The state of the function group can't be found.
    UpdateSessionIsActive: error-code=104  # There is a update session active.
    FGDeactived: error-code=105  # The function group is deactived.
    AlreadyInState: error-code=106  # The function group/state machine is already in requested state.
    FailedToSetStateFromEM: error-code=107  # Can't SetState From EM successfully.
    TimeOutWhenCalling: error-code=108  # Time out when calling.
    NotFoundNetworkStateService: error-code=109  # Hasn't fount NetworkState service needed yet.
    SMNotFound: error-code=110  # The state machine can't be found.
    SMStateNotFound: error-code=111  # The state machine state can't be found.
package /ara/sm/ErrorDomains
  ap application error domain SM: value=46
    namespaces:
      symbol props ara
      symbol props sm

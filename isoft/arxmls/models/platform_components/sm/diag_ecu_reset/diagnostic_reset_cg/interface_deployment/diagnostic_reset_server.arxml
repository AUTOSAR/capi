AUTOSAR XML (schema 00049)
package /iSOFT/PlatformComponents/sm/SomeipInterfaceDeployments
  someip service interface deployment DiagnosticResetServer: service-interface=DiagnosticResetServer, service-interface-id=44, service-interface-version={major-version=1, minor-version=0}
    someip event deployment response: event=response, event-id=0x0015, transport-protocol=UDP
    someip method deployment broadcast: method=broadcast, method-id=0x002b, transport-protocol=UDP
    someip method deployment listClients: method=listClients, method-id=45, transport-protocol=UDP
    someip method deployment message: method=message, method-id=0x002c, transport-protocol=UDP
    someip event group EventGroupDiagnosticResetServer: event-group-id=0x0391, event=response

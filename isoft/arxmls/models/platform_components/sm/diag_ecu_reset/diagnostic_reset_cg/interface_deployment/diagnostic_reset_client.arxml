AUTOSAR XML (schema 00049)
package /iSOFT/PlatformComponents/sm/SomeipInterfaceDeployments
  someip service interface deployment DiagnosticResetClient: service-interface=DiagnosticResetClient, service-interface-id=43, service-interface-version={major-version=1, minor-version=0}
    someip event deployment response: event=response, event-id=22, transport-protocol=UDP
    someip method deployment message: method=message, method-id=46, transport-protocol=UDP
    someip event group EventGroupDiagnosticResetClient: event-group-id=912, event=response

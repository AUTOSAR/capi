AUTOSAR XML (schema 00049)
package /iSOFT/PlatformComponents/sm/types
  std cpp implementation data type DiagnosticResetMsg: category=STRING, type-emitter=TYPE_EMITTER_ARA
    namespaces:
      symbol props ara
      symbol props sm
  std cpp implementation data type DiagnosticResetRespMsg: type-emitter=TYPE_EMITTER_ARA, type-reference=int32_t
    namespaces:
      symbol props ara
      symbol props sm
  std cpp implementation data type DiagnosticResetResponse: category=STRUCTURE, type-emitter=TYPE_EMITTER_ARA
    namespaces:
      symbol props ara
      symbol props sm
    cpp implementation data type element clientID: type-reference=uint32_t
    cpp implementation data type element respMsg: type-reference={inplace=false, type-reference=DiagnosticResetRespMsg}

AUTOSAR XML (schema 00049)
package /iSOFT/PlatformComponents/sm
  service interface DiagnosticResetClient: category=COMMUNICATION_GROUP_CLIENT, major-version=1, minor-version=0
    namespaces:
      symbol props ara
      symbol props sm
    events:
      data response: type=DiagnosticResetRespMsg
    methods:
      operation message: possible-ap-error=CommunicationGroupNotActive
        arg msg: type=DiagnosticResetMsg, direction=IN

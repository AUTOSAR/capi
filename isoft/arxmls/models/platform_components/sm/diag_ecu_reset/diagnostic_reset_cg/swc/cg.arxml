AUTOSAR XML (schema 00049)
package /ISOFT/PlatformComponents/sm/swc
  adaptive application sw component type sm
    require port CgServerRDiagnosticResetServer: required-interface=DiagnosticResetServer

AUTOSAR XML (schema 00049)
package /ISOFT/PlatformComponents/sm/swc
  adaptive application sw component type sm
    provide port DiagnosticEcuResetPPort: provided-interface=DiagnosticEcuResetInterface
    adaptive swc internal behavior AdaptiveSwcInternalBehavior
      swc service dependency DiagnosticEcuResetDependence: assigned-ports=role-based-port-assignment={port-prototype=DiagnosticEcuResetPPort, role=DiagnosticEcuResetInterface}
        service-needs:
          diagnostic control needs DiagnosticControlNeeds

AUTOSAR XML (schema 00049)
package /ara/sm/DiagnosticPortInterface
  diagnostic ecu reset interface DiagnosticEcuResetInterface

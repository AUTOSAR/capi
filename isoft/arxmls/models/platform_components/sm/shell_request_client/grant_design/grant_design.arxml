AUTOSAR XML (schema 00049)
package /ISOFT/PlatformComponents/shell
  com find service grant design shell_sm_findservicegrantdesign: process-design=shell_request_client_design, required-service-port=shell_request_client_root.ShellRequestRPort
  5 x com method grant design, all with process-design=shell_request_client_design:
    shell_sm_methodgrantdesign1: method=shell_request_client_root.ShellRequestRPort.SetSMState
    shell_sm_methodgrantdesign2: method=shell_request_client_root.ShellRequestRPort.GetSMState
    shell_sm_methodgrantdesign3: method=shell_request_client_root.ShellRequestRPort.SetFGState
    shell_sm_methodgrantdesign4: method=shell_request_client_root.ShellRequestRPort.GetFGState
    shell_sm_methodgrantdesign5: method=shell_request_client_root.ShellRequestRPort.GetAllFunctionGroupsInfo

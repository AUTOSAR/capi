AUTOSAR XML (schema 00049)
package /ara/sm/PersistencyKeyValueDatabaseInterfaces
  persistency key value storage interface UpdateSessionStatus: minimum-sustained-size=4096, redundancy=REDUNDANT, redundancy-handlings=persistency-redundancy-m-out-of-n={m=3, n=5}, update-strategy=KEEP-EXISTING
  persistency key value storage interface CalibrationData: minimum-sustained-size=4096, redundancy=REDUNDANT, redundancy-handlings=persistency-redundancy-m-out-of-n={m=3, n=5}, update-strategy=KEEP-EXISTING

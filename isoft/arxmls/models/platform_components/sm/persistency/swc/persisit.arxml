AUTOSAR XML (schema 00049)
package /ISOFT/PlatformComponents/sm/swc
  adaptive application sw component type sm
    provide/require port CalibrationDataPRPort: provided-required-interface=CalibrationData
    provide/require port UpdateSessionStatusPRPort: provided-required-interface=UpdateSessionStatus

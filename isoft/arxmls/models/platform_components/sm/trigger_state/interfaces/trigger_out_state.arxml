AUTOSAR XML (schema 00049)
package /ara/sm/AAInterfaces
  service interface TriggerOut_State: major-version=1, minor-version=0
    namespaces:
      symbol props ara
      symbol props sm
    field Notifier: type=String, has-getter=true, has-notifier=true, has-setter=false
    methods:
      operation PlaceholderFunction: possible-ap-error=[Rejected, FGNameIllegal, FGStateIllegal, UpdateSessionIsActive, FGDeactived, AlreadyInState]

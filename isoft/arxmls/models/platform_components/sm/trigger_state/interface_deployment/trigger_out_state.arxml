AUTOSAR XML (schema 00049)
package /SomeipDeployments
  someip service interface deployment TriggerOut_State: service-interface=TriggerOut_State, service-interface-id=51, service-interface-version={major-version=1, minor-version=0}
    someip field deployment Notifier: field=Notifier
      get Notifier_getter: method-id=27001, transport-protocol=UDP
      notifier Notifier_notifier: event-id=3601, transport-protocol=TCP
    someip method deployment SM_PlaceholderFunction: method=PlaceholderFunction, method-id=2901, transport-protocol=UDP
    someip event group Notifier_eventgroup: event-group-id=47001, event=Notifier_notifier

AUTOSAR XML (schema 00049)
package /SomeipDeployments
  someip service interface deployment TriggerIn_State: service-interface=TriggerIn_State, service-interface-id=50, service-interface-version={major-version=1, minor-version=0}
    someip field deployment Trigger: field=Trigger
      set Trigger_setter: method-id=16001, transport-protocol=UDP
    someip method deployment SM_PlaceholderFunction: method=PlaceholderFunction, method-id=2801, transport-protocol=UDP

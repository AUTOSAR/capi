AUTOSAR XML (schema 00049)
package /SomeipDeployments
  someip service interface deployment TriggerInOut_State: service-interface=TriggerInOut_State, service-interface-id=52, service-interface-version={major-version=1, minor-version=0}
    someip field deployment Trigger: field=Trigger
      set Trigger_setter: method-id=16002, transport-protocol=UDP
    someip field deployment Notifier: field=Notifier
      get Notifier_getter: method-id=27002, transport-protocol=UDP
      notifier Notifier_notifier: event-id=3602, transport-protocol=TCP
    someip method deployment SM_PlaceholderFunction: method=PlaceholderFunction, method-id=2902, transport-protocol=UDP
    someip event group Notifier_eventgroup: event-group-id=47002, event=Notifier_notifier

AUTOSAR XML (schema 00049)
package /iSOFT/PlatformComponents/sm
  service interface PowerModeServer: category=COMMUNICATION_GROUP_SERVER, major-version=1, minor-version=0
    namespaces:
      symbol props ara
      symbol props sm
    events:
      data response: type=PowerModeResponse
    methods:
      operation broadcast: possible-ap-error=[CommunicationGroupNotActive, NoClients]
        arg msg: type=PowerModeMsg, direction=IN
      operation listClients: possible-ap-error=[CommunicationGroupNotActive, NoClients]
        arg clients: type=clients, direction=OUT
      operation message: possible-ap-error=[CommunicationGroupNotActive, NoClients, WrongClientAddress]
        arg clientID: type=uint32_t, direction=IN
        arg msg: type=PowerModeMsg, direction=IN

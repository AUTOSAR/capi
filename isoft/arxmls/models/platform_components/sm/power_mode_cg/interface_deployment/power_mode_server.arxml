AUTOSAR XML (schema 00049)
package /iSOFT/PlatformComponents/sm/SomeipInterfaceDeployments
  someip service interface deployment PowerModeServer: service-interface=PowerModeServer, service-interface-id=42, service-interface-version={major-version=1, minor-version=0}
    someip event deployment response: event=response, event-id=0x000b, transport-protocol=UDP
    someip method deployment broadcast: method=broadcast, method-id=0x0015, transport-protocol=UDP
    someip method deployment listClients: method=listClients, method-id=23, transport-protocol=UDP
    someip method deployment message: method=message, method-id=0x0016, transport-protocol=UDP
    someip event group EventGroupPowerModeServer: event-group-id=0x038f, event=response

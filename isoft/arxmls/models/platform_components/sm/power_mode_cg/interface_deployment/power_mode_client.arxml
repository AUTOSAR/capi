AUTOSAR XML (schema 00049)
package /iSOFT/PlatformComponents/sm/SomeipInterfaceDeployments
  someip service interface deployment PowerModeClient: service-interface=PowerModeClient, service-interface-id=41, service-interface-version={major-version=1, minor-version=0}
    someip event deployment response: event=response, event-id=12, transport-protocol=UDP
    someip method deployment message: method=message, method-id=31, transport-protocol=UDP
    someip event group EventGroupPowerModeClient: event-group-id=912, event=response

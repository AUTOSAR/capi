AUTOSAR XML (schema 00049)
package /ISOFT/PlatformComponents/sm
  com field grant design sm_nm_field_currentfieldgrantdesign: process-design=state_manager_instance_design, field=state_manager.NetworkState_ln1.NetworkCurrentState, role=GETTER
  com field grant design sm_nm_fieldrequeststategrantdesign: process-design=state_manager_instance_design, field=state_manager.NetworkState_ln1.NetworkRequestedState, role=GETTER
  com find service grant design sm_nm_findservicegrantdesign: process-design=state_manager_instance_design, required-service-port=state_manager.NetworkState_ln1

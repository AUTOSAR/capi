AUTOSAR XML (schema 00049)
package /ISOFT/FunctionGroups
  mode declaration group NMDemoFG: initial-mode=Off
    mode Off
    mode Startup
    mode Verify

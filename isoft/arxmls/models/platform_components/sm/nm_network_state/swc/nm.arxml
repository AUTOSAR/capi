AUTOSAR XML (schema 00049)
package /ISOFT/PlatformComponents/sm/swc
  adaptive application sw component type sm
    require port NetworkState_ln1: required-interface=NetworkState

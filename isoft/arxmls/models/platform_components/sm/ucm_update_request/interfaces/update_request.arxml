AUTOSAR XML (schema 00049)
package /ara/sm/UCMManager
  service interface UpdateRequest: major-version=1, minor-version=0
    namespaces:
      symbol props ara
      symbol props sm
    methods:
      6 x operation:
        ResetMachine: possible-ap-error=Rejected
        StartUpdateSession: possible-ap-error=Rejected
        PrepareUpdate: fire-and-forget=false, possible-ap-error=[Rejected, PrepareFailed]
          arg FunctionGroupList: type=FunctionGroupList, direction=IN
        VerifyUpdate: fire-and-forget=false, possible-ap-error=[Rejected, VerifyFailed]
          arg FunctionGroupList: type=FunctionGroupList, direction=IN
        PrepareRollback: fire-and-forget=false, possible-ap-error=[Rejected, RollbackFailed]
          arg FunctionGroupList: type=FunctionGroupList, direction=IN
        StopUpdateSession: fire-and-forget=true

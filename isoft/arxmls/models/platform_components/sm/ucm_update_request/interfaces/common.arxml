AUTOSAR XML (schema 00049)
package /ISOFT/SMTypes
  std cpp implementation data type FGNameType: category=STRING, type-emitter=TYPE_EMITTER_ARA  # full qualified FunctionGroup shortName.
    namespaces:
      symbol props ara
      symbol props sm
      symbol props updaterequest
  std cpp implementation data type FunctionGroupList: category=VECTOR, cpp-template-argument=FGNameType, type-emitter=TYPE_EMITTER_ARA  # A list of FunctionGroups
    namespaces:
      symbol props ara
      symbol props sm
      symbol props updaterequest

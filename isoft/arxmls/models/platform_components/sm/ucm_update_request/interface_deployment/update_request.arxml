AUTOSAR XML (schema 00049)
package /SomeipDeployments
  someip service interface deployment SSC_UpdateRequest: service-interface=UpdateRequest, service-interface-id=40, service-interface-version={major-version=1, minor-version=0}
    6 x someip method deployment, all with transport-protocol=UDP:
      SM_ResetMachine: method=ResetMachine, method-id=1801
      SM_StartUpdateSession: method=StartUpdateSession, method-id=1802
      SM_PrepareUpdate: method=PrepareUpdate, method-id=1803
      SM_VerifyUpdate: method=VerifyUpdate, method-id=1804
      SM_PrepareRollback: method=PrepareRollback, method-id=1806
      SM_StopUpdateSession: method=StopUpdateSession, method-id=1805

AUTOSAR XML (schema 00049)
package /SomeipDeployments
  someip service interface deployment TriggerIn_FunctionGroup: service-interface=TriggerIn_FunctionGroup, service-interface-id=53, service-interface-version={major-version=1, minor-version=0}
    someip field deployment Trigger: field=Trigger
      set Trigger_setter: method-id=17101, transport-protocol=UDP
    someip method deployment SM_PlaceholderFunction: method=PlaceholderFunction, method-id=17102, transport-protocol=UDP

AUTOSAR XML (schema 00049)
package /SomeipDeployments
  someip service interface deployment TriggerInOut_FunctionGroup: service-interface=TriggerInOut_FunctionGroup, service-interface-id=55, service-interface-version={major-version=1, minor-version=0}
    someip field deployment Trigger: field=Trigger
      set Trigger_setter: method-id=17201, transport-protocol=UDP
    someip field deployment Notifier: field=Notifier
      get Notifier_getter: method-id=17202, transport-protocol=UDP
      notifier Notifier_notifier: event-id=17203, transport-protocol=TCP
    someip method deployment SM_PlaceholderFunction: method=PlaceholderFunction, method-id=17204, transport-protocol=UDP
    someip event group Notifier_eventgroup: event-group-id=17205, event=Notifier_notifier

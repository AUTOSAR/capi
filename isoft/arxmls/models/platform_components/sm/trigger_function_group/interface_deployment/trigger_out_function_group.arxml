AUTOSAR XML (schema 00049)
package /SomeipDeployments
  someip service interface deployment TriggerOut_FunctionGroup: service-interface=TriggerOut_FunctionGroup, service-interface-id=54, service-interface-version={major-version=1, minor-version=0}
    someip field deployment Notifier: field=Notifier
      get Notifier_getter: method-id=17301, transport-protocol=UDP
      notifier Notifier_notifier: event-id=17302, transport-protocol=TCP
    someip method deployment SM_PlaceholderFunction: method=PlaceholderFunction, method-id=17304, transport-protocol=UDP
    someip event group Notifier_eventgroup: event-group-id=17305, event=Notifier_notifier

AUTOSAR XML (schema 00049)
package /SomeipDeployments
  someip service interface deployment SSC_ShellRequest: service-interface=ShellRequest, service-interface-id=120, service-interface-version={major-version=1, minor-version=0}
    someip event deployment SM_NotifyStateMachineStateChanged: event=NotifyStateMachineStateChanged, event-id=0x4021, transport-protocol=UDP
    5 x someip method deployment, all with transport-protocol=UDP:
      SM_SetSMState: method=SetSMState, method-id=2001
      SM_SetFGState: method=SetFGState, method-id=2002
      SM_GetSMState: method=GetSMState, method-id=2003
      SM_GetFGState: method=GetFGState, method-id=2004
      SM_GetAllFunctionGroupsInfo: method=GetAllFunctionGroupsInfo, method-id=2005
    someip event group SM_NotifyStateMachineStateChangedGroup: event-group-id=4, event=SM_NotifyStateMachineStateChanged

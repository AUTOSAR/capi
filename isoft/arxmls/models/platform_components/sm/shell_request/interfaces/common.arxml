AUTOSAR XML (schema 00049)
package /ISOFT/SMTypes
  9 x std cpp implementation data type, all with type-emitter=TYPE_EMITTER_ARA:
    smCurrentStateInfo: category=STRUCTURE  # current State info about a StateMachine.
      namespaces:
        symbol props ara
        symbol props sm
      cpp implementation data type element smFQN: type-reference=String
      cpp implementation data type element smCurrentState: type-reference=String
    StateMachineInfo: category=STRUCTURE  # FQN and current state of a StateMachine.
      namespaces:
        symbol props ara
        symbol props sm
      cpp implementation data type element smFQN: type-reference=String
      cpp implementation data type element smState: type-reference=String
    FunctionGroupInfo: category=STRUCTURE  # all infos about a FunctionGroup.
      namespaces:
        symbol props ara
        symbol props sm
      cpp implementation data type element fgFQN: type-reference=String
      cpp implementation data type element fgStateList: type-reference=StateList
    TransitionItem: category=STRUCTURE  # all infos about a TransitionItem.
      namespaces:
        symbol props ara
        symbol props sm
      cpp implementation data type element requestID: type-reference=uint32_t
      cpp implementation data type element currentSmState: type-reference=String
      cpp implementation data type element nextSmState: type-reference=String
    FunctionGroupsInfo: category=STRUCTURE  # all infos about a set of FunctionGroups.
      namespaces:
        symbol props ara
        symbol props sm
      5 x cpp implementation data type element:
        managedBySm: type-reference=bool
        smFQN: type-reference=String
        smStateList: type-reference=StateList
        fgInfoList: type-reference=FGInfoList
        transitionList: type-reference=TransitionList
    FunctionGroupsInfoList: category=VECTOR, cpp-template-argument=FunctionGroupsInfo  # A list of FunctionGroupsInfo
      namespaces:
        symbol props ara
        symbol props sm
    StateList: category=VECTOR, cpp-template-argument=String  # A list of StateMachine State or FunctionGroup State
      namespaces:
        symbol props ara
        symbol props sm
    FGInfoList: category=VECTOR, cpp-template-argument=FunctionGroupInfo  # A list of FunctionGroupInfo
      namespaces:
        symbol props ara
        symbol props sm
    TransitionList: category=VECTOR, cpp-template-argument=TransitionItem  # A list of TransitionItem
      namespaces:
        symbol props ara
        symbol props sm

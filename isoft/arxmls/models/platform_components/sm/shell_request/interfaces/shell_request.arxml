AUTOSAR XML (schema 00049)
package /ara/sm/ShellManager
  service interface ShellRequest: major-version=1, minor-version=0
    namespaces:
      symbol props ara
      symbol props sm
    events:
      data NotifyStateMachineStateChanged: type=StateMachineInfo
    methods:
      5 x operation, all with fire-and-forget=false:
        SetSMState: possible-ap-error=[FailedToSetStateFromEM, SMNotFound, SMStateNotFound, Rejected, Canceled, InvalidValue, RecoveryTransitionOngoing, TransitionFailed, TransitionNotAllowed, AlreadyInState, InTransitionToSameState, NotWorking]
          arg SMName: type=String, direction=IN
          arg SMStateRequest: type=uint32_t, direction=IN
        SetFGState: possible-ap-error=[FGNameIllegal, FGStateIllegal, UpdateSessionIsActive, FGDeactived, FailedToSetStateFromEM, NotFoundNetworkStateService, SMNotFound, SMStateNotFound, Rejected, Canceled, RecoveryTransitionOngoing, TransitionFailed, TransitionNotAllowed, AlreadyInState, InTransitionToSameState, NotWorking]
          arg FGName: type=String, direction=IN
          arg FGState: type=String, direction=IN
        GetSMState: possible-ap-error=[SMNotFound, Rejected]
          arg SMName: type=String, direction=IN
          arg SMState: type=String, direction=OUT
        GetFGState: possible-ap-error=[FGNameIllegal, FGDeactived, Rejected]
          arg FGName: type=String, direction=IN
          arg FGState: type=String, direction=OUT
        GetAllFunctionGroupsInfo: possible-ap-error=Rejected
          arg infos: type=FunctionGroupsInfoList, direction=OUT

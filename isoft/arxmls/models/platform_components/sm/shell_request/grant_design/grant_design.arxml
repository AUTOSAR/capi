AUTOSAR XML (schema 00049)
package /ISOFT/PlatformComponents/sm
  com offer service grant design sm_shell_offerservicegrantdesign: process-design=state_manager_instance_design, provided-service-port=state_manager.ShellRequest

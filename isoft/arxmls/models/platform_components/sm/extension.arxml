AUTOSAR XML (schema 00049)
package /ISOFT/PlatformComponents/sm
  sdg def Extension
    sdg-classes:
      12 x sdg class:
        ARPackage: category=ISOFT_EXTENSION, gid=iSOFT:sm:NmHandleToFunctionGroupStateMapping, extends-meta-class=ARPackage
          attributes:
            sdg aggregation with variation NmHandleToFunctionGroupStateMappingSubclass: lower-multiplicity=0, upper-multiplicity=1, gid=iSOFT:sm:NmHandleToFunctionGroupStateMappingSubclass:Attributes, variation=false, sub-sdg=NmHandleToFunctionGroupStateMappingAttributes
        NmHandleToFunctionGroupStateMappingAttributes: gid=iSOFT:sm:NmHandleToFunctionGroupStateMappingAttributes
          attributes:
            sdg primitive attribute Type: category=ENUMERATION, lower-multiplicity=1, upper-multiplicity=1, gid=iSOFT:sm:NmHandleToFunctionGroupStateMappingSubclass:Type, pattern=functionGroupStateToNmHandle|nmHandleActiveToFunctionGroupState|nmHandleInactiveToFunctionGroupState
            sdg foreign reference NmHandle: lower-multiplicity=0, upper-multiplicity=1, gid=iSOFT:sm:NmHandleToFunctionGroupStateMappingSubclass:NmHandle, dest-meta-class=NmNetworkHandle
            sdg aggregation with variation FunctionGroup: lower-multiplicity=0, upper-multiplicity-infinite=true, gid=iSOFT:sm:NmHandleToFunctionGroupStateMappingSubclass:FunctionGroup, variation=false, sub-sdg=FunctionGroupInformation
        FunctionGroupInformation: gid=iSOFT:sm:FunctionGroupInformation
          attributes:
            sdg foreign reference ContextModeDeclarationGroupPrototype: lower-multiplicity=0, upper-multiplicity=1, gid=iSOFT:sm:NmHandleToFunctionGroupStateMappingSubclass:ContextModeDeclarationGroupPrototype, dest-meta-class=ModeDeclarationGroupPrototype
            sdg foreign reference TargetModeDeclaration: lower-multiplicity=0, upper-multiplicity=1, gid=iSOFT:sm:NmHandleToFunctionGroupStateMappingSubclass:TargetModeDeclaration, dest-meta-class=ModeDeclaration
        NmHandleToFunctionGroupStateTimeControl: gid=iSOFT:sm:NmHandleToFunctionGroupStateTimeControl, extends-meta-class=Machine
          sdg primitive attribute FGOffTime: category=FLOAT, lower-multiplicity=1, upper-multiplicity=1, gid=iSOFT:sm:NmHandleToFunctionGroupStateTimeControl:FGOffTime
          sdg primitive attribute NetworkOffTime: category=FLOAT, lower-multiplicity=1, upper-multiplicity=1, gid=iSOFT:sm:NmHandleToFunctionGroupStateTimeControl:NetworkOffTime
        GenericModuleInstantiation: category=ISOFT_EXTENSION, gid=iSOFT:sm:GenericModuleInstantiation, extends-meta-class=GenericModuleInstantiation
          attributes:
            4 x sdg aggregation with variation, all with lower-multiplicity=0, upper-multiplicity-infinite=true, variation=false:
              FGServerInstanceConfig: gid=iSOFT:sm:GenericModuleInstantiation:FGServerInstanceConfig, sub-sdg=FGServerInstanceConfigDefinition
              Notification: gid=iSOFT:sm:GenericModuleInstantiation:Notification, sub-sdg=StateManagementStateNotification
              ActionItemList: gid=iSOFT:sm:GenericModuleInstantiation:ActionItemList, sub-sdg=StateManagementActionList
              Request: gid=iSOFT:sm:GenericModuleInstantiation:Request, sub-sdg=StateManagementStateRequest
        FGServerInstanceConfigDefinition: category=ISOFT_EXTENSION
          attributes:
            sdg foreign reference FunctionGroup: lower-multiplicity=1, upper-multiplicity=1, gid=iSOFT:sm:FGServerInstanceConfigDefinition:FunctionGroup, dest-meta-class=ModeDeclarationGroupPrototype
            sdg primitive attribute TriggerInIdentifier: category=INTEGER, lower-multiplicity=0, upper-multiplicity=1, gid=iSOFT:sm:FGServerInstanceConfigDefinition:TriggerInIdentifier, max=65534, min=1
            sdg foreign reference TriggerInSomeipSdServerServiceInstanceConfig: lower-multiplicity=0, upper-multiplicity=1, gid=iSOFT:sm:FGServerInstanceConfigDefinition:TriggerInSomeipSdServerServiceInstanceConfig, dest-meta-class=SomeipSdServerServiceInstanceConfig
            sdg foreign reference TriggerInConnector: lower-multiplicity=0, upper-multiplicity=1, gid=iSOFT:sm:FGServerInstanceConfigDefinition:TriggerInConnector, dest-meta-class=CommunicationConnector
            sdg primitive attribute TriggerInPort: category=INTEGER, lower-multiplicity=0, upper-multiplicity=1, gid=iSOFT:sm:FGServerInstanceConfigDefinition:TriggerInPort, max=65534, min=1
            sdg primitive attribute TriggerInOutIdentifier: category=INTEGER, lower-multiplicity=0, upper-multiplicity=1, gid=iSOFT:sm:FGServerInstanceConfigDefinition:TriggerInOutIdentifier, max=65534, min=1
            sdg foreign reference TriggerInOutSomeipSdServerServiceInstanceConfig: lower-multiplicity=0, upper-multiplicity=1, gid=iSOFT:sm:FGServerInstanceConfigDefinition:TriggerInOutSomeipSdServerServiceInstanceConfig, dest-meta-class=SomeipSdServerServiceInstanceConfig
            sdg foreign reference TriggerInOutConnector: lower-multiplicity=0, upper-multiplicity=1, gid=iSOFT:sm:FGServerInstanceConfigDefinition:TriggerInOutConnector, dest-meta-class=CommunicationConnector
            sdg primitive attribute TriggerInOutPort: category=INTEGER, lower-multiplicity=0, upper-multiplicity=1, gid=iSOFT:sm:FGServerInstanceConfigDefinition:TriggerInOutPort, max=65534, min=1
            sdg primitive attribute TriggerOutIdentifier: category=INTEGER, lower-multiplicity=0, upper-multiplicity=1, gid=iSOFT:sm:FGServerInstanceConfigDefinition:TriggerOutIdentifier, max=65534, min=1
            sdg foreign reference TriggerOutSomeipSdServerServiceInstanceConfig: lower-multiplicity=0, upper-multiplicity=1, gid=iSOFT:sm:FGServerInstanceConfigDefinition:TriggerOutSomeipSdServerServiceInstanceConfig, dest-meta-class=SomeipSdServerServiceInstanceConfig
            sdg foreign reference TriggerOutConnector: lower-multiplicity=0, upper-multiplicity=1, gid=iSOFT:sm:FGServerInstanceConfigDefinition:TriggerOutConnector, dest-meta-class=CommunicationConnector
            sdg primitive attribute TriggerOutPort: category=INTEGER, lower-multiplicity=0, upper-multiplicity=1, gid=iSOFT:sm:FGServerInstanceConfigDefinition:TriggerOutPort, max=65534, min=1
        StateManagementStateNotification: category=ISOFT_EXTENSION, caption=true
          attributes:
            sdg primitive attribute TriggerOutIdentifier: category=INTEGER, lower-multiplicity=1, upper-multiplicity=1, gid=iSOFT:sm:StateManagementStateNotification:TriggerOutIdentifier, max=65534, min=1
            sdg foreign reference TriggerOutSomeipSdServerServiceInstanceConfig: lower-multiplicity=1, upper-multiplicity=1, gid=iSOFT:sm:StateManagementStateNotification:TriggerOutSomeipSdServerServiceInstanceConfig, dest-meta-class=SomeipSdServerServiceInstanceConfig
            sdg foreign reference TriggerOutConnector: lower-multiplicity=1, upper-multiplicity=1, gid=iSOFT:sm:StateManagementStateNotification:TriggerOutConnector, dest-meta-class=CommunicationConnector
            sdg primitive attribute TriggerOutPort: category=INTEGER, lower-multiplicity=1, upper-multiplicity=1, gid=iSOFT:sm:StateManagementStateNotification:TriggerOutPort, max=65534, min=1
            sdg aggregation with variation StateMachine: lower-multiplicity=1, upper-multiplicity=1, gid=iSOFT:sm:StateManagementStateNotification:StateMachine, variation=false, sub-sdg=StateMachine
            sdg primitive attribute StateMachineIdentifier: category=INTEGER, lower-multiplicity=0, upper-multiplicity=1, gid=iSOFT:sm:StateManagementStateNotification:StateMachineIdentifier, max=65534, min=1
            sdg foreign reference StateMachineSomeipSdServerServiceInstanceConfig: lower-multiplicity=0, upper-multiplicity=1, gid=iSOFT:sm:StateManagementStateNotification:StateMachineSomeipSdServerServiceInstanceConfig, dest-meta-class=SomeipSdServerServiceInstanceConfig
            sdg foreign reference StateMachineConnector: lower-multiplicity=0, upper-multiplicity=1, gid=iSOFT:sm:StateManagementStateNotification:StateMachineConnector, dest-meta-class=CommunicationConnector
            sdg primitive attribute StateMachinePort: category=INTEGER, lower-multiplicity=0, upper-multiplicity=1, gid=iSOFT:sm:StateManagementStateNotification:StateMachinePort, max=65534, min=1
        StateMachine: category=ISOFT_EXTENSION, caption=true
          attributes:
            sdg foreign reference StateMachine: lower-multiplicity=1, upper-multiplicity=1, gid=iSOFT:sm:StateMachine, dest-meta-class=ModeDeclarationGroup
        StateManagementActionList: category=ISOFT_EXTENSION, caption=true
          attributes:
            sdg aggregation with variation ActionItem: lower-multiplicity=0, upper-multiplicity-infinite=true, gid=iSOFT:sm:StateManagementActionList:ActionItem, variation=false, sub-sdg=StateManagementActionItem
            sdg reference ContextStateMachine: lower-multiplicity=1, upper-multiplicity=1, dest-sdg=StateMachine
            sdg foreign reference AffectedState: lower-multiplicity=1, upper-multiplicity=1, gid=iSOFT:sm:StateManagementActionList:AffectedState, dest-meta-class=ModeDeclaration
        StateManagementActionItem: category=ISOFT_EXTENSION
          attributes:
            sdg primitive attribute ItemType: category=ENUMERATION, lower-multiplicity=1, upper-multiplicity=1, gid=iSOFT:sm:StateManagementActionItem:ItemType, pattern=SetFunctionGroupState|Sync
            sdg foreign reference ContextModeDeclarationGroupPrototype: lower-multiplicity=0, upper-multiplicity=1, gid=iSOFT:sm:StateManagementActionItem:SetFunctionGroupStateContextModeDeclarationGroupPrototype, dest-meta-class=ModeDeclarationGroupPrototype
            sdg foreign reference TargetModeDeclaration: lower-multiplicity=0, upper-multiplicity=1, gid=iSOFT:sm:StateManagementActionItem:SetFunctionGroupStateTargetModeDeclaration, dest-meta-class=ModeDeclaration
        StateManagementStateRequest: category=ISOFT_EXTENSION
          attributes:
            sdg primitive attribute RequestType: category=ENUMERATION, lower-multiplicity=1, upper-multiplicity=1, gid=iSOFT:sm:StateManagementStateRequest:RequestType, pattern=RequestTrigger|RequestError
            sdg aggregation with variation Rule: lower-multiplicity=0, upper-multiplicity-infinite=true, gid=iSOFT:sm:StateManagementStateRequest:Rule, variation=false, sub-sdg=StateManagementRequestRule
        StateManagementRequestRule: category=ISOFT_EXTENSION
          attributes:
            sdg reference ContextStateMachine: lower-multiplicity=1, upper-multiplicity=1, dest-sdg=StateMachine
            sdg foreign reference AssumedCurrentState: lower-multiplicity=0, upper-multiplicity=1, gid=iSOFT:sm:StateManagementRequestRule:AssumedCurrentState, dest-meta-class=ModeDeclaration
            sdg primitive attribute CompareValue: category=STRING, lower-multiplicity=1, upper-multiplicity=1, gid=iSOFT:sm:StateManagementRequestRule:CompareValue, pattern=[1-9][0-9]*|0|ANY
            sdg foreign reference NextState: lower-multiplicity=1, upper-multiplicity=1, gid=iSOFT:sm:StateManagementRequestRule:NextState, dest-meta-class=ModeDeclaration

AUTOSAR XML (schema 00049)
package /ISOFT/PlatformComponents/diag/AdaptiveApplicationSwComponentType
  adaptive application sw component type doipd
package /ISOFT/PlatformComponents/diag/Executable
  executable doipd: category=PLATFORM_LEVEL, logging-behavior=USES-LOGGING, reporting-behavior=REPORTS-EXECUTION-STATE
    root sw component prototype root: application-type=doipd
package /ISOFT/PlatformComponents/diag/ProcessDesign
  process design doipd: executable=doipd

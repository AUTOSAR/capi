AUTOSAR XML (schema 00049)
package /ISOFT/PlatformComponents/diag
  sdg def Extension
    sdg-classes:
      39 x sdg class, all with category=ISOFT_EXTENSION:
        Aging: gid=iSOFT:diag:Aging, extends-meta-class=DiagnosticAging
          sdg primitive attribute Count: category=ENUMERATION, lower-multiplicity=1, upper-multiplicity=1, gid=iSOFT:diag:Aging:Direction, pattern=UP|DOWN
        AuthTransmitCertificateEvaluation: gid=iSOFT:diag:AuthTransmitCertificateEvaluation
          sdg primitive attribute function: category=STRING, lower-multiplicity=1, upper-multiplicity=1, gid=iSOFT:diag:AuthTransmitCertificateEvaluation::function
          sdg primitive attribute evaluationId: category=INTEGER, lower-multiplicity=1, upper-multiplicity=1, gid=iSOFT:diag:AuthTransmitCertificateEvaluation::evaluationId
        AuthenticationEnabled: gid=iSOFT:diag:DiagnosticAccessPermission, extends-meta-class=DiagnosticAccessPermission
          attributes:
            sdg reference Role: upper-multiplicity-infinite=true, dest-sdg=DiagnosticRole
        AuthenticationServiceClass: gid=iSOFT:diag:DiagnosticCustomServiceClass, extends-meta-class=DiagnosticCustomServiceClass
          attributes:
            sdg aggregation with variation diagnosticRole: lower-multiplicity=0, upper-multiplicity-infinite=true, gid=iSOFT:diag:DiagnosticCustomServiceClass::diagnosticRole, sub-sdg=DiagnosticRole
            sdg aggregation with variation certificateEvaluation: lower-multiplicity=0, upper-multiplicity-infinite=true, gid=iSOFT:diag:DiagnosticCustomServiceClass::certificateEvaluation, sub-sdg=AuthTransmitCertificateEvaluation
        ContributionSet: gid=iSOFT:diag:DiagnosticContributionSet, extends-meta-class=DiagnosticContributionSet
          attributes:
            sdg aggregation with variation externalAuthentication: lower-multiplicity=0, upper-multiplicity-infinite=true, gid=iSOFT:diag:DiagnosticContributionSet:externalAuthentication, sub-sdg=ExternalAuthenticationIdentification
            sdg primitive attribute authenticationTimeout: category=INTEGER, lower-multiplicity=1, upper-multiplicity=1, gid=iSOFT:diag:DiagnosticContributionSet:authenticationTimeout
            sdg primitive attribute P4Server_max_0x3E: category=INTEGER, lower-multiplicity=0, upper-multiplicity=1, gid=iSOFT:diag:DiagnosticContributionSet:P4Server_max_0x3E
        DiagnosticAuthRoleProxy: gid=iSOFT:diag:DiagnosticAuthRoleProxy
          attributes:
            sdg reference Role: upper-multiplicity=1, dest-sdg=DiagnosticRole
        DiagnosticClearDiagnosticInformationClassExtension: gid=iSOFT:diag:DiagnosticClearDiagnosticInformationClassExtension, extends-meta-class=DiagnosticClearDiagnosticInformationClass
          sdg primitive attribute P4Server_max: category=INTEGER, lower-multiplicity=0, upper-multiplicity=1, gid=iSOFT:diag:DiagnosticClearDiagnosticInformationClassExtension:P4Server_max
        DiagnosticComControlClassExtension: gid=iSOFT:diag:DiagnosticComControlClassExtension, extends-meta-class=DiagnosticComControlClass
          sdg primitive attribute P4Server_max: category=INTEGER, lower-multiplicity=0, upper-multiplicity=1, gid=iSOFT:diag:DiagnosticComControlClassExtension:P4Server_max
        DiagnosticControlDTCSettingClassExtension: gid=iSOFT:diag:DiagnosticControlDTCSettingClassExtension, extends-meta-class=DiagnosticControlDTCSettingClass
          sdg primitive attribute P4Server_max: category=INTEGER, lower-multiplicity=0, upper-multiplicity=1, gid=iSOFT:diag:DiagnosticControlDTCSettingClassExtension:P4Server_max
        DiagnosticCustomServiceClassExtension: gid=iSOFT:diag:DiagnosticCustomServiceClassExtension, extends-meta-class=DiagnosticCustomServiceClass
          sdg primitive attribute P4Server_max: category=INTEGER, lower-multiplicity=0, upper-multiplicity=1, gid=iSOFT:diag:DiagnosticCustomServiceClassExtension:P4Server_max
        DiagnosticDynamicallyDefineDataIdentifierClassExtension: gid=iSOFT:diag:DiagnosticDynamicallyDefineDataIdentifierClassExtension, extends-meta-class=DiagnosticDynamicallyDefineDataIdentifierClass
          sdg primitive attribute P4Server_max: category=INTEGER, lower-multiplicity=0, upper-multiplicity=1, gid=iSOFT:diag:DiagnosticDynamicallyDefineDataIdentifierClassExtension:P4Server_max
        DiagnosticEcuResetClassExtension: gid=iSOFT:diag:DiagnosticEcuResetClassExtension, extends-meta-class=DiagnosticEcuResetClass
          sdg primitive attribute P4Server_max: category=INTEGER, lower-multiplicity=0, upper-multiplicity=1, gid=iSOFT:diag:DiagnosticEcuResetClassExtension:P4Server_max
        DiagnosticReadDTCInformationClassExtension: gid=iSOFT:diag:DiagnosticReadDTCInformationClassExtension, extends-meta-class=DiagnosticReadDTCInformationClass
          sdg primitive attribute P4Server_max: category=INTEGER, lower-multiplicity=0, upper-multiplicity=1, gid=iSOFT:diag:DiagnosticReadDTCInformationClassExtension:P4Server_max
        DiagnosticReadDataByIdentifierClassExtension: gid=iSOFT:diag:DiagnosticReadDataByIdentifierClassExtension, extends-meta-class=DiagnosticReadDataByIdentifierClass
          sdg primitive attribute P4Server_max: category=INTEGER, lower-multiplicity=0, upper-multiplicity=1, gid=iSOFT:diag:DiagnosticReadDataByIdentifierClassExtension:P4Server_max
        DiagnosticReadDataByPeriodicIdentifierClassExtension: gid=iSOFT:diag:DiagnosticReadDataByPeriodicIdentifierClassExtension, extends-meta-class=DiagnosticReadDataByPeriodicIdentifierClass
          sdg primitive attribute P4Server_max: category=INTEGER, lower-multiplicity=0, upper-multiplicity=1, gid=iSOFT:diag:DiagnosticReadDataByPeriodicIdentifierClassExtension:P4Server_max
        DiagnosticRequestDownloadClassExtension: gid=iSOFT:diag:DiagnosticRequestDownloadClassExtension, extends-meta-class=DiagnosticRequestDownloadClass
          sdg primitive attribute P4Server_max: category=INTEGER, lower-multiplicity=0, upper-multiplicity=1, gid=iSOFT:diag:DiagnosticRequestDownloadClassExtension:P4Server_max
          sdg primitive attribute P4Server_max_0x36: category=INTEGER, lower-multiplicity=0, upper-multiplicity=1, gid=iSOFT:diag:DiagnosticRequestDownloadClassExtension:P4Server_max_0x36
          sdg primitive attribute P4Server_max_0x37: category=INTEGER, lower-multiplicity=0, upper-multiplicity=1, gid=iSOFT:diag:DiagnosticRequestDownloadClassExtension:P4Server_max_0x37
        DiagnosticRequestFileTransferClassExtension: gid=iSOFT:diag:DiagnosticRequestFileTransferClassExtension, extends-meta-class=DiagnosticRequestFileTransferClass
          sdg primitive attribute P4Server_max: category=INTEGER, lower-multiplicity=0, upper-multiplicity=1, gid=iSOFT:diag:DiagnosticRequestFileTransferClassExtension:P4Server_max
          sdg primitive attribute P4Server_max_0x36: category=INTEGER, lower-multiplicity=0, upper-multiplicity=1, gid=iSOFT:diag:DiagnosticRequestFileTransferClassExtension:P4Server_max_0x36
          sdg primitive attribute P4Server_max_0x37: category=INTEGER, lower-multiplicity=0, upper-multiplicity=1, gid=iSOFT:diag:DiagnosticRequestFileTransferClassExtension:P4Server_max_0x37
        DiagnosticRequestRoutineResultsExtension: gid=iSOFT:diag:DiagnosticRequestRoutineResultsExtension, extends-meta-class=DiagnosticRequestRoutineResults
          sdg primitive attribute P4Server_max: category=INTEGER, lower-multiplicity=0, upper-multiplicity=1, gid=iSOFT:diag:DiagnosticRequestRoutineResultsExtension:P4Server_max
        DiagnosticRequestUploadClassExtension: gid=iSOFT:diag:DiagnosticRequestUploadClassExtension, extends-meta-class=DiagnosticRequestUploadClass
          sdg primitive attribute P4Server_max: category=INTEGER, lower-multiplicity=0, upper-multiplicity=1, gid=iSOFT:diag:DiagnosticRequestUploadClassExtension:P4Server_max
          sdg primitive attribute P4Server_max_0x36: category=INTEGER, lower-multiplicity=0, upper-multiplicity=1, gid=iSOFT:diag:DiagnosticRequestUploadClassExtension:P4Server_max_0x36
          sdg primitive attribute P4Server_max_0x37: category=INTEGER, lower-multiplicity=0, upper-multiplicity=1, gid=iSOFT:diag:DiagnosticRequestUploadClassExtension:P4Server_max_0x37
        DiagnosticResponseOnEventClassExtension: gid=iSOFT:diag:DiagnosticResponseOnEventClassExtension, extends-meta-class=DiagnosticResponseOnEventClass
          sdg primitive attribute P4Server_max: category=INTEGER, lower-multiplicity=0, upper-multiplicity=1, gid=iSOFT:diag:DiagnosticResponseOnEventClassExtension:P4Server_max
        DiagnosticRole: gid=iSOFT:diag:DiagnosticRole, caption=true
          sdg primitive attribute isDefault: category=STRING, lower-multiplicity=1, upper-multiplicity=1, gid=iSOFT:diag:DiagnosticRole::isDefault, pattern=true|false
          sdg primitive attribute bitPosition: category=INTEGER, lower-multiplicity=1, upper-multiplicity=1, gid=iSOFT:diag:DiagnosticRole::bitPosition, max=7, min=0
        DiagnosticRoutineControlClassExtension: gid=iSOFT:diag:DiagnosticRoutineControlClassExtension, extends-meta-class=DiagnosticRoutineControlClass
          sdg primitive attribute P4Server_max: category=INTEGER, lower-multiplicity=0, upper-multiplicity=1, gid=iSOFT:diag:DiagnosticRoutineControlClassExtension:P4Server_max
        DiagnosticRoutineExtension: gid=iSOFT:diag:DiagnosticRoutineExtension, extends-meta-class=DiagnosticRoutine
          sdg primitive attribute P4Server_max: category=INTEGER, lower-multiplicity=0, upper-multiplicity=1, gid=iSOFT:diag:DiagnosticRoutineExtension:P4Server_max
        DiagnosticSecurityAccessClassExtension: gid=iSOFT:diag:DiagnosticSecurityAccessClassExtension, extends-meta-class=DiagnosticSecurityAccessClass
          sdg primitive attribute P4Server_max: category=INTEGER, lower-multiplicity=0, upper-multiplicity=1, gid=iSOFT:diag:DiagnosticSecurityAccessClassExtension:P4Server_max
        DiagnosticSessionControlClassExtension: gid=iSOFT:diag:DiagnosticSessionControlClassExtension, extends-meta-class=DiagnosticSessionControlClass
          sdg primitive attribute P4Server_max: category=INTEGER, lower-multiplicity=0, upper-multiplicity=1, gid=iSOFT:diag:DiagnosticSessionControlClassExtension:P4Server_max
        DiagnosticStartRoutineExtension: gid=iSOFT:diag:DiagnosticStartRoutineExtension, extends-meta-class=DiagnosticStartRoutine
          sdg primitive attribute P4Server_max: category=INTEGER, lower-multiplicity=0, upper-multiplicity=1, gid=iSOFT:diag:DiagnosticStartRoutineExtension:P4Server_max
        DiagnosticStopRoutineExtension: gid=iSOFT:diag:DiagnosticStopRoutineExtension, extends-meta-class=DiagnosticStopRoutine
          sdg primitive attribute P4Server_max: category=INTEGER, lower-multiplicity=0, upper-multiplicity=1, gid=iSOFT:diag:DiagnosticStopRoutineExtension:P4Server_max
        DiagnosticWriteDataByIdentifierClassExtension: gid=iSOFT:diag:DiagnosticWriteDataByIdentifierClassExtension, extends-meta-class=DiagnosticWriteDataByIdentifierClass
          sdg primitive attribute P4Server_max: category=INTEGER, lower-multiplicity=0, upper-multiplicity=1, gid=iSOFT:diag:DiagnosticWriteDataByIdentifierClassExtension:P4Server_max
        DoIPInstantiationExtension: gid=iSOFT:diag:DoIPInstantiationExtension, extends-meta-class=DoIpInstantiation
          5 x sdg primitive attribute, all with lower-multiplicity=0, upper-multiplicity=1:
            DoIPVersion: category=INTEGER, gid=iSOFT:diag:DoIPInstantiationExtension:DoIPVersion
            NoParamVehicleIdentificationSwitch: category=BOOLEAN, gid=iSOFT:diag:DoIPInstantiationExtension:NoParamVehicleIdentificationSwitch
            ServerCrt: category=STRING, gid=iSOFT:diag:DoIPInstantiationExtension:ServerCrt
            ServerKey: category=STRING, gid=iSOFT:diag:DoIPInstantiationExtension:ServerKey
            Ca: category=STRING, gid=iSOFT:diag:DoIPInstantiationExtension:Ca
        ExternalAuthenticationIdentification: gid=iSOFT:diag:ExternalAuthenticationIdentification
          sdg primitive attribute sourceAddressMask: category=INTEGER, lower-multiplicity=1, upper-multiplicity=1, gid=iSOFT:diag:ExternalAuthenticationIdentification:sourceAddressMask, max=255, min=0
          sdg primitive attribute sourceAddressCode: category=INTEGER, lower-multiplicity=1, upper-multiplicity=1, gid=iSOFT:diag:ExternalAuthenticationIdentification:sourceAddressCode, max=255, min=0
        NetConfig: gid=iSOFT:diag:NetConfig, extends-meta-class=Machine
          attributes:
            sdg foreign reference multicastIp: lower-multiplicity=1, upper-multiplicity=1, gid=iSOFT:diag:NetConfig:multicastIP, dest-meta-class=NetworkEndpoint
            sdg primitive attribute multicastPort: category=INTEGER, lower-multiplicity=1, upper-multiplicity=1, gid=iSOFT:diag:NetConfig:multicastPort, max=65535, min=1
        NetConfigForDm: gid=iSOFT:diag:NetConfigForDm, extends-meta-class=Machine
          attributes:
            sdg foreign reference unicastIP: lower-multiplicity=1, upper-multiplicity=1, gid=iSOFT:diag:NetConfigForDm:unicastIP, dest-meta-class=NetworkEndpoint
            sdg primitive attribute unicastPort: category=INTEGER, lower-multiplicity=1, upper-multiplicity=1, gid=iSOFT:diag:NetConfigForDm:unicastPort, max=65535, min=1
        ProvidedInterface: gid=iSOFT:diag:ProvidedInterface, extends-meta-class=PPortPrototype
          sdg primitive attribute Class: category=STRING, lower-multiplicity=1, upper-multiplicity=1, gid=iSOFT:diag:ProvidedInterface:Class
        RequestDownload: gid=iSOFT:diag:DiagnosticRequestDownload, extends-meta-class=DiagnosticRequestDownload
          sdg primitive attribute MaxNumberOfBlockLength: category=INTEGER, lower-multiplicity=1, upper-multiplicity=1, gid=iSOFT:diag:DiagnosticRequestDownload:maxNumberOfBlockLength
        RequestFileTransfer: gid=iSOFT:diag:DiagnosticRequestFileTransfer, extends-meta-class=DiagnosticRequestFileTransfer
          sdg primitive attribute MaxNumberOfBlockLength: category=INTEGER, lower-multiplicity=1, upper-multiplicity=1, gid=iSOFT:diag:DiagnosticRequestFileTransfer:maxNumberOfBlockLength
        RequestUpload: gid=iSOFT:diag:DiagnosticRequestUpload, extends-meta-class=DiagnosticRequestUpload
          sdg primitive attribute MaxNumberOfBlockLength: category=INTEGER, lower-multiplicity=1, upper-multiplicity=1, gid=iSOFT:diag:DiagnosticRequestUpload:maxNumberOfBlockLength
        RequiredInterface: gid=iSOFT:diag:RequiredInterface, extends-meta-class=RPortPrototype
          sdg primitive attribute Class: category=STRING, lower-multiplicity=1, upper-multiplicity=1, gid=iSOFT:diag:RequiredInterface:Class
        ResponseOnEvent: gid=iSOFT:diag:DiagnosticResponseOnEvent, extends-meta-class=DiagnosticResponseOnEvent
          sdg primitive attribute InfiniteTimeToResponse: category=STRING, lower-multiplicity=1, upper-multiplicity=1, gid=iSOFT:diag:DiagnosticResponseOnEvent:infiniteTimeToResponse, pattern=true|false
          sdg primitive attribute Count: category=STRING, lower-multiplicity=1, upper-multiplicity=1, gid=iSOFT:diag:DiagnosticResponseOnEvent:powerWindowTime, pattern=true|false
        ResponseOnEventClass: gid=iSOFT:diag:DiagnosticResponseOnEventClass, extends-meta-class=DiagnosticResponseOnEventClass
          6 x sdg primitive attribute, all with lower-multiplicity=1, upper-multiplicity=1:
            StoreEventEnabled: category=STRING, gid=iSOFT:diag:DiagnosticResponseOnEventClass:storeEventEnabled, pattern=false|true
            ResponseOnEventSchedulerRate: category=INTEGER, gid=iSOFT:diag:DiagnosticResponseOnEventClass:responseOnEventSchedulerRate
            MaxNumberOfStoredDTCStatusChangedEvents: category=INTEGER, gid=iSOFT:diag:DiagnosticResponseOnEventClass:maxNumberOfStoredDTCStatusChangedEvents
            MaxNumChangeOfDataIdentfierEvents: category=INTEGER, gid=iSOFT:diag:DiagnosticResponseOnEventClass:maxNumChangeOfDataIdentfierEvents
            MaxNumComparisionOfValueEvents: category=INTEGER, gid=iSOFT:diag:DiagnosticResponseOnEventClass:maxNumComparisionOfValueEvents
            MaxSupportedDIDLength: category=INTEGER, gid=iSOFT:diag:DiagnosticResponseOnEventClass:maxSupportedDIDLength

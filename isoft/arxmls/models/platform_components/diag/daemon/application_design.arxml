AUTOSAR XML (schema 00049)
package /ISOFT/PlatformComponents/diag/AdaptiveApplicationSwComponentType
  adaptive application sw component type dmd
    provide/require port DiagnosticStorage: provided-required-interface=dmd
    provide/require port DoIpStorage: provided-required-interface=doip
package /ISOFT/PlatformComponents/diag/Executable
  executable dmd: category=PLATFORM_LEVEL, logging-behavior=USES-LOGGING, reporting-behavior=REPORTS-EXECUTION-STATE
    root sw component prototype root: application-type=dmd
package /ISOFT/PlatformComponents/diag/PersistencyKeyValueStorageInterface
  persistency key value storage interface dmd: redundancy-handlings=persistency-redundancy-crc={algorithm-family=CRC_32P4, length=32}
  persistency key value storage interface doip: redundancy-handlings=persistency-redundancy-crc={algorithm-family=CRC_32P4, length=32}
package /ISOFT/PlatformComponents/diag/ProcessDesign
  process design dmd: executable=dmd

AUTOSAR XML (schema 00049)
package /ISOFT/PlatformComponents/com
  sdg def Extension
    sdg-classes:
      19 x sdg class, all with category=ISOFT_EXTENSION:
        ApSomeipTransformationProps: gid=iSOFT:com:ApSomeipTransformationProps, extends-meta-class=ApSomeipTransformationProps
          sdg primitive attribute SizeOfFixedArrayLengthField: category=INTEGER, lower-multiplicity=0, upper-multiplicity=1, gid=iSOFT:com:ApSomeipTransformationProps:SizeOfFixedArrayLengthField
          sdg primitive attribute SizeOfFixedStringLengthField: category=INTEGER, lower-multiplicity=0, upper-multiplicity=1, gid=iSOFT:com:ApSomeipTransformationProps:SizeOfFixedStringLengthField
        CommunicationGroup: gid=iSOFT:com:CommunicationGroup, extends-meta-class=ServiceInterface
          sdg primitive attribute GroupName: category=STRING, lower-multiplicity=1, upper-multiplicity=1, gid=iSOFT:com:CommunicationGroup:GroupName
        DdsProvidedTransportConfig: gid=iSOFT:com:DdsProvidedTransportConfig, extends-meta-class=DdsProvidedServiceInstance
          4 x sdg primitive attribute, all with upper-multiplicity=1:
            EnableDdsProvidedTransportConfig: category=BOOLEAN, lower-multiplicity=0, gid=iSOFT:com:DdsProvidedTransportConfig:EnableDdsProvidedTransportConfig
            TCPv4Port: category=INTEGER, gid=iSOFT:com:DdsProvidedTransportConfig:TCPv4Port, max=65535, min=0
            TCPv6Port: category=INTEGER, gid=iSOFT:com:DdsProvidedTransportConfig:TCPv6Port, max=65535, min=0
            DSCP: category=ENUMERATION, lower-multiplicity=0, gid=iSOFT:com:DdsProvidedTransportConfig:DSCP, pattern=0|8|16|24|32|40|48|56
        DdsRequiredTransportConfig: gid=iSOFT:com:DdsRequiredTransportConfig, extends-meta-class=DdsRequiredServiceInstance
          6 x sdg primitive attribute, all with upper-multiplicity=1:
            EnableDdsRequiredTransportConfig: category=BOOLEAN, lower-multiplicity=0, gid=iSOFT:com:DdsRequiredTransportConfig:EnableDdsRequiredTransportConfig
            RemoteIpv4Address: category=STRING, gid=iSOFT:com:DdsRequiredTransportConfig:RemoteIpv4Address
            RemoteIpv6Address: category=STRING, gid=iSOFT:com:DdsRequiredTransportConfig:RemoteIpv6Address
            RemoteTCPv4Port: category=INTEGER, gid=iSOFT:com:DdsRequiredTransportConfig:RemoteTCPv4Port, max=65535, min=0
            RemoteTCPv6Port: category=INTEGER, gid=iSOFT:com:DdsRequiredTransportConfig:RemoteTCPv6Port, max=65535, min=0
            DSCP: category=ENUMERATION, lower-multiplicity=0, gid=iSOFT:com:DdsRequiredTransportConfig:DSCP, pattern=0|8|16|24|32|40|48|56
        DdsServiceInterfaceDeploymentSdgProps: gid=iSOFT:com:DdsServiceInterfaceDeploymentSdgProps, extends-meta-class=DdsServiceInterfaceDeployment
          sdg primitive attribute EnableEventIdlWithKey: category=BOOLEAN, lower-multiplicity=0, upper-multiplicity=1, gid=iSOFT:com:DdsServiceInterfaceDeploymentSdgProps:EnableEventIdlWithKey
        IccServiceInterfaceDeployment: gid=iSOFT:com:IccServiceInterfaceDeployment, extends-meta-class=UserDefinedServiceInterfaceDeployment
          sdg primitive attribute Service: category=INTEGER, upper-multiplicity=1, gid=iSOFT:com:IccServiceInterfaceDeployment:Service, max=65535, min=0
        SomeipConfiguration: gid=iSOFT:com:SomeipConfiguration, extends-meta-class=Process
          sdg primitive attribute Mode: category=ENUMERATION, upper-multiplicity=1, gid=iSOFT:com:SomeipConfiguration:Mode, pattern=route|proxy|auto
          sdg primitive attribute RequestResponseDelayMin: category=INTEGER, upper-multiplicity=1, gid=iSOFT:com:SomeipConfiguration:RequestResponseDelayMin, max=4294967295, min=0
          sdg primitive attribute RequestResponseDelayMax: category=INTEGER, upper-multiplicity=1, gid=iSOFT:com:SomeipConfiguration:RequestResponseDelayMax, max=4294967295, min=0
        SomeipdConfiguration: gid=iSOFT:com:SomeipdConfiguration, extends-meta-class=Machine
          sdg primitive attribute Mode: category=ENUMERATION, upper-multiplicity=1, gid=iSOFT:com:SomeipdConfiguration:Mode, pattern=route|proxy|auto
          sdg primitive attribute RequestResponseDelayMin: category=INTEGER, upper-multiplicity=1, gid=iSOFT:com:SomeipdConfiguration:RequestResponseDelayMin, max=4294967295, min=0
          sdg primitive attribute RequestResponseDelayMax: category=INTEGER, upper-multiplicity=1, gid=iSOFT:com:SomeipdConfiguration:RequestResponseDelayMax, max=4294967295, min=0
        IpcConfiguration: gid=iSOFT:com:IpcConfiguration, extends-meta-class=Process
          9 x sdg primitive attribute, all with upper-multiplicity=1:
            NetName: category=STRING, gid=iSOFT:com:IpcConfiguration:NetName
            AppName: category=STRING, gid=iSOFT:com:IpcConfiguration:AppName
            AppId: category=INTEGER, gid=iSOFT:com:IpcConfiguration:AppId, max=4294967295, min=0
            ServiceNetType: category=ENUMERATION, gid=iSOFT:com:IpcConfiguration:ServiceNetType, pattern=tcp|unixsock
            ServiceAccessHandle: category=STRING, gid=iSOFT:com:IpcConfiguration:ServiceAccessHandle
            DiscoveryNetType: category=ENUMERATION, gid=iSOFT:com:IpcConfiguration:DiscoveryNetType, pattern=tcp|unixsock
            DiscoveryAccessHandle: category=STRING, gid=iSOFT:com:IpcConfiguration:DiscoveryAccessHandle
            Mode: category=ENUMERATION, gid=iSOFT:com:IpcConfiguration:Mode, pattern=application|discovery
            SendTimeout: category=INTEGER, gid=iSOFT:com:IpcConfiguration:SendTimeout, max=18446744073709551615, min=0
        IpcServiceInstanceDeployment: gid=iSOFT:com:IpcServiceInstanceDeployment, extends-meta-class=ProvidedUserDefinedServiceInstance
          5 x sdg primitive attribute, all with upper-multiplicity=1:
            Instance: category=INTEGER, gid=iSOFT:com:IpcServiceInstanceDeployment:Instance, max=65535, min=0
            ShmPath: category=STRING, gid=iSOFT:com:IpcServiceInstanceDeployment:ShmPath
            ShmSegSize: category=INTEGER, gid=iSOFT:com:IpcServiceInstanceDeployment:ShmSegSize, max=4294967295, min=0
            ShmSegCount: category=INTEGER, gid=iSOFT:com:IpcServiceInstanceDeployment:ShmSegCount, max=4294967295, min=0
            MsgQueueLen: category=INTEGER, gid=iSOFT:com:IpcServiceInstanceDeployment:MsgQueueLen, max=65535, min=0
        IpcServiceInterfaceDeployment: gid=iSOFT:com:IpcServiceInterfaceDeployment, extends-meta-class=UserDefinedServiceInterfaceDeployment
          sdg primitive attribute Service: category=INTEGER, upper-multiplicity=1, gid=iSOFT:com:IpcServiceInterfaceDeployment:Service, max=65535, min=0
          sdg primitive attribute Major: category=INTEGER, upper-multiplicity=1, gid=iSOFT:com:IpcServiceInterfaceDeployment:Major, max=255, min=0
          sdg primitive attribute Minor: category=INTEGER, upper-multiplicity=1, gid=iSOFT:com:IpcServiceInterfaceDeployment:Minor, max=4294967295, min=0
        Ipv6Configuration: gid=iSOFT:com:NetworkEndpoint:Ipv6Configuration, extends-meta-class=NetworkEndpoint
          sdg primitive attribute AdapterName: category=STRING, lower-multiplicity=1, upper-multiplicity=1, gid=iSOFT:com:NetworkEndpoint:AdapterName
        ProvidedIccServiceInstanceDeployment: gid=iSOFT:com:ProvidedIccServiceInstanceDeployment, extends-meta-class=ProvidedUserDefinedServiceInstance
          sdg primitive attribute Instance: category=INTEGER, upper-multiplicity=1, gid=iSOFT:com:ProvidedIccServiceInstanceDeployment:Instance, max=65535, min=0
          sdg primitive attribute IccIdentifier: category=STRING, upper-multiplicity=1, gid=iSOFT:com:ProvidedIccServiceInstanceDeployment:IccIdentifier
          sdg primitive attribute IccType: category=INTEGER, upper-multiplicity=1, gid=iSOFT:com:ProvidedIpcServiceInstanceDeployment:IccType, max=4294967295, min=0
        RequiredIccServiceInstanceDeployment: gid=iSOFT:com:RequiredIccServiceInstanceDeployment, extends-meta-class=RequiredUserDefinedServiceInstance
          sdg primitive attribute Instance: category=INTEGER, upper-multiplicity=1, gid=iSOFT:com:RequiredIccServiceInstanceDeployment:Instance, max=65535, min=0
          sdg primitive attribute IccIdentifier: category=STRING, upper-multiplicity=1, gid=iSOFT:com:RequiredIccServiceInstanceDeployment:IccIdentifier
          sdg primitive attribute IccType: category=INTEGER, upper-multiplicity=1, gid=iSOFT:com:RequiredIpcServiceInstanceDeployment:IccType, max=4294967295, min=0
        ServiceMethod: gid=iSOFT:com:Output, extends-meta-class=ClientServerOperation
          sdg primitive attribute AsArgs: category=BOOLEAN, lower-multiplicity=0, upper-multiplicity=1, gid=iSOFT:com:Output:AsArgs
        SomeipRemoteUnicastConfig: gid=iSOFT:com:SomeipRemoteUnicastConfig
          attributes:
            4 x sdg primitive attribute, all with upper-multiplicity=1:
              Ipv4Address: category=STRING, gid=iSOFT:com:SomeipRemoteUnicastConfig:Ipv4Address
              Ipv6Address: category=STRING, gid=iSOFT:com:SomeipRemoteUnicastConfig:Ipv6Address
              TcpPort: category=INTEGER, gid=iSOFT:com:SomeipRemoteUnicastConfig:TcpPort, max=65535, min=0
              UdpPort: category=INTEGER, gid=iSOFT:com:SomeipRemoteUnicastConfig:UdpPort, max=65535, min=0
            sdg foreign reference SomeipEventGroup: upper-multiplicity-infinite=true, gid=iSOFT:com:SomeipRemoteUnicastConfig:SomeipEventGroup, dest-meta-class=SomeipEventGroup
            sdg primitive attribute ClientSDStrategy: category=ENUMERATION, upper-multiplicity=1, gid=iSOFT:com:SomeipRemoteUnicastConfig:ClientSDStrategy, pattern=Dynamic|Static
        SomeipSdConfiguration: gid=iSOFT:com:SomeipSdConfiguration, extends-meta-class=NetworkEndpoint
          sdg primitive attribute EnableIpv4SdEndpointOption: category=BOOLEAN, lower-multiplicity=0, upper-multiplicity=1, gid=iSOFT:com:SomeipSdConfiguration:EnableIpv4SdEndpointOption
        SomeipServiceInstanceToMachineMapping: gid=iSOFT:com:SomeipServiceInstanceToMachineMapping, extends-meta-class=SomeipServiceInstanceToMachineMapping
          attributes:
            sdg aggregation with variation SomeipRemoteUnicastConfig: gid=iSOFT:com:SomeipServiceInstanceToMachineMapping:SomeipRemoteUnicastConfig, sub-sdg=SomeipRemoteUnicastConfig
            sdg primitive attribute ClientBindUdpEndPort: category=INTEGER, upper-multiplicity=1, gid=iSOFT:com:SomeipServiceInstanceToMachineMapping:ClientBindUdpEndPort, max=65535, min=0
            sdg primitive attribute ClientBindTcpEndPort: category=INTEGER, upper-multiplicity=1, gid=iSOFT:com:SomeipServiceInstanceToMachineMapping:ClientBindTcpEndPort, max=65535, min=0
        TlsCryptoCipherSuite: gid=iSOFT:com:TlsCryptoCipherSuite, extends-meta-class=TlsCryptoCipherSuite
          4 x sdg primitive attribute, all with upper-multiplicity=1:
            TlsVerifyClient: category=ENUMERATION, gid=iSOFT:com:TlsCryptoCipherSuite:TlsVerifyClient, pattern=0|1
            TlsPeerCAFile: category=STRING, lower-multiplicity=0, gid=iSOFT:com:TlsCryptoCipherSuite:TlsPeerCAFile
            TlsLocalCertFile: category=STRING, lower-multiplicity=0, gid=iSOFT:com:TlsCryptoCipherSuite:TlsLocalCertFile
            TlsLocalPrivateKeyFile: category=STRING, lower-multiplicity=0, gid=iSOFT:com:TlsCryptoCipherSuite:TlsLocalPrivateKeyFile

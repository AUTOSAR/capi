AUTOSAR XML (schema 00049)
package /ISOFT/PlatformComponents/com
  process design nsomeip_routing_proc_design: executable=nsomeipd
package /ISOFT/PlatformComponents/com/exe
  executable nsomeipd: category=PLATFORM_LEVEL, logging-behavior=USES-LOGGING, reporting-behavior=REPORTS-EXECUTION-STATE
    root sw component prototype root_swc: application-type=nsomeip_routing
package /ISOFT/PlatformComponents/com/swc
  adaptive application sw component type nsomeip_routing

AUTOSAR XML (schema 00049)
package /ISOFT/PlatformComponents/com
  unit NoUnit
  dlt message collection set trace
    13 x dlt message, all with message-type-info=DLT_TRACE_VFB:
      serviceOffered: message-id=0x8000C000
        8 x dlt argument:
          processFullQualifiedName: network-representation={base-type=utf8, unit=NoUnit}
          instanceFullQualifiedName: network-representation={base-type=utf8, unit=NoUnit}
          serviceIdentifier: network-representation={base-type=utf8, unit=NoUnit}
          bindingType: network-representation={base-type=utf8, unit=NoUnit}
          serviceId: network-representation={base-type=utf8, unit=NoUnit}
          instanceId: network-representation={base-type=uint16_t, unit=NoUnit}
          state: network-representation={base-type=uint8_t, unit=NoUnit}
          comErrc: network-representation={base-type=uint32_t, unit=NoUnit}
      serviceFind: message-id=0x8000C001
        8 x dlt argument:
          processFullQualifiedName: network-representation={base-type=utf8, unit=NoUnit}
          instanceFullQualifiedName: network-representation={base-type=utf8, unit=NoUnit}
          serviceIdentifier: network-representation={base-type=utf8, unit=NoUnit}
          bindingType: network-representation={base-type=utf8, unit=NoUnit}
          serviceId: network-representation={base-type=utf8, unit=NoUnit}
          instanceId: network-representation={base-type=uint16_t, unit=NoUnit}
          state: network-representation={base-type=uint8_t, unit=NoUnit}
          comErrc: network-representation={base-type=uint32_t, unit=NoUnit}
      eventSubscribe: message-id=0x8000C002
        10 x dlt argument:
          processFullQualifiedName: network-representation={base-type=utf8, unit=NoUnit}
          instanceFullQualifiedName: network-representation={base-type=utf8, unit=NoUnit}
          serviceIdentifier: network-representation={base-type=utf8, unit=NoUnit}
          bindingType: network-representation={base-type=utf8, unit=NoUnit}
          serviceId: network-representation={base-type=utf8, unit=NoUnit}
          instanceId: network-representation={base-type=uint16_t, unit=NoUnit}
          eventId: network-representation={base-type=uint16_t, unit=NoUnit}
          eventName: network-representation={base-type=utf8, unit=NoUnit}
          isField: network-representation={base-type=bool, unit=NoUnit}
          comErrc: network-representation={base-type=uint32_t, unit=NoUnit}
      eventUnsubscribe: message-id=0x8000C003
        10 x dlt argument:
          processFullQualifiedName: network-representation={base-type=utf8, unit=NoUnit}
          instanceFullQualifiedName: network-representation={base-type=utf8, unit=NoUnit}
          serviceIdentifier: network-representation={base-type=utf8, unit=NoUnit}
          bindingType: network-representation={base-type=utf8, unit=NoUnit}
          serviceId: network-representation={base-type=utf8, unit=NoUnit}
          instanceId: network-representation={base-type=uint16_t, unit=NoUnit}
          eventId: network-representation={base-type=uint16_t, unit=NoUnit}
          eventName: network-representation={base-type=utf8, unit=NoUnit}
          isField: network-representation={base-type=bool, unit=NoUnit}
          comErrc: network-representation={base-type=uint32_t, unit=NoUnit}
      sendEvent: message-id=0x8000C004
        12 x dlt argument:
          processFullQualifiedName: network-representation={base-type=utf8, unit=NoUnit}
          instanceFullQualifiedName: network-representation={base-type=utf8, unit=NoUnit}
          serviceIdentifier: network-representation={base-type=utf8, unit=NoUnit}
          bindingType: network-representation={base-type=utf8, unit=NoUnit}
          serviceId: network-representation={base-type=utf8, unit=NoUnit}
          instanceId: network-representation={base-type=uint16_t, unit=NoUnit}
          eventId: network-representation={base-type=uint16_t, unit=NoUnit}
          eventName: network-representation={base-type=utf8, unit=NoUnit}
          isField: network-representation={base-type=bool, unit=NoUnit}
          sessionId: network-representation={base-type=uint16_t, unit=NoUnit}
          comErrc: network-representation={base-type=uint32_t, unit=NoUnit}
          payload: network-representation={base-type=utf8, unit=NoUnit}
      recvEvent: message-id=0x8000C005
        12 x dlt argument:
          processFullQualifiedName: network-representation={base-type=utf8, unit=NoUnit}
          instanceFullQualifiedName: network-representation={base-type=utf8, unit=NoUnit}
          serviceIdentifier: network-representation={base-type=utf8, unit=NoUnit}
          bindingType: network-representation={base-type=utf8, unit=NoUnit}
          serviceId: network-representation={base-type=utf8, unit=NoUnit}
          instanceId: network-representation={base-type=uint16_t, unit=NoUnit}
          eventId: network-representation={base-type=uint16_t, unit=NoUnit}
          eventName: network-representation={base-type=utf8, unit=NoUnit}
          isField: network-representation={base-type=bool, unit=NoUnit}
          sessionId: network-representation={base-type=uint16_t, unit=NoUnit}
          comErrc: network-representation={base-type=uint32_t, unit=NoUnit}
          payload: network-representation={base-type=utf8, unit=NoUnit}
      sendRequest: message-id=0x8000C006
        13 x dlt argument:
          processFullQualifiedName: network-representation={base-type=utf8, unit=NoUnit}
          instanceFullQualifiedName: network-representation={base-type=utf8, unit=NoUnit}
          serviceIdentifier: network-representation={base-type=utf8, unit=NoUnit}
          bindingType: network-representation={base-type=utf8, unit=NoUnit}
          serviceId: network-representation={base-type=utf8, unit=NoUnit}
          instanceId: network-representation={base-type=uint16_t, unit=NoUnit}
          methodId: network-representation={base-type=uint16_t, unit=NoUnit}
          methodName: network-representation={base-type=utf8, unit=NoUnit}
          isField: network-representation={base-type=bool, unit=NoUnit}
          sessionId: network-representation={base-type=uint16_t, unit=NoUnit}
          messageType: network-representation={base-type=uint8_t, unit=NoUnit}
          comErrc: network-representation={base-type=uint32_t, unit=NoUnit}
          payload: network-representation={base-type=utf8, unit=NoUnit}
      recvRequest: message-id=0x8000C007
        13 x dlt argument:
          processFullQualifiedName: network-representation={base-type=utf8, unit=NoUnit}
          instanceFullQualifiedName: network-representation={base-type=utf8, unit=NoUnit}
          serviceIdentifier: network-representation={base-type=utf8, unit=NoUnit}
          bindingType: network-representation={base-type=utf8, unit=NoUnit}
          serviceId: network-representation={base-type=utf8, unit=NoUnit}
          instanceId: network-representation={base-type=uint16_t, unit=NoUnit}
          methodId: network-representation={base-type=uint16_t, unit=NoUnit}
          methodName: network-representation={base-type=utf8, unit=NoUnit}
          isField: network-representation={base-type=bool, unit=NoUnit}
          sessionId: network-representation={base-type=uint16_t, unit=NoUnit}
          messageType: network-representation={base-type=uint8_t, unit=NoUnit}
          comErrc: network-representation={base-type=uint32_t, unit=NoUnit}
          payload: network-representation={base-type=utf8, unit=NoUnit}
      sendResponse: message-id=0x8000C008
        13 x dlt argument:
          processFullQualifiedName: network-representation={base-type=utf8, unit=NoUnit}
          instanceFullQualifiedName: network-representation={base-type=utf8, unit=NoUnit}
          serviceIdentifier: network-representation={base-type=utf8, unit=NoUnit}
          bindingType: network-representation={base-type=utf8, unit=NoUnit}
          serviceId: network-representation={base-type=utf8, unit=NoUnit}
          instanceId: network-representation={base-type=uint16_t, unit=NoUnit}
          methodId: network-representation={base-type=uint16_t, unit=NoUnit}
          methodName: network-representation={base-type=utf8, unit=NoUnit}
          isField: network-representation={base-type=bool, unit=NoUnit}
          sessionId: network-representation={base-type=uint16_t, unit=NoUnit}
          messageType: network-representation={base-type=uint8_t, unit=NoUnit}
          comErrc: network-representation={base-type=uint32_t, unit=NoUnit}
          payload: network-representation={base-type=utf8, unit=NoUnit}
      recvResponse: message-id=0x8000C009
        13 x dlt argument:
          processFullQualifiedName: network-representation={base-type=utf8, unit=NoUnit}
          instanceFullQualifiedName: network-representation={base-type=utf8, unit=NoUnit}
          serviceIdentifier: network-representation={base-type=utf8, unit=NoUnit}
          bindingType: network-representation={base-type=utf8, unit=NoUnit}
          serviceId: network-representation={base-type=utf8, unit=NoUnit}
          instanceId: network-representation={base-type=uint16_t, unit=NoUnit}
          methodId: network-representation={base-type=uint16_t, unit=NoUnit}
          methodName: network-representation={base-type=utf8, unit=NoUnit}
          isField: network-representation={base-type=bool, unit=NoUnit}
          sessionId: network-representation={base-type=uint16_t, unit=NoUnit}
          messageType: network-representation={base-type=uint8_t, unit=NoUnit}
          comErrc: network-representation={base-type=uint32_t, unit=NoUnit}
          payload: network-representation={base-type=utf8, unit=NoUnit}
      Serialize: message-id=0x8000C00A
        13 x dlt argument:
          processFullQualifiedName: network-representation={base-type=utf8, unit=NoUnit}
          instanceFullQualifiedName: network-representation={base-type=utf8, unit=NoUnit}
          serviceIdentifier: network-representation={base-type=utf8, unit=NoUnit}
          bindingType: network-representation={base-type=utf8, unit=NoUnit}
          serviceId: network-representation={base-type=utf8, unit=NoUnit}
          instanceId: network-representation={base-type=uint16_t, unit=NoUnit}
          methodId: network-representation={base-type=uint16_t, unit=NoUnit}
          methodName: network-representation={base-type=utf8, unit=NoUnit}
          isField: network-representation={base-type=bool, unit=NoUnit}
          sessionId: network-representation={base-type=uint16_t, unit=NoUnit}
          messageType: network-representation={base-type=uint8_t, unit=NoUnit}
          comErrc: network-representation={base-type=uint32_t, unit=NoUnit}
          payload: network-representation={base-type=utf8, unit=NoUnit}
      Deserialize: message-id=0x8000C00B
        13 x dlt argument:
          processFullQualifiedName: network-representation={base-type=utf8, unit=NoUnit}
          instanceFullQualifiedName: network-representation={base-type=utf8, unit=NoUnit}
          serviceIdentifier: network-representation={base-type=utf8, unit=NoUnit}
          bindingType: network-representation={base-type=utf8, unit=NoUnit}
          serviceId: network-representation={base-type=utf8, unit=NoUnit}
          instanceId: network-representation={base-type=uint16_t, unit=NoUnit}
          methodId: network-representation={base-type=uint16_t, unit=NoUnit}
          methodName: network-representation={base-type=utf8, unit=NoUnit}
          isField: network-representation={base-type=bool, unit=NoUnit}
          sessionId: network-representation={base-type=uint16_t, unit=NoUnit}
          messageType: network-representation={base-type=uint8_t, unit=NoUnit}
          comErrc: network-representation={base-type=uint32_t, unit=NoUnit}
          payload: network-representation={base-type=utf8, unit=NoUnit}
      eventSubscribed: message-id=0x8000C00C
        10 x dlt argument:
          processFullQualifiedName: network-representation={base-type=utf8, unit=NoUnit}
          instanceFullQualifiedName: network-representation={base-type=utf8, unit=NoUnit}
          serviceIdentifier: network-representation={base-type=utf8, unit=NoUnit}
          bindingType: network-representation={base-type=utf8, unit=NoUnit}
          serviceId: network-representation={base-type=utf8, unit=NoUnit}
          instanceId: network-representation={base-type=uint16_t, unit=NoUnit}
          eventId: network-representation={base-type=uint16_t, unit=NoUnit}
          eventName: network-representation={base-type=utf8, unit=NoUnit}
          isField: network-representation={base-type=bool, unit=NoUnit}
          comErrc: network-representation={base-type=uint32_t, unit=NoUnit}

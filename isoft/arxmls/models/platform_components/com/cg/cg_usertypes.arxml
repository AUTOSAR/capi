AUTOSAR XML (schema 00049)
package /iSOFT/PlatformComponents/com/cg
  std cpp implementation data type clients: category=VECTOR, cpp-template-argument=uint32_t, type-emitter=TYPE_EMITTER_ARA
    namespaces:
      symbol props ara
      symbol props com
      symbol props cg

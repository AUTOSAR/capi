AUTOSAR XML (schema 00049)
package /iSOFT/PlatformComponents/com/cg/ErrorDomains
  ap application error domain CG: value=0x8000000000001270
    namespaces:
      symbol props ara
      symbol props com
      symbol props cg
package /iSOFT/PlatformComponents/com/cg/Errors
  6 x ap application error, all with error-domain=CG:
    BindingError: error-code=4  # Error at technology binding.
    CommunicationGroupNotActive: error-code=1  # Commincation Group not active/connected by a Server.
    MemoryError: error-code=5  # Memory Error.
    NoClients: error-code=2  # No communication group clients.
    ServerExists: error-code=6  # Other server already connected to communication group.
    WrongClientAddress: error-code=3  # Wrong client address.

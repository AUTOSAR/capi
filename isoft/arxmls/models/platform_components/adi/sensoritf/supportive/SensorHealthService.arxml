AUTOSAR XML (schema 00049)
package /AUTOSAR/AutomatedDrivingInterfaces/ServiceInterfaces
  service interface SensorHealthService: is-service=true
    namespaces:
      symbol props ara
      symbol props adi
      symbol props sensoritf
    events:
      data SHealth: type=SensorHealthInfo  # The sensor health information is reported by a sensor.
    methods:
      operation Capability: fire-and-forget=false  # Get the capability vector of the service.
        arg capVector: type=CapabilityVector, direction=OUT  # The capability vector of the servie indicates the presence of the optional signals of the event.

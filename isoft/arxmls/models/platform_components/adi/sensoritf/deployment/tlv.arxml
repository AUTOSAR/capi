AUTOSAR XML (schema 00049)
package /ISOFT/PlatformComponents/adi
  transformation props set TransformationPropsSet
    ap someip transformation props ApSomeipTransformationProps: byte-order=big-endian, size-of-array-length-field=4, size-of-string-length-field=4, size-of-struct-length-field=4, size-of-union-length-field=4
  transformation props to service interface element mapping set TransformationPropsToServiceInterfaceElementMappingSet
    11 x transformation props to service interface element mapping, all with method=Capability, tlv-data-id-definition=[AmbiguityDomainInfo, BboxInfo, CameraDetectionInfo, CameraDetectionsInfo, CameraFeature, CameraFeatures, DetectionClassTypeInfo, DetectionStatus, DimensionBox, DimensionBoxError, EllipseAxesError, FeatureStatus, GeneralHeader, GeneralLandmarks, HeaderBasic, HeaderBasicDetection, Landmark, Landmarkposition, LaneInfo, LidarDetectionInfo, LidarDetectionsInfo, ObjectDetectionRateInfo, ObjectStatus, PMOBoundingBox, PMOHeader, PMObject, PMObjectDynamics, PMObjects, PefSegmentInfo, Point3D, Point3DError, PolynomialsInfo, Pose, Position3DSpheric, Position3DSphericError, ROBoundaryType, ROMarkingT, RObjects, RadarDetectionInfo, RadarDetectionsInfo, ReferTargetRateInfo, RoadBoundaries, RoadBoundaryInfo, RoadBoundaryProperties, RoadSurface, Roadmarking, Roadmarkings, SensorCaliInfo, SensorHealthInfo, SensorHealthStatus, SensorMountingInfo, SensorPerformance, SensorPerformanceStatus, ShapeInfo, ShapeReferPointInfo, StaticObjects, SubObjectStatus, TrafficLight, TrafficLightPos, TrafficLightSpotPos, TrafficLightSpotShape, TrafficLightSpots, TrafficLights, TrafficSigns, UltrasonicDetectionInfo, UltrasonicDetectionsInfo, UltrasonicFeatures, ValidPointInfo, VanishingPointInfo, VertexPointInfo], transformation-props=ApSomeipTransformationProps:
      TransformationPropsToServiceInterfaceElementMapping_CameraDetectionsService: event=CameraDetectionsEvent
      TransformationPropsToServiceInterfaceElementMapping_CameraFeaturesService: event=CameraFeatureEvent
      TransformationPropsToServiceInterfaceElementMapping_LidarDetectionsService: event=LidarDetectionsEvent
      TransformationPropsToServiceInterfaceElementMapping_PMObjectsService: event=PMObjects
      TransformationPropsToServiceInterfaceElementMapping_RObjectsService: event=RoadObject
      TransformationPropsToServiceInterfaceElementMapping_RadarDetectionsService: event=RadarDetectionsEvent
      TransformationPropsToServiceInterfaceElementMapping_SObjectsService: event=StaticObject
      TransformationPropsToServiceInterfaceElementMapping_SensorHealthService: event=SHealth
      TransformationPropsToServiceInterfaceElementMapping_SensorPerformanceService: event=SPerformance
      TransformationPropsToServiceInterfaceElementMapping_UltrasonicDetectionsService: event=UltrasonicDetectionsEvent
      TransformationPropsToServiceInterfaceElementMapping_UltrasonicFeaturesService: event=UltrasonicFeaturesEvent
package /ISOFT/PlatformComponents/adi/TlvDataIdDefinitionSet
  70 x tlv data id definition set:
    AmbiguityDomainInfo
      tlv-data-id-definitions:
        id=1, tlv-sub-element=VelocityAmbiguity
        id=2, tlv-sub-element=RangeAmbiguity
        id=3, tlv-sub-element=AzimuthAmbiguity
        id=4, tlv-sub-element=ElevationAmbiguity
    BboxInfo: tlv-data-id-definitions=[{id=1, tlv-sub-element=BoxDimension}, {id=2, tlv-sub-element=BoxError}]
    CameraDetectionInfo
      tlv-data-id-definitions:
        id=1, tlv-sub-element=DetectionShapeType
        id=2, tlv-sub-element=FreeSpacePro
        id=3, tlv-sub-element=NoValidShapeClass
        id=4, tlv-sub-element=ShapeClassTypeList
        id=5, tlv-sub-element=ShapeAmbiguityID
        id=6, tlv-sub-element=ColourValueList
        id=7, tlv-sub-element=ColourConfidence
    CameraDetectionsInfo
      tlv-data-id-definitions:
        id=1, tlv-sub-element=RecognizedDetectionsCap
        id=2, tlv-sub-element=RecognizedDetectionsStatus
        id=3, tlv-sub-element=NoValidDetections
        id=4, tlv-sub-element=CameraDetectionList
    CameraFeature
      tlv-data-id-definitions:
        id=1, tlv-sub-element=CFStatus
        id=2, tlv-sub-element=CFShapeInfo
        id=3, tlv-sub-element=CFShapePoints
        id=4, tlv-sub-element=CFShapeReferPoints
    CameraFeatures
      tlv-data-id-definitions:
        id=1, tlv-sub-element=CFHeader
        id=2, tlv-sub-element=RecognizedFeaturesCap
        id=3, tlv-sub-element=RecognizedFeaturesStatus
        id=4, tlv-sub-element=NoValidFeatures
        id=5, tlv-sub-element=CFeatueList
    DetectionClassTypeInfo: tlv-data-id-definitions=[{id=1, tlv-sub-element=DClassType}, {id=2, tlv-sub-element=DetectionClassPro}]
    DetectionStatus
      tlv-data-id-definitions:
        id=1, tlv-sub-element=DetectionExistPro
        id=2, tlv-sub-element=FeatureID
        id=3, tlv-sub-element=ObjectID
        id=4, tlv-sub-element=TimestampDiff
    DimensionBox: tlv-data-id-definitions=[{id=1, tlv-sub-element=Length}, {id=2, tlv-sub-element=Width}, {id=3, tlv-sub-element=Height}]
    DimensionBoxError: tlv-data-id-definitions=[{id=1, tlv-sub-element=Length}, {id=2, tlv-sub-element=Width}, {id=3, tlv-sub-element=Height}]
    EllipseAxesError: tlv-data-id-definitions=[{id=1, tlv-sub-element=SemiMinor}, {id=2, tlv-sub-element=SemiMajor}]
    FeatureStatus
      tlv-data-id-definitions:
        id=1, tlv-sub-element=FeatureExistPro
        id=2, tlv-sub-element=FeatureID
        id=3, tlv-sub-element=ObjectID
        id=4, tlv-sub-element=TimestampDiff
        id=5, tlv-sub-element=Observation
    GeneralHeader
      tlv-data-id-definitions:
        id=1, tlv-sub-element=Basic
        id=2, tlv-sub-element=VehicleCoordinateST
        id=3, tlv-sub-element=ColourModelType
    GeneralLandmarks
      tlv-data-id-definitions:
        id=1, tlv-sub-element=RecognizedGeneralLandmarksCap
        id=2, tlv-sub-element=RecognizedGeneralLandmarksStatus
        id=3, tlv-sub-element=NoValidGeneralLandmarks
        id=4, tlv-sub-element=LandmarkList
    HeaderBasic
      tlv-data-id-definitions:
        id=1, tlv-sub-element=VersionID
        id=2, tlv-sub-element=SensorID
        id=3, tlv-sub-element=InterfaceID
        id=4, tlv-sub-element=TimeStampP
        id=5, tlv-sub-element=CycleCounter
        id=6, tlv-sub-element=ItfCycleTime
        id=7, tlv-sub-element=ItfCycleTimeV
        id=8, tlv-sub-element=Qualifier
    HeaderBasicDetection
      tlv-data-id-definitions:
        id=1, tlv-sub-element=VersionID
        id=2, tlv-sub-element=SensorID
        id=3, tlv-sub-element=IterfaceID
        id=4, tlv-sub-element=TimeStampM
        id=5, tlv-sub-element=ItfCycleTime
        id=6, tlv-sub-element=ItfCycleTimeV
        id=7, tlv-sub-element=Qualifier
    Landmark
      tlv-data-id-definitions:
        id=1, tlv-sub-element=Landmarkstatus
        id=2, tlv-sub-element=LandmarkTypeCen
        id=3, tlv-sub-element=LandmarkPos
        id=4, tlv-sub-element=LandmarkBoundingbox
    Landmarkposition
      tlv-data-id-definitions:
        id=1, tlv-sub-element=RPs
        id=2, tlv-sub-element=Position
        id=3, tlv-sub-element=PositionError
        id=4, tlv-sub-element=OrientationVertical
        id=5, tlv-sub-element=OrientationVerticalError
    LaneInfo
      tlv-data-id-definitions:
        id=1, tlv-sub-element=LaneAssociation
        id=2, tlv-sub-element=Angles
        id=3, tlv-sub-element=AngleError
        id=4, tlv-sub-element=Percentage
    LidarDetectionInfo
      tlv-data-id-definitions:
        id=1, tlv-sub-element=PositionSpheric
        id=2, tlv-sub-element=PositionSphericError
        id=3, tlv-sub-element=HeightLidar
        id=4, tlv-sub-element=HeightLidarError
        id=5, tlv-sub-element=RadialRelVelocity
        id=6, tlv-sub-element=RadialRelVelocityError
        id=7, tlv-sub-element=Reflectivity
        id=8, tlv-sub-element=ReflectivityError
        id=9, tlv-sub-element=FreeSpacePro
        id=10, tlv-sub-element=LidarClassType
    LidarDetectionsInfo
      tlv-data-id-definitions:
        id=1, tlv-sub-element=RecognizedDetectionsCap
        id=2, tlv-sub-element=RecognizedDetectionsStatus
        id=3, tlv-sub-element=NoValidDetections
        id=4, tlv-sub-element=LidarDetectionList
    ObjectDetectionRateInfo
      tlv-data-id-definitions:
        id=1, tlv-sub-element=RObjectType
        id=2, tlv-sub-element=ODetectionRange
        id=3, tlv-sub-element=MinimunClassRate
        id=4, tlv-sub-element=MaxFalsePositiveRate
        id=5, tlv-sub-element=PositivePredictiveValue
    ObjectStatus
      tlv-data-id-definitions:
        id=1, tlv-sub-element=ObjectID
        id=2, tlv-sub-element=GroupingObjectID
        id=3, tlv-sub-element=Age
        id=4, tlv-sub-element=Observation
        id=5, tlv-sub-element=TrackQuality
        id=6, tlv-sub-element=PMOMeasurementStatus
    PMOBoundingBox
      tlv-data-id-definitions:
        id=1, tlv-sub-element=BoxDimension
        id=2, tlv-sub-element=BoxError
        id=3, tlv-sub-element=GroundClearance
        id=4, tlv-sub-element=IncludedGeometricStructures
    PMOHeader
      tlv-data-id-definitions:
        id=1, tlv-sub-element=Basic
        id=2, tlv-sub-element=VehicleCoordinateST
        id=3, tlv-sub-element=TMModel
        id=4, tlv-sub-element=Motion
    PMObject
      tlv-data-id-definitions:
        id=1, tlv-sub-element=PMObjectInfo
        id=2, tlv-sub-element=ObjectDynamics
        id=3, tlv-sub-element=ObjectBoundingBox
        id=4, tlv-sub-element=ObjectTypeCertainty
        id=5, tlv-sub-element=ObjectLights
        id=6, tlv-sub-element=PersonPoses
        id=7, tlv-sub-element=LaneInforation
        id=8, tlv-sub-element=PMOMotionInfo
        id=9, tlv-sub-element=ScaleChange
        id=10, tlv-sub-element=EntityRCS
        id=11, tlv-sub-element=EntityLidarReflectivity
    PMObjectDynamics
      tlv-data-id-definitions:
        id=1, tlv-sub-element=PMORPs
        id=2, tlv-sub-element=PMOPosition
        id=3, tlv-sub-element=PMOPositionError
        id=4, tlv-sub-element=PMOrientation
        id=5, tlv-sub-element=PMOrientationError
        id=6, tlv-sub-element=PMOVelocity
        id=7, tlv-sub-element=PMOVelocityError
        id=8, tlv-sub-element=PMOAcceleration
        id=9, tlv-sub-element=PMOAccelerationError
        id=10, tlv-sub-element=KinematicPoint
        id=11, tlv-sub-element=KPError
        id=12, tlv-sub-element=KPOrientation
        id=13, tlv-sub-element=KPOrentationError
        id=14, tlv-sub-element=PMORoadLevel
        id=15, tlv-sub-element=PMOMovementStatus
    PMObjects
      tlv-data-id-definitions:
        id=1, tlv-sub-element=PMOHeader
        id=2, tlv-sub-element=PMOCap
        id=3, tlv-sub-element=PMOStatus
        id=4, tlv-sub-element=NoValidPMO
        id=5, tlv-sub-element=PMObjectList
    PefSegmentInfo
      tlv-data-id-definitions:
        id=1, tlv-sub-element=PefStatus
        id=2, tlv-sub-element=PefFOVReductionInfo
        id=3, tlv-sub-element=RealWorldODRates
        id=4, tlv-sub-element=RefDetectionRates
    Point3D: tlv-data-id-definitions=[{id=1, tlv-sub-element=x}, {id=2, tlv-sub-element=y}, {id=3, tlv-sub-element=z}]
    Point3DError: tlv-data-id-definitions=[{id=1, tlv-sub-element=x}, {id=2, tlv-sub-element=y}, {id=3, tlv-sub-element=z}]
    PolynomialsInfo
      tlv-data-id-definitions:
        id=1, tlv-sub-element=Coefficient
        id=2, tlv-sub-element=PolynomialError
        id=3, tlv-sub-element=Range
        id=4, tlv-sub-element=WidthPolynomials
        id=5, tlv-sub-element=WidthPolynomialsError
        id=6, tlv-sub-element=WidthPolynomialsConfidence
        id=7, tlv-sub-element=HeightPolynomials
        id=8, tlv-sub-element=HeightPolynomialsError
        id=9, tlv-sub-element=HeightPolynomialsConfidence
        id=10, tlv-sub-element=NoDataRanges
        id=11, tlv-sub-element=DataRangeList
    Pose
      tlv-data-id-definitions:
        id=1, tlv-sub-element=PoseType
        id=2, tlv-sub-element=PersonPoseInfo
        id=3, tlv-sub-element=PoseError
    Position3DSpheric: tlv-data-id-definitions=[{id=1, tlv-sub-element=elevation}, {id=2, tlv-sub-element=azimuth}, {id=3, tlv-sub-element=distance}]
    Position3DSphericError: tlv-data-id-definitions=[{id=1, tlv-sub-element=elevation}, {id=2, tlv-sub-element=azimuth}, {id=3, tlv-sub-element=distance}]
    ROBoundaryType
      tlv-data-id-definitions:
        id=1, tlv-sub-element=Type
        id=2, tlv-sub-element=RoadBoundaryTypeConfidence
        id=3, tlv-sub-element=Role
        id=4, tlv-sub-element=LaneBoundaryRoleConfidence
        id=5, tlv-sub-element=RBProperties
    ROMarkingT
      tlv-data-id-definitions:
        id=1, tlv-sub-element=ROMarkingType
        id=2, tlv-sub-element=RoadMarkingTypeConfidence
        id=3, tlv-sub-element=ArrowOrientation
        id=4, tlv-sub-element=ArrowDirect
        id=5, tlv-sub-element=SignT
        id=6, tlv-sub-element=SignTypeConfidence
        id=7, tlv-sub-element=SignValue
        id=8, tlv-sub-element=SignUnit
        id=9, tlv-sub-element=ColourValueList
        id=10, tlv-sub-element=ColourConfidence
    RObjects
      tlv-data-id-definitions:
        id=1, tlv-sub-element=ROheader
        id=2, tlv-sub-element=RoadSurface
        id=3, tlv-sub-element=ROmarkings
        id=4, tlv-sub-element=ROBoundaries
    RadarDetectionInfo
      tlv-data-id-definitions:
        id=1, tlv-sub-element=PositionSpheric
        id=2, tlv-sub-element=PositionSphericError
        id=3, tlv-sub-element=RadialRelVelocity
        id=4, tlv-sub-element=RadialRelVelocityError
        id=5, tlv-sub-element=RCS
        id=6, tlv-sub-element=RCSError
        id=7, tlv-sub-element=SNR
        id=8, tlv-sub-element=SNRError
        id=9, tlv-sub-element=MultiTargetPro
        id=10, tlv-sub-element=AmbiguityID
        id=11, tlv-sub-element=DetectionAmbiguityPro
        id=12, tlv-sub-element=FreeSpacePro
        id=13, tlv-sub-element=NoValidDetectionClass
        id=14, tlv-sub-element=RDetectionClassTypeList
    RadarDetectionsInfo
      tlv-data-id-definitions:
        id=1, tlv-sub-element=RecognizedDetectionsCap
        id=2, tlv-sub-element=RecognizedDetectionsStatus
        id=3, tlv-sub-element=NoValidDetections
        id=4, tlv-sub-element=RadarDetectionList
    ReferTargetRateInfo
      tlv-data-id-definitions:
        id=1, tlv-sub-element=RCSRefTarget
        id=2, tlv-sub-element=ReflectivityRefTarget
        id=3, tlv-sub-element=DeltaEDiff
        id=4, tlv-sub-element=RTSpeedRange
        id=5, tlv-sub-element=RTDetectionRange
        id=6, tlv-sub-element=SNRatio
    RoadBoundaries
      tlv-data-id-definitions:
        id=1, tlv-sub-element=RecognizedRoadBoundariesCap
        id=2, tlv-sub-element=RecognizedRoadBoundariesStatus
        id=3, tlv-sub-element=NoValidRoadBoundaries
        id=4, tlv-sub-element=RoadBoundaryList
    RoadBoundaryInfo
      tlv-data-id-definitions:
        id=1, tlv-sub-element=ROBoundaryStatus
        id=2, tlv-sub-element=ExistancePro
        id=3, tlv-sub-element=ROBoundaryInfo
        id=4, tlv-sub-element=RBPolynomialsInfor
        id=5, tlv-sub-element=RBPolylines
    RoadBoundaryProperties: tlv-data-id-definitions=[{id=1, tlv-sub-element=ColourValueList}, {id=2, tlv-sub-element=ColourConfidence}]
    RoadSurface
      tlv-data-id-definitions:
        id=1, tlv-sub-element=ROType
        id=2, tlv-sub-element=NoRoadSurface
        id=3, tlv-sub-element=ROsurfaceList
        id=4, tlv-sub-element=NoConditionClass
        id=5, tlv-sub-element=ROsurfaceConList
        id=6, tlv-sub-element=SurfaceRoughness
    Roadmarking
      tlv-data-id-definitions:
        id=1, tlv-sub-element=ROStatus
        id=2, tlv-sub-element=ExistancePro
        id=3, tlv-sub-element=ROmarkingTypeInfo
        id=4, tlv-sub-element=ROPolynomialsInfor
        id=5, tlv-sub-element=ROPolylines
    Roadmarkings
      tlv-data-id-definitions:
        id=1, tlv-sub-element=RecognizedRoadMarkingCap
        id=2, tlv-sub-element=RecognizedRoadMarkingStatus
        id=3, tlv-sub-element=NoValidRoadMarking
        id=4, tlv-sub-element=ROmarkinglist
    SensorCaliInfo
      tlv-data-id-definitions:
        id=1, tlv-sub-element=NoValidSensorCalibratableComponents
        id=2, tlv-sub-element=SensorCaliCompList
        id=3, tlv-sub-element=CoorectionOriginPos
        id=4, tlv-sub-element=CoorectionOriginPosError
        id=5, tlv-sub-element=CoorectionPosLimitMin
        id=6, tlv-sub-element=CoorectionPosLimitMax
        id=7, tlv-sub-element=CoorectionOrientation
        id=8, tlv-sub-element=CoorectionOrientationError
        id=9, tlv-sub-element=CoorectionAngleLimitMin
        id=10, tlv-sub-element=CoorectionAngleLimitMax
    SensorHealthInfo
      tlv-data-id-definitions:
        id=1, tlv-sub-element=SHHeader
        id=2, tlv-sub-element=SensorMountingPos
        id=3, tlv-sub-element=SHStatus
        id=4, tlv-sub-element=SensorCali
    SensorHealthStatus
      tlv-data-id-definitions:
        id=1, tlv-sub-element=OperationState
        id=2, tlv-sub-element=OperationMode
        id=3, tlv-sub-element=DefectDetected
        id=4, tlv-sub-element=DefectReason
        id=5, tlv-sub-element=DiagMode
        id=6, tlv-sub-element=SupplyVoltage
        id=7, tlv-sub-element=TempStatus
        id=8, tlv-sub-element=NoValidSensorInput
        id=9, tlv-sub-element=ValidSenorInputSignalList
        id=10, tlv-sub-element=ExternalDisturbed
        id=11, tlv-sub-element=TPReduced
        id=12, tlv-sub-element=HeatingStatus
        id=13, tlv-sub-element=CleaningStatus
        id=14, tlv-sub-element=TSYStatus
        id=15, tlv-sub-element=SensorTimeSynccOffset
    SensorMountingInfo
      tlv-data-id-definitions:
        id=1, tlv-sub-element=OriginPosition
        id=2, tlv-sub-element=OriginPositionError
        id=3, tlv-sub-element=OriginOrientation
        id=4, tlv-sub-element=OriginOrientationError
    SensorPerformance
      tlv-data-id-definitions:
        id=1, tlv-sub-element=SPHeader
        id=2, tlv-sub-element=SPScopeIntf
        id=3, tlv-sub-element=SensorMountingPos
        id=4, tlv-sub-element=VPInfo
        id=5, tlv-sub-element=PerformanceSegments
    SensorPerformanceStatus
      tlv-data-id-definitions:
        id=1, tlv-sub-element=HAngle
        id=2, tlv-sub-element=VerticalAngle
        id=3, tlv-sub-element=SResolution
        id=4, tlv-sub-element=BeamDivergence
        id=5, tlv-sub-element=RangeGain
        id=6, tlv-sub-element=BStatus
    ShapeInfo
      tlv-data-id-definitions:
        id=1, tlv-sub-element=CFShapeType
        id=2, tlv-sub-element=NoValidShapeClass
        id=3, tlv-sub-element=CFShapeClassTypeList
        id=4, tlv-sub-element=ColourValueList
        id=5, tlv-sub-element=ColourPro
    ShapeReferPointInfo
      tlv-data-id-definitions:
        id=1, tlv-sub-element=PointExistPro
        id=2, tlv-sub-element=Position3D
        id=3, tlv-sub-element=Position3DError
        id=4, tlv-sub-element=OrientationNormal
        id=5, tlv-sub-element=OrientationNormalError
        id=6, tlv-sub-element=TranslationRate
        id=7, tlv-sub-element=TranslationRateError
        id=8, tlv-sub-element=RotationRate
        id=9, tlv-sub-element=RotationRateError
        id=10, tlv-sub-element=ScaleChange
        id=11, tlv-sub-element=ScaleChangeError
    StaticObjects
      tlv-data-id-definitions:
        id=1, tlv-sub-element=Header
        id=2, tlv-sub-element=SOLandmarks
        id=3, tlv-sub-element=SOTrafficSigns
        id=4, tlv-sub-element=SOTrafficLights
    SubObjectStatus
      tlv-data-id-definitions:
        id=1, tlv-sub-element=Age
        id=2, tlv-sub-element=Observation
        id=3, tlv-sub-element=TrackQuality
        id=4, tlv-sub-element=PMOMeasurementStatus
    TrafficLight
      tlv-data-id-definitions:
        id=1, tlv-sub-element=TLightStatus
        id=2, tlv-sub-element=TLightTypeCer
        id=3, tlv-sub-element=TLightPos
        id=4, tlv-sub-element=TLightBox
        id=5, tlv-sub-element=TLightSpots
    TrafficLightPos
      tlv-data-id-definitions:
        id=1, tlv-sub-element=MinimumVisibilityDistance
        id=2, tlv-sub-element=RPs
        id=3, tlv-sub-element=Position
        id=4, tlv-sub-element=PositionError
        id=5, tlv-sub-element=OrientationVertical
        id=6, tlv-sub-element=OrientationVerticalError
    TrafficLightSpotPos: tlv-data-id-definitions=[{id=1, tlv-sub-element=Position}, {id=2, tlv-sub-element=PositionError}]
    TrafficLightSpotShape
      tlv-data-id-definitions:
        id=1, tlv-sub-element=TLightSpotShape
        id=2, tlv-sub-element=LightShapeConfidence
        id=3, tlv-sub-element=LightShapeValue
    TrafficLightSpots
      tlv-data-id-definitions:
        id=1, tlv-sub-element=NoTrafficLightSpots
        id=2, tlv-sub-element=NoTrafficLightSpotsConfidence
        id=3, tlv-sub-element=NoValidLightSpots
        id=4, tlv-sub-element=TrafficSLightSpotList
    TrafficLights
      tlv-data-id-definitions:
        id=1, tlv-sub-element=RecognizedTrafficLightsCap
        id=2, tlv-sub-element=RecognizedTrafficLightsStatus
        id=3, tlv-sub-element=NoValidTrafficLights
        id=4, tlv-sub-element=TrafficLightList
    TrafficSigns
      tlv-data-id-definitions:
        id=1, tlv-sub-element=RecognizedTrafficSignsCap
        id=2, tlv-sub-element=RecognizedTrafficSignsStatus
        id=3, tlv-sub-element=NoValidTrafficSigns
        id=4, tlv-sub-element=TrafficSignsList
    UltrasonicDetectionInfo
      tlv-data-id-definitions:
        id=1, tlv-sub-element=Reflectivity
        id=2, tlv-sub-element=EllipseSemiMinorAxis
        id=3, tlv-sub-element=EllipseSemiMajorAxis
        id=4, tlv-sub-element=UltrasonicEllipseAxesError
        id=5, tlv-sub-element=HeightUltrasonic
        id=6, tlv-sub-element=HeightUltrasonicError
    UltrasonicDetectionsInfo
      tlv-data-id-definitions:
        id=1, tlv-sub-element=RecognizedDetectionsCap
        id=2, tlv-sub-element=RecognizedDetectionsStatus
        id=3, tlv-sub-element=NoValidDetections
        id=4, tlv-sub-element=UltrasonicDetectionList
    UltrasonicFeatures
      tlv-data-id-definitions:
        id=1, tlv-sub-element=UltrasonicFHeader
        id=2, tlv-sub-element=RecognizedFeaturesCap
        id=3, tlv-sub-element=RecognizedFeaturesStatus
        id=4, tlv-sub-element=NoValidFeatures
        id=5, tlv-sub-element=UltrasonicFeatueList
    ValidPointInfo
      tlv-data-id-definitions:
        id=1, tlv-sub-element=Position2D
        id=2, tlv-sub-element=Position2DError
        id=3, tlv-sub-element=OrientationUltrasonic
        id=4, tlv-sub-element=OrientationUltrasonicError
        id=5, tlv-sub-element=HeightUltrasonic
        id=6, tlv-sub-element=HeightUltrasonicError
        id=7, tlv-sub-element=VelocityUltrasonic
        id=8, tlv-sub-element=VelocityUltrasonicError
        id=9, tlv-sub-element=TriStatus
        id=10, tlv-sub-element=FeatureMStatus
    VanishingPointInfo: tlv-data-id-definitions=[{id=1, tlv-sub-element=VPDirection}, {id=2, tlv-sub-element=VPError}]
    VertexPointInfo
      tlv-data-id-definitions:
        id=1, tlv-sub-element=VertexPoint
        id=2, tlv-sub-element=VertexPointError
        id=3, tlv-sub-element=Confidence
        id=4, tlv-sub-element=WidthVertex
        id=5, tlv-sub-element=WidthVertexError
        id=6, tlv-sub-element=WidthVertexConfidence
        id=7, tlv-sub-element=HeightVertex
        id=8, tlv-sub-element=HeightVertexError
        id=9, tlv-sub-element=HeightVertexConfidence

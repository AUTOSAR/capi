AUTOSAR XML (schema 00049)
package /AUTOSAR/AutomatedDrivingInterfaces/CompuMethods
  compu method MeasurementStatusFeature: 0x00=kInitialization (No information available.), 0x01=kTracked (Not measured in this cycle.), 0x02=kMeasured (Current position of this feature was measured.), 0x03=kDelete (Tracking will be deleted in the next cycle.), 0x04=kNew (Shape is a polyline (2 or more points).), 0x05=kUnknown (The measurement status is unknown.)
  compu method ShapeClassType: 0x00=kBackground (Shape is classified as background entity.), 0x01=kForeground (Shape is classified as foreground entity.), 0x02=kFlat (Shape is classified as flat entity.), 0x03=kUpright (Shape is classified as upright entity.), 0x04=kGround (Shape is classified as ground entity.), 0x05=kBuilding (Shape is classified as building entity.), 0x06=kVegetation (Shape is classified as vegetation entity.), 0x07=kRoad (Shape is classified as road entity.), 0x08=kNonRoad (Shape is classified as non-road entity.), 0x09=kSidewalk (Shape is classified as sidewalk entity.), 0x0A=kPedestrian (Shape is classified as pedestrian entity.), 0x0B=kVehicle (Shape is classified as vehicle entity.), 0x0C=kTrafficSign (Shape is classified as traffic sign entity.), 0x0D=kPedestrianFront (Shape is classified as pedestrian front-view entity.), 0x0E=kPedestrianSide (Shape is classified as pedestrian side-view entity.), 0x0F=kPedestrianRear (Shape is classified as pedestrian rear-view entity.), 0x10=kUnknown (Shape Class type is unknown.)
package /AUTOSAR/AutomatedDrivingInterfaces/DataConstrs
  range MeasurementStatusFeature: raw 0x00..0x05
package /AUTOSAR/AutomatedDrivingInterfaces/ImplementationDataTypes
  263 x std cpp implementation data type, all with type-emitter=TYPE_EMITTER_ARA:
    AmbiguityDomainInfo: category=STRUCTURE  # Radar Sensor Ambiguity Domain informaiton if the sensor has related capability.
      namespaces:
        symbol props ara
        symbol props adi
        symbol props sensoritf
      4 x cpp implementation data type element, all with is-optional=true:
        VelocityAmbiguity: type-reference={inplace=false, type-reference=RadialVelocityAmbiguityDomain}  # Radial Velocity ambiguity domain information.
        RangeAmbiguity: type-reference={inplace=false, type-reference=RangeAmbiguityDomain}  # The radar range ambiguity domain information.
        AzimuthAmbiguity: type-reference={inplace=false, type-reference=AngleAzimuthAmbiguityDomain}  # The angle azimuth ambiguity domain information.
        ElevationAmbiguity: type-reference={inplace=false, type-reference=AngleElevationAmbiguityDomain}  # The angle elevation ambiguity domain information.
    Angle2ObjectEdge2Line: category=STRUCTURE  # Represents the Angles to object edge to lane. The unit is {rad,rad}.
      namespaces:
        symbol props ara
        symbol props adi
        symbol props sensoritf
      cpp implementation data type element LeftEdgeRightLane: type-reference=float  # Represents angle to the left edge of the object to the right centre of the lane.
      cpp implementation data type element RightEdgeLeftLane: type-reference=float  # Represents angle to the right edge of the object to the left centre of the lane.
    Angle2ObjectEdge2LineError: category=STRUCTURE  # Represents the Error value of the angles to object edge to lane. The unit is {rad,rad}.
      namespaces:
        symbol props ara
        symbol props adi
        symbol props sensoritf
      cpp implementation data type element LeftEdgeRightLane: type-reference=float  # Represents the Error value of the angle of the left edge of the object to the right centre of the lane.
      cpp implementation data type element RightEdgeLeftLane: type-reference=float  # Represents the Error value of the angle to the right edge of the object to the left centre of the lane.
    AngleAzimuthAmbiguityDomain: category=STRUCTURE  # The azimuth angle of the ambiguity domain is defined by {begin} and {end}. The unit is {rad,rad}
      namespaces:
        symbol props ara
        symbol props adi
        symbol props sensoritf
      cpp implementation data type element Begin: type-reference=float  # The starting point.
      cpp implementation data type element End: type-reference=float  # The end point.
    AngleElevationAmbiguityDomain: category=STRUCTURE  # The elevation angle of the ambiguity domain is defined by {begin} and {end}.The unit is {rad,rad}.
      namespaces:
        symbol props ara
        symbol props adi
        symbol props sensoritf
      cpp implementation data type element Begin: type-reference=float  # The starting point.
      cpp implementation data type element End: type-reference=float  # The end point.
    ArrowDirection:  # To identify estimated direction of the displayed arrow.
      compu {0x00=kForeward (Arrow has an estimated direction of 0 rad to 0.), 0x01=kLeft (Arrow has an estimated direction of +pi/2 rad to +90.), 0x02=kRight (Arrow has an estimated direction of -pi/2 rad to -90.), 0x03=kStraightLeft (Arrow is straight left and has an estimated direction of +pi/2 rad to +90.), 0x04=kStraightRight (Arrow is straight right and has an estimated direction of -pi/2 rad to -90.), 0x05=kTurningPointLeft (Arrow has an estimated direction of +pi/2 rad to +180.), 0x06=kTurningPointRight (Arrow has an estimated direction of -pi/2rad to -180.), 0x07=k45DegLeft (Arrow has an estimated direction of +pi/4 rad to +45.), 0x08=k45DegRight (Arrow has an estimated direction of -pi/4 rad to -45.), 0x09=kNoArrow (No arrow is present.), 0x0A=kUnknown (The arrow direction is unknown.)}
      range raw 0x00..0x0A
      type-reference=uint8_t
      namespaces:
        symbol props ara
        symbol props adi
        symbol props sensoritf
    BboxInfo: category=STRUCTURE  # Represents the bounding box information of the static objects. This is only for camera
      namespaces:
        symbol props ara
        symbol props adi
        symbol props sensoritf
      cpp implementation data type element BoxDimension: type-reference={inplace=false, type-reference=DimensionBox}  # Represents the dimension of the bounding box .
      cpp implementation data type element BoxError: is-optional=true, type-reference={inplace=false, type-reference=DimensionBoxError}  # Represents the Error Value of the bounding box.
    BeamDivergence: category=STRUCTURE  # The Beam divergence {horizontal, vertical} of the sensor within the specified segment is the full width at half maximum (FWHM) of the beam (given as the angle in rad).(rad, rad)
      namespaces:
        symbol props ara
        symbol props adi
        symbol props sensoritf
      cpp implementation data type element Horizontal: type-reference=float  # The horizontal angle.
      cpp implementation data type element Vertical: type-reference=float  # The Vertical Angle.
    BlockageStatus:  # Defines the overall blockage of the FOV segment.
      compu {0x00=kFullBlockage (The sensor is completely blocked, no more feature and functionality working due to blockage condition.), 0x01=kPartialBlockageHighImpact (The sensor has detected a blockage condition which has a significant impact on sensor performance (e.g. range).), 0x02=kPartialBlockageMediumImpact (The sensor has detected a blockage condition which already has impact on sensor performance (e.g. range).), 0x03=kPartialBlockageLowImpact (The sensor detects that a blockage condition is present or is increasing, but the degree of blockage has not yet had a significant impact on sensor performance and functionality.), 0x04=kDefect (The full specified range is blocked, due to e.g. a pixel defect. This segment may overlap with other segments.), 0x05=kNone (Normal mode.), 0x06=kUnknown (The blockage Status is unknown.)}
      range raw 0x00..0x06
      type-reference=uint8_t
      namespaces:
        symbol props ara
        symbol props adi
        symbol props sensoritf
    CDShapeClassTypeInfo: category=STRUCTURE  # Represents the shape class type information.
      namespaces:
        symbol props ara
        symbol props adi
        symbol props sensoritf
      cpp implementation data type element DetectionShapClassType: type-reference={inplace=false, type-reference=ShapeClassType}  # Represents the shape class type.
      cpp implementation data type element DetectionShapeClassVariant: type-reference={inplace=false, type-reference=ShapeClassVariant}  # Description of the segment's possible content for Shape classification type.
    CDShapeClassTypeInfoVector: category=VECTOR, cpp-template-argument{inplace=false, template-type=CDShapeClassTypeInfo}  # Represents a list of shape class type information.
      namespaces:
        symbol props ara
        symbol props adi
        symbol props sensoritf
    CDShapePoint: category=STRUCTURE  # Represents the Shape point information.
      namespaces:
        symbol props ara
        symbol props adi
        symbol props sensoritf
      cpp implementation data type element PointProValue: type-reference=ProPercentage  # Existence probability of the point.
      cpp implementation data type element PositionSpheric: type-reference={inplace=false, type-reference=Position3DSpheric}  # 3D point in Spheric coordinate system, while optional for Distance.
      cpp implementation data type element PositionSphericError: type-reference={inplace=false, type-reference=Position3DSphericError}  # Represents the Error Value of the detction postion, while optional for Distance.
    CDShapePointVector: category=VECTOR, cpp-template-argument{inplace=false, template-type=CDShapePoint}  # Represents a list of shape point information.
      namespaces:
        symbol props ara
        symbol props adi
        symbol props sensoritf
    CDShapePointsInfo: category=STRUCTURE  # Represents the Shape points related information.
      namespaces:
        symbol props ara
        symbol props adi
        symbol props sensoritf
      cpp implementation data type element NoValidShapePoints: type-reference=uint16_t  # Represents the number of valid shape points.
      cpp implementation data type element CDShapePointsList: type-reference={inplace=false, type-reference=CDShapePointVector}  # Represents a list of shape point information.
    CaliComponentInfo: category=STRUCTURE  # Represents the caliberation component information.
      namespaces:
        symbol props ara
        symbol props adi
        symbol props sensoritf
      cpp implementation data type element CaliComponent: type-reference={inplace=false, type-reference=SensorCalibratableComponent}  # Defines the caliberation component information.
      cpp implementation data type element CaliStatus: type-reference={inplace=false, type-reference=SensorCalibrationStatus}  # Sensor caliberation status.
    CaliComponentInfoVector: category=VECTOR, cpp-template-argument{inplace=false, template-type=CaliComponentInfo}  # Represents a list of caliberation component information.
      namespaces:
        symbol props ara
        symbol props adi
        symbol props sensoritf
    CameraDetection: category=STRUCTURE  # Represents the Camera detection information.
      namespaces:
        symbol props ara
        symbol props adi
        symbol props sensoritf
      cpp implementation data type element CDetectionStatus: type-reference={inplace=false, type-reference=DetectionStatus}  # Represnets the Camera detection status.
      cpp implementation data type element CDetetionInfo: type-reference={inplace=false, type-reference=CameraDetectionInfo}  # Camera detection information.
      cpp implementation data type element CDShapePoints: type-reference={inplace=false, type-reference=CDShapePointsInfo}  # Camera detection shape points information.
    CameraDetectionInfo: category=STRUCTURE  # Represents the Camera detection related information.
      namespaces:
        symbol props ara
        symbol props adi
        symbol props sensoritf
      7 x cpp implementation data type element:
        DetectionShapeType: type-reference={inplace=false, type-reference=ShapeType}  # Represents the shape of the segment's borderline..
        FreeSpacePro: is-optional=true, type-reference={inplace=false, type-reference=ProPercentage}  # The Free space probability in the range [0, 100] % from the origin up to this detection, as given by the distance. %
        NoValidShapeClass: type-reference={inplace=false, type-reference=uint8_t}  # Represents the number of valid shape class .
        ShapeClassTypeList: type-reference={inplace=false, type-reference=CDShapeClassTypeInfoVector}  # Represents a list of shape class type information.
        ShapeAmbiguityID: is-optional=true, type-reference={inplace=false, type-reference=uint16_t}  # Each ambiguous shape classification with different shape classification probabilities uses one unique ID.
        ColourValueList: type-reference={inplace=false, type-reference=ColourValueVector}  # Definition of the colour value(s). Number of values depends on the Colour model type . %
        ColourConfidence: is-optional=true, type-reference={inplace=false, type-reference=ProPercentage}  # Represents the colour value confidence.
    CameraDetectionVector: category=VECTOR, cpp-template-argument{inplace=false, template-type=CameraDetection}  # Represents a list of Camera detection information.
      namespaces:
        symbol props ara
        symbol props adi
        symbol props sensoritf
    CameraDetections: category=STRUCTURE  # Represents the Camera detection interface information.
      namespaces:
        symbol props ara
        symbol props adi
        symbol props sensoritf
      cpp implementation data type element CDHeader: type-reference={inplace=false, type-reference=GeneralHeader}  # Represents the header of a Camera detection interface.
      cpp implementation data type element SensorMountingPos: type-reference={inplace=false, type-reference=SensorMountingInfo}  # The Sensor mounting position.
      cpp implementation data type element CDetectionsInfo: type-reference={inplace=false, type-reference=CameraDetectionsInfo}  # Represents the Camera detections information .
    CameraDetectionsInfo: category=STRUCTURE  # Represents the Camera detections information.
      namespaces:
        symbol props ara
        symbol props adi
        symbol props sensoritf
      4 x cpp implementation data type element:
        RecognizedDetectionsCap: is-optional=true, type-reference=uint32_t  # To indicate the guaranted recongnized detections.
        RecognizedDetectionsStatus: is-optional=true, type-reference={inplace=false, type-reference=RecognizedStatus}  # The recongnized Camera detections status.
        NoValidDetections: type-reference=uint32_t  # The number of valid Camera detections in the message.
        CameraDetectionList: type-reference={inplace=false, type-reference=CameraDetectionVector}  # Represents a list of Camera detections .
    CameraFeature: category=STRUCTURE  # Represents the Camera feature information.
      namespaces:
        symbol props ara
        symbol props adi
        symbol props sensoritf
      4 x cpp implementation data type element:
        CFStatus: type-reference={inplace=false, type-reference=FeatureStatus}  # Represnets the camera feature status.
        CFShapeInfo: type-reference={inplace=false, type-reference=ShapeInfo}  # Camera shape information.
        CFShapePoints: type-reference={inplace=false, type-reference=ShapePoints}  # Camera shape points information.
        CFShapeReferPoints: is-optional=true, type-reference={inplace=false, type-reference=ShapeReferPoints}  # Camera shape refernece points information.
    CameraFeatureVector: category=VECTOR, cpp-template-argument{inplace=false, template-type=CameraFeature}  # Represents a list of camerqa feature information.
      namespaces:
        symbol props ara
        symbol props adi
        symbol props sensoritf
    CameraFeatures: category=STRUCTURE  # Represents the camera feature interface information.
      namespaces:
        symbol props ara
        symbol props adi
        symbol props sensoritf
      5 x cpp implementation data type element:
        CFHeader: type-reference={inplace=false, type-reference=CameraGeneralHeader}  # Represents the header of a Camera feature interface.
        RecognizedFeaturesCap: is-optional=true, type-reference={inplace=false, type-reference=uint32_t}  # To indicate the guaranted recongnized features.
        RecognizedFeaturesStatus: is-optional=true, type-reference={inplace=false, type-reference=RecognizedStatus}  # The recongnized camera features status.
        NoValidFeatures: type-reference={inplace=false, type-reference=uint32_t}  # The number of valid camera features in the message.
        CFeatueList: type-reference={inplace=false, type-reference=CameraFeatureVector}  # Represents a list of camera features .
    CameraGeneralHeader: category=STRUCTURE  # Represents the Genreal header infomation for Camera.
      namespaces:
        symbol props ara
        symbol props adi
        symbol props sensoritf
      cpp implementation data type element Basic: type-reference={inplace=false, type-reference=HeaderBasic}  # Represents the basic infor of the message header.
      cpp implementation data type element VehicleCoordinateST: type-reference={inplace=false, type-reference=VehicleCoordinateSystemType}  # Represents the vehicle coordinate system type.
      cpp implementation data type element ColourModelType: type-reference={inplace=false, type-reference=ColourModelType}  # Represents Colour model type of a camera sensor.
    CapabilityVector: category=VECTOR, cpp-template-argument=bool  # To identify presence of optional signal. The exact bit reference is denfined in the specification. For each service, there is exact one capabilityVector table, which is deifined in chapter 10.
      namespaces:
        symbol props ara
        symbol props adi
        symbol props sensoritf
    ColourModelType:  # To identify the applied colour model in the service.
      compu {0x00=kGrey (Grey scale – 1 colour value is used for grey value.), 0x01=kRGB (Red, green, blue – 3 colour values are used for the values for red, green, blue.), 0x02=kHSV (Hue, saturation, value – 3 colour values are used for the values for hue, saturation, value.), 0x03=kLUV (Luminance and colour coordinates U, V – 3 colour values are used for the values for hue, saturation, value.), 0x04=kColourList (Each value reference a pre-defined colour – 1 colour value.)}
      range raw 0x00..0x04
      type-reference=uint8_t
      namespaces:
        symbol props ara
        symbol props adi
        symbol props sensoritf
    ColourType: compu {0x00=kRed (The spot colour is red.), 0x01=kYellow (The spot colour is yellow.), 0x02=kGreen (The spot colour is green.), 0x03=kWhite (The spot colour is white.), 0x04=kUnknown (The spot colour is unknown.)}, range raw 0x00..0x04, type-reference=uint8_t  # Colour of light spot.
      namespaces:
        symbol props ara
        symbol props adi
        symbol props sensoritf
    ColourTypeInfo: category=STRUCTURE  # Represents the colour type and probability.
      namespaces:
        symbol props ara
        symbol props adi
        symbol props sensoritf
      cpp implementation data type element CType: type-reference={inplace=false, type-reference=ColourType}  # Represents the colour type.
      cpp implementation data type element ColourTypeProbability: type-reference={inplace=false, type-reference=ProPercentage}  # Represents the colour type probability.
    ColourTypeInfoVector: category=VECTOR, cpp-template-argument{inplace=false, template-type=ColourTypeInfo}  # Represents a list of colour type.
      namespaces:
        symbol props ara
        symbol props adi
        symbol props sensoritf
    ColourValueVector: category=VECTOR, cpp-template-argument=float  # Represents a list of Colour Value.
      namespaces:
        symbol props ara
        symbol props adi
        symbol props sensoritf
    ConnectionInfo: category=STRUCTURE  # Represents the road marking connection information.
      namespaces:
        symbol props ara
        symbol props adi
        symbol props sensoritf
      cpp implementation data type element Type: type-reference={inplace=false, type-reference=ConnectionType}  # Represents the road marking connection type.
      cpp implementation data type element ConnectionID: type-reference={inplace=false, type-reference=uint8_t}  # Represents the road condition type probability.
    ConnectionInfoVector: category=VECTOR, cpp-template-argument{inplace=false, template-type=ConnectionInfo}  # Represents a list of Road marking connection information.
      namespaces:
        symbol props ara
        symbol props adi
        symbol props sensoritf
    ConnectionType:  # To identify the type of connection of at least two road markings, polylines or polynomials.
      compu {0x00=kMerge (The connection of road markings is a merge of road markings.), 0x01=kSplit (The connection of road markings is a split of road markings.), 0x02=kInterconnection (The connection of road markings is an interconnection of road markings.), 0x03=kExtension (The connection of road markings is an extension of two road markings.), 0x04=kUnknown (The connection type is unknown.)}
      range raw 0x00..0x04
      type-reference=uint8_t
      namespaces:
        symbol props ara
        symbol props adi
        symbol props sensoritf
    DataQualifier:  # To identify the data quality of the transmitted data.
      compu {0x00=kNormal (Information can be used without restriction.), 0x01=kNotAvailable (Information from the senor is not available.), 0x02=kReduceInCoverage (Reported data are from the sensor in a restricted view.), 0x03=kReduceInPerformance (Reported data are from the sensor in a restricted performance.), 0x04=kReduceInViewAndPerformance (Reported data are from the sensor in a restricted view and performance.), 0x05=kTestMode (Reported data are from the sensor in a test mode.), 0x06=kInvalid (Mesaurement cycle was invalid and no valid objects will be reported.), 0x07=kUnknown (Datat quality is unknown.)}
      range raw 0x00..0x07
      type-reference=uint8_t
      namespaces:
        symbol props ara
        symbol props adi
        symbol props sensoritf
    DetectionClassType:  # The classification type for the shape.
      compu {0x00=kNoClassification (Detection entity is not classified.), 0x01=kNoise (Detection entity is noise.), 0x02=kObstacle (Detection entity is an obstacle for vehicle.), 0x03=kUnderdriveable (Detection entity is underdrivable for vehicle.), 0x04=kOverdrivable (Detection entity is overdrivable for vehicle.), 0x05=kNearest (Detection entity is the nearest detection of a measurement.), 0x06=kStrongest (Detection entity has the strongest signal of a measurement.), 0x07=kUnknown (The detection type is unknown.)}
      range raw 0x00..0x07
      type-reference=uint8_t
      namespaces:
        symbol props ara
        symbol props adi
        symbol props sensoritf
    DetectionClassTypeInfo: category=STRUCTURE  # Represents the detection class type information.
      namespaces:
        symbol props ara
        symbol props adi
        symbol props sensoritf
      cpp implementation data type element DClassType: is-optional=true, type-reference={inplace=false, type-reference=DetectionClassType}  # Represents the detection class type.
      cpp implementation data type element DetectionClassPro: is-optional=true, type-reference={inplace=false, type-reference=ProPercentage}  # A probability for the corresponding Detection classification type. %
    DetectionClassTypeInfoVector: category=VECTOR, cpp-template-argument{inplace=false, template-type=DetectionClassTypeInfo}  # Represents a list of detection class type information.
      namespaces:
        symbol props ara
        symbol props adi
        symbol props sensoritf
    DetectionRange: category=STRUCTURE  # Sensor detection range for one object type with Minimum classification rate this object type and Maximum false positive rate for this object type. (m, m)
      namespaces:
        symbol props ara
        symbol props adi
        symbol props sensoritf
      cpp implementation data type element Min: type-reference=float  # The Minimum value.
      cpp implementation data type element Max: type-reference=float  # The Maximum.
    DetectionStatus: category=STRUCTURE  # Represents the dynamics of the detections.
      namespaces:
        symbol props ara
        symbol props adi
        symbol props sensoritf
      4 x cpp implementation data type element:
        DetectionExistPro: type-reference=ProPercentage  # Existence probability of the detection.
        FeatureID: is-optional=true, type-reference=uint16_t  # Feature ID of the feature to which this detection is associated to; invalid = “no associated Feature” e.g. for the first detection cycle.
        ObjectID: is-optional=true, type-reference=uint16_t  # Object ID of the object to which this feature is associated to; invalid = “no associated object” e.g. first detection cycle.
        TimestampDiff: type-reference=uint64_t  # Each detection entity can have an individual time stamp, i.e. a time stamp difference to the Time stamp – measurement
    DimensionBox: category=STRUCTURE  # Represents the dimension of the bounding box. The unit is {m,m,m}.
      namespaces:
        symbol props ara
        symbol props adi
        symbol props sensoritf
      cpp implementation data type element Length: type-reference=float  # Represents the length.
      cpp implementation data type element Width: type-reference=float  # Represents the width.
      cpp implementation data type element Height: is-optional=true, type-reference=float  # Represents the Height.
    DimensionBoxError: category=STRUCTURE  # Represents the Error value of the bounding box, the unit is {m,m,m}.
      namespaces:
        symbol props ara
        symbol props adi
        symbol props sensoritf
      cpp implementation data type element Length: type-reference=float  # Represents the Error value in Length.
      cpp implementation data type element Width: type-reference=float  # Represents the Error value in Width.
      cpp implementation data type element Height: is-optional=true, type-reference=float  # Represents the Error value in Height.
    EllipseAxesError: category=STRUCTURE  # EDistributed sender/receiver sensor (virtual sensor) the distance is the ellipse’s semi-major axis of the detection. Single sensor (real sensor) the semi-major axis is the radius of the detection.
      namespaces:
        symbol props ara
        symbol props adi
        symbol props sensoritf
      cpp implementation data type element SemiMinor: type-reference=float  # Represents the ellipse’s semi-minor axis error value of the detection.
      cpp implementation data type element SemiMajor: is-optional=true, type-reference=float  # Represents the ellipse’s semi-major axis error value of the detection.
    FOVReductionInfo: category=STRUCTURE  # Represents the FOV reduction related information.
      namespaces:
        symbol props ara
        symbol props adi
        symbol props sensoritf
      cpp implementation data type element NoValidReductionReasons: type-reference=uint8_t  # Represents the number of Valid FOV Redcution Reasons.
      cpp implementation data type element FOVReductionTypeList: type-reference={inplace=false, type-reference=FOVReductionTypeInfoVector}  # Represents a list of FOV Redcution related information.
    FOVReductionTypeInfo: category=STRUCTURE  # Represents the FOV Reduction type information.
      namespaces:
        symbol props ara
        symbol props adi
        symbol props sensoritf
      cpp implementation data type element FOVReductionType: type-reference={inplace=false, type-reference=FieldOfViewReductionType}  # Represents the Field Of View Reduction reason type.
      cpp implementation data type element FieldOfViewReductionTypePro: type-reference={inplace=false, type-reference=ProPercentage}  # Probability of FOV reduction of the segment by Field of view reduction reason type.
    FOVReductionTypeInfoVector: category=VECTOR, cpp-template-argument{inplace=false, template-type=FOVReductionTypeInfo}  # Represents a list of FOV reduction reason type information.
      namespaces:
        symbol props ara
        symbol props adi
        symbol props sensoritf
    FeatureStatus: category=STRUCTURE  # Represents the dynamics of the features.
      namespaces:
        symbol props ara
        symbol props adi
        symbol props sensoritf
      5 x cpp implementation data type element:
        FeatureExistPro: type-reference=ProPercentage  # Existence probability of the feature.
        FeatureID: is-optional=true, type-reference=uint16_t  # Unique identification number of the feature within the feature list.
        ObjectID: is-optional=true, type-reference=uint16_t  # Object ID of the object to which this feature is associated to; invalid = “no associated object” e.g. first feature cycle.
        TimestampDiff: type-reference=uint64_t  # Represents the amount of time that this object has been currently tracked.
        Observation: is-optional=true, type-reference=uint32_t  # Represents the last 32 cycles in which this feature has been currently tracked..
    FieldOfViewReductionType:  # Defines the overall blockage of the FOV segment.
      compu {0x00=kSnow (Range reduction due to snow.), 0x01=kRain (Range reduction due to rain.), 0x02=kClutter (Range reduction due to clutter.), 0x03=kFlyingLeaves (Range reduction due to flying leaves.), 0x04=kNightAndLights (Range reduction due to night and lights.), 0x05=kShades (Range reduction due to shades.), 0x06=kContrastIssues (Range reduction due to contrast issues.), 0x07=kJamming (Range reduction, e.g. electromagnetic compatibility.), 0x08=kDeviceInterference (Range reduction, e.g. electromagnetic compatibility.), 0x09=kSand (Range reduction due to sand.), 0x0A=kWetRoads (Range reduction due to wet roads.), 0x0B=kGhosts (Range reduction due to ghosts.), 0x0C=kSnowOnSensorSurface (Near range blockage due to snow on the sensor surface.), 0x0D=kWaterOnSensorSurface (Near range blockage due to water on the sensor surface.), 0x0E=kSoilOnSensorSurface (Near range blockage due to soil on the sensor surface.), 0x0F=kScratchesOnSensorSurface (Near range blockage due to scratches on the sensor surface.), 0x10=kUnknown (FOV Reduction type is unknown.)}
      range raw 0x00..0x10
      type-reference=uint8_t
      namespaces:
        symbol props ara
        symbol props adi
        symbol props sensoritf
    GeneralHeader: category=STRUCTURE  # Represents the Genreal header infomation.
      namespaces:
        symbol props ara
        symbol props adi
        symbol props sensoritf
      cpp implementation data type element Basic: type-reference={inplace=false, type-reference=HeaderBasic}  # Represents the basic infor of the message header.
      cpp implementation data type element VehicleCoordinateST: type-reference={inplace=false, type-reference=VehicleCoordinateSystemType}  # Represents the vehicle coordinate system type.
      cpp implementation data type element ColourModelType: is-optional=true, type-reference={inplace=false, type-reference=ColourModelType}  # Represents Colour model type of a camera sensor.
    GeneralLandmarks: category=STRUCTURE  # Represents the general landmarks Information.
      namespaces:
        symbol props ara
        symbol props adi
        symbol props sensoritf
      4 x cpp implementation data type element:
        RecognizedGeneralLandmarksCap: is-optional=true, type-reference=uint16_t  # Represents the capability of the recognized general landmarks.
        RecognizedGeneralLandmarksStatus: is-optional=true, type-reference={inplace=false, type-reference=RecognizedStatus}  # The recongnized general landmarks Objects status.
        NoValidGeneralLandmarks: type-reference=uint16_t  # Represents the number of valid general landmarks objects.
        LandmarkList: type-reference={inplace=false, type-reference=LandmarkVector}  # Represents the list of general landmarks objects.
    GeometricStructures: compu {0x00=kWithoutMirrors (Geometrical structures don't include the mirrors.), 0x01=kWithMirrors (Geometrical structures include the Mirrors.), 0x02=kUnknow (Geometrical structures including the mirrors or not is unknown.)}, range raw 0x00..0x02, type-reference=uint8_t  # Represent the geometrical structures that are taken into account in the bounding boxes.
      namespaces:
        symbol props ara
        symbol props adi
        symbol props sensoritf
    HeaderBasic: category=STRUCTURE  # Represents the basic info of message header.
      namespaces:
        symbol props ara
        symbol props adi
        symbol props sensoritf
      8 x cpp implementation data type element:
        VersionID: type-reference={inplace=false, type-reference=Version}  # Represents the version of the message.
        SensorID: type-reference={inplace=false, type-reference=uint8_t}  # Represents the sensor logical identity.
        InterfaceID: is-optional=true, type-reference={inplace=false, type-reference=InterfaceID}  # Represents the interface identity of the message.
        TimeStampP: type-reference={inplace=false, type-reference=uint64_t}  # Time stamp at which the entities of the interface are consistent (not the time at which it was processed or at which it is transmitted) in the vehicle-global synchronized time.
        CycleCounter: is-optional=true, type-reference={inplace=false, type-reference=uint8_t}  # Continuous up counter to identify the message cycle of the interface. It counts up per "every cycle of a complete prediction/single measurement".
        ItfCycleTime: is-optional=true, type-reference={inplace=false, type-reference=uint32_t}  # To indicate the reporting cycle of the service, the unit is FFS.
        ItfCycleTimeV: is-optional=true, type-reference={inplace=false, type-reference=InterfaceCycleTimeVariation}  # Represents the interface cycle time variation.
        Qualifier: type-reference={inplace=false, type-reference=DataQualifier}  # Represents the data qualifier.
    HeaderBasicDetection: category=STRUCTURE  # Represents the basic info of service header.
      namespaces:
        symbol props ara
        symbol props adi
        symbol props sensoritf
      7 x cpp implementation data type element:
        VersionID: type-reference={inplace=false, type-reference=Version}  # Represents the version of the message.
        SensorID: type-reference={inplace=false, type-reference=uint8_t}  # Represents the sensor logical identity.
        IterfaceID: is-optional=true, type-reference={inplace=false, type-reference=InterfaceID}  # Represents the interface identity of the message.
        TimeStampM: type-reference={inplace=false, type-reference=uint64_t}  # Time stamp at which the measurement was taken (not the time at which it was processed or at which it is transmitted) in the vehicle-global synchronized time. Clock synchronization shall be ensured, depending on bus technology.
        ItfCycleTime: is-optional=true, type-reference={inplace=false, type-reference=uint32_t}  # Represents the interface cycle time.
        ItfCycleTimeV: is-optional=true, type-reference={inplace=false, type-reference=InterfaceCycleTimeVariation}  # Represents the interface cycle time variation.
        Qualifier: type-reference={inplace=false, type-reference=DataQualifier}  # Represents the data qualifier.
    HorizontalAngle: category=STRUCTURE  # FOV defined by opening angles in sensor XY-plane. (rad, rad)
      namespaces:
        symbol props ara
        symbol props adi
        symbol props sensoritf
      cpp implementation data type element Begin: type-reference=float  # The starting point.
      cpp implementation data type element End: type-reference=float  # The end point.
    InputSignalInfo: category=STRUCTURE  # Represents the input signal information.
      namespaces:
        symbol props ara
        symbol props adi
        symbol props sensoritf
      cpp implementation data type element InSignalType: type-reference={inplace=false, type-reference=SensorInputSignalType}  # Defines the input signal type.
      cpp implementation data type element InSingalStatus: type-reference={inplace=false, type-reference=SensorInputSignalStatus}  # Sensor input signal status.
    InputSignalInfoVector: category=VECTOR, cpp-template-argument{inplace=false, template-type=InputSignalInfo}  # Represents a list of input singal information.
      namespaces:
        symbol props ara
        symbol props adi
        symbol props sensoritf
    InterfaceCycleTimeVariation: range raw 0..100, type-reference=uint8_t  # To indicate the cycle time variation. It represents a linear value between 0% and 100%.
      namespaces:
        symbol props ara
        symbol props adi
        symbol props sensoritf
    InterfaceID:  # Uniquely identify the interface.
      compu {0x00=kPotentialMovingObject (The Potential Moving Object interface.), 0x01=kRoadObject (The Road Object interface.), 0x02=kStaticObject (The Static Object interface.), 0x03=kCameraFeature (The Camera Feature interface.), 0x04=kUltrasonicFeature (The Ultrasonic Feature interface.), 0x05=kRadarDetection (The Radar Detection interface.), 0x06=kLidarDetection (The Lidar Detection interface.), 0x07=kCameraDetection (The Camera Detection interface.), 0x08=kUltrasonicDetection (The Ultrasonic Detection interface.), 0x09=kSensorPerformance (The Sensor Performance interface.), 0x0A=kSensorHealthInformation (The Sensor Health interface.), 0x0B=kUnknown (The interface ID is unknown.)}
      range raw 0x00..0x0B
      type-reference=uint8_t
      namespaces:
        symbol props ara
        symbol props adi
        symbol props sensoritf
    InterpolationMethod: compu {0x00=kLinear (Linear interpolation between two sequential points.), 0x01=kSpline (Spline interpolation between two sequential points.), 0x02=kCubic (Cubic interpolation between two sequential points.), 0x03=kUnknown (Interpolation Method is unknown.)}, range raw 0x00..0x03, type-reference=uint8_t  # To identify the type of connection of at least two road markings, polylines or polynomials.
      namespaces:
        symbol props ara
        symbol props adi
        symbol props sensoritf
    LandMarkTypeCertainty: category=STRUCTURE  # Represents the ladmark type certainty Information.
      namespaces:
        symbol props ara
        symbol props adi
        symbol props sensoritf
      4 x cpp implementation data type element:
        ExistPro: type-reference=ProPercentage  # Represents the Landmark existance probablity.
        NoGeneralLandMarkClass: type-reference=uint8_t  # Represents the nubmer of the general landmark class type list.
        LandmarkTypelist: type-reference={inplace=false, type-reference=LandmarkTypeVector}  # Represents the general landmark class list.
        LandmarkClassConfidence: type-reference=ProPercentage  # Represents the general landmark class confidence. %
    Landmark: category=STRUCTURE  # Represents the landmark Information.
      namespaces:
        symbol props ara
        symbol props adi
        symbol props sensoritf
      4 x cpp implementation data type element:
        Landmarkstatus: type-reference={inplace=false, type-reference=ObjectStatus}  # Represents the Landmark status.
        LandmarkTypeCen: type-reference={inplace=false, type-reference=LandMarkTypeCertainty}  # Represents the certainty of a landmark type clas.
        LandmarkPos: type-reference={inplace=false, type-reference=Landmarkposition}  # Represents the landmark position information.
        LandmarkBoundingbox: is-optional=true, type-reference={inplace=false, type-reference=BboxInfo}  # Represents the landmark bounding box information. Relevant: camera
    LandmarkClass:  # Classification of the general landmark.
      compu {0x00=kBridge (Bridge as general landmark.), 0x01=kBeacon (Beacon as general landmark.), 0x02=kCone (Cone as general landmark.), 0x03=kBarrel (TBarrel as general landmark.), 0x04=kGuidePost (Guide post as general landmark.), 0x05=kLampPost (Lamp post as general landmark.), 0x06=kVerticalStructure (Vertical structure as general landmark.), 0x07=kOverheadObject (Overhead object as general landmark.), 0x08=kRectangularStructure (Rectangular structure as general landmark.), 0x09=kTunnel (Tunnel as general landmark.), 0x0A=kReflector (Reflector as general landmark.), 0x0B=kUnknown (The landmark class is unknown.)}
      range raw 0x00..0x0B
      type-reference=uint8_t
      namespaces:
        symbol props ara
        symbol props adi
        symbol props sensoritf
    LandmarkType: category=STRUCTURE  # Represents the general landmark type and probability.
      namespaces:
        symbol props ara
        symbol props adi
        symbol props sensoritf
      cpp implementation data type element GeneralLandMarkType: type-reference={inplace=false, type-reference=LandmarkClass}  # Represents the general landmark type.
      cpp implementation data type element LandmarkClassProbability: type-reference={inplace=false, type-reference=ProPercentage}  # Represents the Landmark class type probability.
    LandmarkTypeVector: category=VECTOR, cpp-template-argument{inplace=false, template-type=LandmarkType}  # Represents a list of Landmark type.
      namespaces:
        symbol props ara
        symbol props adi
        symbol props sensoritf
    LandmarkVector: category=VECTOR, cpp-template-argument{inplace=false, template-type=Landmark}  # Represents a list of Landmark.
      namespaces:
        symbol props ara
        symbol props adi
        symbol props sensoritf
    Landmarkposition: category=STRUCTURE  # Represents the landmark position.
      namespaces:
        symbol props ara
        symbol props adi
        symbol props sensoritf
      5 x cpp implementation data type element:
        RPs: is-optional=true, type-reference={inplace=false, type-reference=ReferencePoints}  # Represent outer edges of the recognized object’s bounding box.
        Position: type-reference={inplace=false, type-reference=Point3D}  # Represents the position of the object, and the unit is {m,m,m}.
        PositionError: type-reference={inplace=false, type-reference=Point3DError}  # Represents the Error Value of the object, the unit is {m,m,m}.
        OrientationVertical: is-optional=true, type-reference={inplace=false, type-reference=float}  # Represents the rotation of the static object at the given [x, y, z] coordinates around the vertical axis of the object. rad
        OrientationVerticalError: is-optional=true, type-reference={inplace=false, type-reference=float}  # Represents the Error Value of the object orientation, with the unit rad.
    LaneBoundaryRole:  # Definition of the road boundary role w.r.t. the ego-vehicle lane.
      compu {0x00=kHostLeft (The lane boundary role is left to the ego-vehicle.), 0x01=kHostRight (The lane boundary role is right to the ego-vehicle.), 0x02=kAdjacentLeft (The lane boundary role is to the left adjacent ego-vehicle lane.), 0x03=kAdjacentRight (The lane boundary role is to the right adjacent ego-vehicle lane.), 0x04=kNotValid (The road boundary is not valid as lane boundary.), 0x05=kUnknown (The road boundary role is unknown.)}
      range raw 0x00..0x05
      type-reference=uint8_t
      namespaces:
        symbol props ara
        symbol props adi
        symbol props sensoritf
    LaneInfo: category=STRUCTURE  # Represents the lane related information.
      namespaces:
        symbol props ara
        symbol props adi
        symbol props sensoritf
      4 x cpp implementation data type element:
        LaneAssociation: type-reference={inplace=false, type-reference=ObjectLaneAssociation}  # Represents the lane associated information of an object.
        Angles: is-optional=true, type-reference={inplace=false, type-reference=Angle2ObjectEdge2Line}  # Represents the angles to object edge to lane {left edge right lane, right edge left lane} .
        AngleError: is-optional=true, type-reference={inplace=false, type-reference=Angle2ObjectEdge2LineError}  # The Error Value of the angles to object edge to lane {left edge right lane, right edge left lane}.
        Percentage: is-optional=true, type-reference={inplace=false, type-reference=PercentageSideLane}  # Represnets percentage value of the object width in the corresponding {left, right} lane.
    LaneRelevance:  # Information if the sign is relevant for the ego-vehicle’s lane, the nearest lane to the ego-vehicle or other relevant lanes.
      compu {0x00=kOnTrack (Relevant on track of ego-vehicle.), 0x01=kNextLaneLeft (Relevant for the next lane to the ego-vehicle on the left site.), 0x02=kNextLaneRight (Relevant for the next lane to the ego-vehicle on the right site.), 0x03=kNextNextLaneLeft (Relevant for the second next lane to the ego-vehicle on the left site.), 0x04=kNextNextLaneRight (Relevant for the second next lane to the ego-vehicle on the right site.), 0x05=kOnTrackAndNextLaneLeft (Relevant on track of ego-vehicle and the next left lane.), 0x06=kOnTrackAndNextLaneRight (Relevant on track of ego-vehicle and the next right lane.), 0x07=kMostLeftLane (Relevant for the leftest lane.), 0x08=kMostRightLane (Relevant for the rightest lane.), 0x09=kAllLanes (Relevant for all lanes, lane to the right and left site and on track.), 0x0A=kOtherLane (Relevant for another far lane.), 0x0B=kUnknown (The lane relevance is unknown.)}
      range raw 0x00..0x0B
      type-reference=uint8_t
      namespaces:
        symbol props ara
        symbol props adi
        symbol props sensoritf
    LidarDetection: category=STRUCTURE  # Represents the lidar detection information.
      namespaces:
        symbol props ara
        symbol props adi
        symbol props sensoritf
      cpp implementation data type element LDetectionStatus: type-reference={inplace=false, type-reference=DetectionStatus}  # Represnets the lidar detection status.
      cpp implementation data type element LDetetionInfo: type-reference={inplace=false, type-reference=LidarDetectionInfo}  # Lidar detection information.
    LidarDetectionInfo: category=STRUCTURE  # Represents the lidar detection information.
      namespaces:
        symbol props ara
        symbol props adi
        symbol props sensoritf
      10 x cpp implementation data type element:
        PositionSpheric: type-reference={inplace=false, type-reference=Position3DSpheric}  # Represents the position of the detection, and the unit is {rad,rad,m}.
        PositionSphericError: type-reference={inplace=false, type-reference=Position3DSphericError}  # Represents the Error Value of the detection, the unit is {rad,rad,m}.
        HeightLidar: is-optional=true, type-reference={inplace=false, type-reference=float}  # Height field is required if multiple scan points are vertically clustered..m
        HeightLidarError: is-optional=true, type-reference={inplace=false, type-reference=float}  # Error value of the detection Height. m
        RadialRelVelocity: is-optional=true, type-reference={inplace=false, type-reference=float}  # Radial relative velocity (in direction to the sensor) of the detection. m/s
        RadialRelVelocityError: is-optional=true, type-reference={inplace=false, type-reference=float}  # Error value of the detection measured Radial relative velocity.m/s
        Reflectivity: type-reference={inplace=false, type-reference=float}  # Reflectivity of the detection w.r.t. norm target.%
        ReflectivityError: is-optional=true, type-reference={inplace=false, type-reference=float}  # Error value of the detection’s Reflectivity. %
        FreeSpacePro: is-optional=true, type-reference={inplace=false, type-reference=ProPercentage}  # The Free space probability in the range [0, 100] % from the origin up to this detection, as given by the distance. %
        LidarClassType: is-optional=true, type-reference={inplace=false, type-reference=DetectionClassType}  # Represents an lidar detection class type .
    LidarDetectionVector: category=VECTOR, cpp-template-argument{inplace=false, template-type=LidarDetection}  # Represents a list of lidar detection information.
      namespaces:
        symbol props ara
        symbol props adi
        symbol props sensoritf
    LidarDetections: category=STRUCTURE  # Represents the lidar detection interface information.
      namespaces:
        symbol props ara
        symbol props adi
        symbol props sensoritf
      cpp implementation data type element Header: type-reference={inplace=false, type-reference=GeneralHeader}  # Represents the header of a lidar detection interface.
      cpp implementation data type element SensorMountingPos: type-reference={inplace=false, type-reference=SensorMountingInfo}  # The recongnized Lidar Mounting position.
      cpp implementation data type element LDetectionsInfo: type-reference={inplace=false, type-reference=LidarDetectionsInfo}  # Represents the lidar detections information .
    LidarDetectionsInfo: category=STRUCTURE  # Represents the lidar detections information.
      namespaces:
        symbol props ara
        symbol props adi
        symbol props sensoritf
      4 x cpp implementation data type element:
        RecognizedDetectionsCap: is-optional=true, type-reference=uint32_t  # To indicate the guaranted recongnized detections.
        RecognizedDetectionsStatus: is-optional=true, type-reference={inplace=false, type-reference=RecognizedStatus}  # The recongnized lidar detections status.
        NoValidDetections: type-reference=uint32_t  # The number of valid lidar detections in the message.
        LidarDetectionList: type-reference={inplace=false, type-reference=LidarDetectionVector}  # Represents a list of lidar detections .
    Light: category=STRUCTURE  # Represents the light information including light type and light status.
      namespaces:
        symbol props ara
        symbol props adi
        symbol props sensoritf
      cpp implementation data type element PMOLightType: type-reference={inplace=false, type-reference=LightType}  # Represents one light type of a tracked object .
      cpp implementation data type element PMOLightStatus: type-reference={inplace=false, type-reference=LightStatus}  # Represents the status of the relevant light .
    LightModeType: compu {0x00=kContinuous (Light source is continuous on.), 0x01=kBlinking (One light source is blinking), 0x02=kTurnedOff (Light source is turned off.), 0x03=kCounting (Light source with counting.), 0x04=kUnknown (Light Mode type is unknown.)}, range raw 0x00..0x04, type-reference=uint8_t  # The light’s mode.
      namespaces:
        symbol props ara
        symbol props adi
        symbol props sensoritf
    LightModeTypeInfo: category=STRUCTURE  # Represents the traffic light mode type and probability.
      namespaces:
        symbol props ara
        symbol props adi
        symbol props sensoritf
      cpp implementation data type element LModeType: type-reference={inplace=false, type-reference=LightModeType}  # Represents the traffic light mode type.
      cpp implementation data type element LightModeProbability: type-reference={inplace=false, type-reference=ProPercentage}  # Represents the traffic light mode type probability.
    LightModeTypeInfoVector: category=VECTOR, cpp-template-argument{inplace=false, template-type=ColourTypeInfo}  # Represents a list of traffic light mode type.
      namespaces:
        symbol props ara
        symbol props adi
        symbol props sensoritf
    LightShape:  # The light’s shape.
      compu {0x00=kNoShape (No additional shape.), 0x01=kArrowStraightAhead (Arrow straight ahead shape.), 0x02=kArrowLeft (Arrow left shape.), 0x03=kArrowDiagLeft (Arrow diagonal left shape.), 0x04=kArrowStraightAheadLeft (Arrow straight ahead and arrow left shape.), 0x05=kArrowRight (Arrow right shape.), 0x06=kArrowDiagRight (Arrow diagonal right shape.), 0x07=kArrowStraightAheadRight (Arrow straight ahead and arrow right shape.), 0x08=kArrowLeftRight (Arrow left and arrow right shape.), 0x09=kArrowDown (Arrow down shape.), 0x0A=kArrowDownLeft (Arrow U-turn left shape.), 0x0B=kArrowDownRight (Arrow U-turn right shape.), 0x0C=kCross (Cross figure.), 0x0D=kPedestrian (Pedestrian figure.), 0x0E=kWalk (Text walk figure.), 0x0F=kDontWalk (Text don’t walk figure.), 0x10=kBicycle (Bicycle figure.), 0x11=kPedestrianAndBicycle (Pedestrian and bicycle figure.), 0x12=kCountdownSecond (Countdown in seconds figure.Signal Light shape value contains the value in s.), 0x13=kCountdownPercent (Countdown in percent figure. Signal Light shape value contains the value in %.), 0x14=kTram (Tram figure.), 0x15=kBus (Bus figure.), 0x16=kBusAndTram (Bus and Tram figure.), 0x17=kUnknown (The light shape is unknown.)}
      range raw 0x00..0x17
      type-reference=uint8_t
      namespaces:
        symbol props ara
        symbol props adi
        symbol props sensoritf
    LightStatus: compu {0x00=kOff (ight status is off.), 0x01=kOn (Light status is on.), 0x02=kFlash (Light status is cyclic flashing.), 0x03=kBrake (Light status indicates braking.), 0x04=kWarning (Light status indicates warning.), 0x06=kOther (Light status could not be determined.)}, range raw 0x00..0x05, type-reference=uint8_t  # Represents the status of an object's light.
      namespaces:
        symbol props ara
        symbol props adi
        symbol props sensoritf
    LightType:  # Represents the light classification.
      compu {0x00=kLeftFlashLight (Vehicle’s left flash light.), 0x01=kRightFlashLight (Probability type heavy truck.), 0x02=kHazardFlashLight (Vehicle’s hazard flash light.), 0x03=kLeftBrakeLight (Vehicle’s left break light.), 0x04=kRightBrakeLight (Vehicle’s right break light.), 0x05=kCentreBrakeLight (Vehicle’s centre break light.), 0x06=kLeftOtherLight (Vehicle’s left light (no flash or break light).), 0x07=kRightOtherLight (Vehicle’s right light (no flash or break light).), 0x08=kCentreOtherLight (Vehicle’s light not on the left or right site (no flash or break light).), 0x09=kUnknown (Light type unknown.)}
      range raw 0x00..0x09
      type-reference=uint8_t
      namespaces:
        symbol props ara
        symbol props adi
        symbol props sensoritf
    LightVector: category=VECTOR, cpp-template-argument{inplace=false, template-type=Light}  # Represents a list of light.
      namespaces:
        symbol props ara
        symbol props adi
        symbol props sensoritf
    MSignInfo: category=STRUCTURE  # Represents the main sign Information.
      namespaces:
        symbol props ara
        symbol props adi
        symbol props sensoritf
      5 x cpp implementation data type element:
        MSignValue: type-reference=float  # Represents the main sign value information.
        MSignUnit: type-reference={inplace=false, type-reference=SignValueUnit}  # Represents the main sign unit regarding the value.
        MSignGeometry: type-reference={inplace=false, type-reference=SignGeometry}  # Represents the main sign geometry information
        MVariableSign: type-reference={inplace=false, type-reference=VariableMessageSign}  # Represents the main sign is including variable information or not.
        MOoS: type-reference={inplace=false, type-reference=OutOfService}  # Represents the main sign service status information
    MSignPos: category=STRUCTURE  # Represents the main sign position.
      namespaces:
        symbol props ara
        symbol props adi
        symbol props sensoritf
      4 x cpp implementation data type element:
        MSignLaneR: type-reference={inplace=false, type-reference=LaneRelevance}  # Represent main sign lane relevance information.
        LaneRelevanceConfidence: type-reference={inplace=false, type-reference=ProPercentage}  # Represent main sign lane relevance confidence information.
        Position: type-reference={inplace=false, type-reference=Point3D}  # Represents the position of the object, and the unit is {m,m,m}.
        PositionError: type-reference={inplace=false, type-reference=Point3DError}  # Represents the Error Value of the object, the unit is {m,m,m}.
    MSignTypeInfo: category=STRUCTURE  # Represents the main sign type certainty Information.
      namespaces:
        symbol props ara
        symbol props adi
        symbol props sensoritf
      cpp implementation data type element ExistPro: type-reference=ProPercentage  # Represents the main sign existance probablity.
      cpp implementation data type element MSignType: type-reference={inplace=false, type-reference=SignType}  # Represents the main sign type.
      cpp implementation data type element SignTypeConfidence: type-reference=ProPercentage  # Represents the confidence information for the sign type, e.g. the confidence for a stop sign as main traffic sign. %
    MeasurementStatus: compu {0x00=kMeasured (The tracked object is measured.), 0x01=kNew (The tracked object is new.), 0x02=kPredicted (The result is by predicted.), 0x03=kPartiallyMeasured (The tracked object is partically measured.), 0x04=kInvalid (The measurement result is invalid.), 0x05=kPredictedOccluded (Tracked object is temporarily occluded by another entity.)}, range raw 0x00..0x05, type-reference=uint8_t  # Represent the measurement Status.
      namespaces:
        symbol props ara
        symbol props adi
        symbol props sensoritf
    MeasurementStatusFeature: compu-method=ShapeClassType, range raw 0x00..0x10, type-reference=uint8_t  # Information about the measurement status of the feature.
      namespaces:
        symbol props ara
        symbol props adi
        symbol props sensoritf
    MotionInfo: category=STRUCTURE  # Represents the motion related information.
      namespaces:
        symbol props ara
        symbol props adi
        symbol props sensoritf
      cpp implementation data type element AngularPositionA: type-reference=float  # Represents Lateral position of 2D bounding box centre measured in 2D image as angle in the sensor’s coordinate system {rad}.
      cpp implementation data type element angularVelocityA: type-reference=float  # Represents Angular velocity of 2D bounding box centre measured in 2D image in the sensor`s coordinate system.{rad/s}
    MotionType: compu {0x00=kRelativeValues (Relative motion values are used.), 0x01=kAbsoluteValues (Absolute motion values are used.)}, range raw 0x00..0x01, type-reference=uint8_t  # To identify the applied motion type in the message, i.e. absolute or relative motion values.
      namespaces:
        symbol props ara
        symbol props adi
        symbol props sensoritf
    MovementStatus: compu {0x00=kUnknow (The status is unknow.), 0x01=kStoppedMoving (The object stopped moving.), 0x02=kStationary (The object is stationary.), 0x03=kMoving (The object is moving.)}, range raw 0x00..0x03, type-reference=uint8_t  # Represent the relevance to ego vehicle road level.
      namespaces:
        symbol props ara
        symbol props adi
        symbol props sensoritf
    ObjectDetectionRateInfo: category=STRUCTURE  # Represents the Object Detection Rate information.
      namespaces:
        symbol props ara
        symbol props adi
        symbol props sensoritf
      5 x cpp implementation data type element:
        RObjectType: type-reference={inplace=false, type-reference=RecognizedObjectType}  # Defines the overall blockage of the FOV segment.
        ODetectionRange: type-reference={inplace=false, type-reference=DetectionRange}  # Sensor detection range for one object type with Minimum classification rate this object type and Maximum false positive rate for this object type. (m, m)
        MinimunClassRate: is-optional=true, type-reference={inplace=false, type-reference=ProPercentage}  # The estimated Minimum classification rate for a FOV segment, i.e. over the complete Detection range {min, max} . %
        MaxFalsePositiveRate: is-optional=true, type-reference={inplace=false, type-reference=ProPercentage}  # The estimated Maximum false positive rate for a FOV segment.
        PositivePredictiveValue: is-optional=true, type-reference={inplace=false, type-reference=ProPercentage}  # The estimated Positive predictive value for a FOV segment.
    ObjectDetectionRateInfoVector: category=VECTOR, cpp-template-argument{inplace=false, template-type=ObjectDetectionRateInfo}  # Represents a list of Object Detection Rate information.
      namespaces:
        symbol props ara
        symbol props adi
        symbol props sensoritf
    ObjectDetectionRates: category=STRUCTURE  # Represents the Object Detection Rate related information.
      namespaces:
        symbol props ara
        symbol props adi
        symbol props sensoritf
      cpp implementation data type element NoValidRecognizedObjectType: type-reference=uint8_t  # Represents the number of Valid Recongnized Object types.
      cpp implementation data type element ObjectDetectionRatesList: type-reference={inplace=false, type-reference=ObjectDetectionRateInfoVector}  # Represents a list of Object Detection Rates information.
    ObjectLaneAssociation:  # Represents an association of the object to neighbouring lanes
      compu {0x00=kEgoLine (Object is in ego lane.), 0x01=kLeftNeighbouringLane (Object is in left neighbouring lane.), 0x02=kRightNeighbouringLane (Object is in right neighbouring lane.), 0x03=kEgoRightLane (Object is located between ego and right neighbouring lane.), 0x04=kEgoLeftLane (Object is located between ego and left neighbouring lane.), 0x05=kUnknown (Object's lane association is unknown.)}
      range raw 0x00..0x05
      type-reference=uint8_t
      namespaces:
        symbol props ara
        symbol props adi
        symbol props sensoritf
    ObjectStatus: category=STRUCTURE  # Represents the dynamics of the possible moving objects.
      namespaces:
        symbol props ara
        symbol props adi
        symbol props sensoritf
      6 x cpp implementation data type element:
        ObjectID: is-optional=true, type-reference=uint16_t  # Represents the object identity in the list, which could be reused after a period not in use .
        GroupingObjectID: is-optional=true, type-reference=uint8_t  # Represents linked tracked objects of a group in a measurement cycle, and 0 means no associted with another object.
        Age: type-reference=uint64_t  # Represents the amount of time that this object has been currently tracked.
        Observation: is-optional=true, type-reference=uint32_t  # Represents the last 32 cycles in which this object has been currently tracked..
        TrackQuality: is-optional=true, type-reference=uint16_t  # Represents the track quality in a linear manner between 0 and 100 .
        PMOMeasurementStatus: type-reference={inplace=false, type-reference=MeasurementStatus}  # Represents the movement status of the PMO .
    Orientation3D: category=STRUCTURE  # Represents a 3 dimension vector {yaw, pitch,roll}, the unit will be vary according to the refering data type.
      namespaces:
        symbol props ara
        symbol props adi
        symbol props sensoritf
      cpp implementation data type element Yaw: type-reference=float  # Represents in yaw.
      cpp implementation data type element Pitch: type-reference=float  # Represents in pitch.
      cpp implementation data type element Roll: type-reference=float  # Represents in roll.
    Orientation3DError: category=STRUCTURE  # Represents Error value in 3 dimension vector {yaw, pitch, roll}, the unit will be vary according to the refering data type.
      namespaces:
        symbol props ara
        symbol props adi
        symbol props sensoritf
      cpp implementation data type element Yaw: type-reference=float  # Represents the Error value in yaw.
      cpp implementation data type element Pitch: type-reference=float  # Represents the Error value in pitch.
      cpp implementation data type element Roll: type-reference=float  # Represents the Error value in roll.
    OutOfService: compu {0x00=kInService (Message sign is in service.), 0x01=kFullOutOfService (Message sign is full out of service.), 0x02=kPartlyOutOfService (Part of the message sign is out of service.), 0x03=kOutOfView (Message sign is rotated.), 0x04=kUnknown (Message sign service status is unknown.)}, range raw 0x00..0x04, type-reference=uint8_t  # Traffic sign is out of service, e.g. the symbol is crossed out.
      namespaces:
        symbol props ara
        symbol props adi
        symbol props sensoritf
    PMOBoundingBox: category=STRUCTURE  # Represents the bounding box information of the possible moving objects.
      namespaces:
        symbol props ara
        symbol props adi
        symbol props sensoritf
      4 x cpp implementation data type element:
        BoxDimension: type-reference={inplace=false, type-reference=DimensionBox}  # Represents the dimension of the bounding box .
        BoxError: is-optional=true, type-reference={inplace=false, type-reference=DimensionBoxError}  # Represents the Error Value of the bounding box.
        GroundClearance: is-optional=true, type-reference={inplace=false, type-reference=float}  # Represents maximum height of the clearance area between ground and object lower shape.
        IncludedGeometricStructures: is-optional=true, type-reference={inplace=false, type-reference=GeometricStructures}  # Represents Geometrical structures that are taken into account in the bounding boxes..
    PMOCertainty: category=STRUCTURE  # Represents the certainty information regarding a possible moving object type.
      namespaces:
        symbol props ara
        symbol props adi
        symbol props sensoritf
      cpp implementation data type element PMOClassificationType: type-reference={inplace=false, type-reference=PMOClassificationType}  # Represents a classification type of the tracked object.
      cpp implementation data type element PMOTypeProbabilityValue: type-reference={inplace=false, type-reference=float}  # Represents the recognition quality and certainty of an object classification type.
    PMOCertaintyVector: category=VECTOR, cpp-template-argument{inplace=false, template-type=PMOCertainty}  # Represents a list of PMOCertainty.
      namespaces:
        symbol props ara
        symbol props adi
        symbol props sensoritf
    PMOClassificationType:  # Represents the potentially moving object classification probability type.
      compu {0x00=kCar (Probability type car.), 0x01=kHeavyTruck (Probability type heavy truck.), 0x02=kVan (Probability type van.), 0x03=kBus (Probability type bus.), 0x04=kTrailer (Probability type trailer.), 0x05=kSemitrailer (Probability type semitrailer.), 0x06=kTram (Probability type tram.), 0x07=kTrain (Probability type train.), 0x08=kOtherVehicle (Probability type unidentified vehicle.), 0x09=kMotorbike (Probability type motorbike.), 0x0A=kAnimal (Probability type animal.), 0x0B=kBicycle (Probability type bicycle.), 0x0C=kTricycle (Probability type tricycle.), 0x0D=kPedestrian (Probability type pedestrian.), 0x0E=kWheelchair (Probability type wheelchair.), 0x0F=kUnknown (Probability type unknown.)}
      range raw 0x00..0x0F
      type-reference=uint8_t
      namespaces:
        symbol props ara
        symbol props adi
        symbol props sensoritf
    PMOHeader: category=STRUCTURE  # Represents the basic info of potential moving object message.
      namespaces:
        symbol props ara
        symbol props adi
        symbol props sensoritf
      4 x cpp implementation data type element:
        Basic: type-reference={inplace=false, type-reference=HeaderBasic}  # Represents the basic infor of the message header.
        VehicleCoordinateST: type-reference={inplace=false, type-reference=VehicleCoordinateSystemType}  # Represents the vehicle coordinate system type.
        TMModel: is-optional=true, type-reference={inplace=false, type-reference=TrackingMotionModel}  # Represents the tracking motion model.
        Motion: type-reference={inplace=false, type-reference=MotionType}  # Represents the motion type.
    PMOLights: category=STRUCTURE  # Represents the lights information of the tracked object.
      namespaces:
        symbol props ara
        symbol props adi
        symbol props sensoritf
      cpp implementation data type element noValidPMOLights: type-reference=uint8_t  # Represents the valid light type number in the list .
      cpp implementation data type element PMOLightList: type-reference={inplace=false, type-reference=LightVector}  # Represents the light list of the possible moving object.
    PMOPersonPose: category=STRUCTURE  # Represents the poses information of the tracked person.
      namespaces:
        symbol props ara
        symbol props adi
        symbol props sensoritf
      cpp implementation data type element noValidPersonPoses: type-reference=uint8_t  # Represents the valid person poses number in the list .
      cpp implementation data type element Poselist: type-reference={inplace=false, type-reference=PoseVector}  # Represents the pose list of the tracked person.
    PMOTypeCertainty: category=STRUCTURE  # Represents the certainty information regarding possible moving object types list.
      namespaces:
        symbol props ara
        symbol props adi
        symbol props sensoritf
      cpp implementation data type element ExistenceProbability: type-reference=uint16_t  # Represents the recognition quality and certainty of an object. 1~100% ; min: 0.0000152587890625; max: 0.9999847412109375; linear.
      cpp implementation data type element NoValidClassification: type-reference=uint8_t  # Represents the valid classification type in the list .
      cpp implementation data type element PMOCertaintyList: type-reference={inplace=false, type-reference=PMOCertaintyVector}  # Represents the centainty list of the possible moving object.
    PMObject: category=STRUCTURE  # Represents the possible moving objects tracked by a camera,radar, lidar or Ultrasonic.
      namespaces:
        symbol props ara
        symbol props adi
        symbol props sensoritf
      11 x cpp implementation data type element:
        PMObjectInfo: type-reference={inplace=false, type-reference=ObjectStatus}  # Represents the tracked object's basic status.
        ObjectDynamics: type-reference={inplace=false, type-reference=PMObjectDynamics}  # Represents the tracked object's dynamics.
        ObjectBoundingBox: is-optional=true, type-reference={inplace=false, type-reference=PMOBoundingBox}  # Represents the bounding box information of the tracked object. It is only for camera.
        ObjectTypeCertainty: type-reference={inplace=false, type-reference=PMOTypeCertainty}  # Represents the possible type information of the tracked object.
        ObjectLights: is-optional=true, type-reference={inplace=false, type-reference=PMOLights}  # Represents the light information of the tracked object. It is only for camera
        PersonPoses: is-optional=true, type-reference={inplace=false, type-reference=PMOPersonPose}  # Represents the person poses information.It is only for camera.
        LaneInforation: is-optional=true, type-reference={inplace=false, type-reference=LaneInfo}  # Represents the lane association information of the tracked object.
        PMOMotionInfo: is-optional=true, type-reference={inplace=false, type-reference=MotionInfo}  # Represents motion information of the tracked object.
        ScaleChange: is-optional=true, type-reference={inplace=false, type-reference=float}  # Represents change in scale of the object in sensor’s projection plane.%/s.It is only for camera
        EntityRCS: is-optional=true, type-reference={inplace=false, type-reference=float}  # Radar cross section of the recognized object.dB m2
        EntityLidarReflectivity: is-optional=true, type-reference={inplace=false, type-reference=float}  # Lidar reflectivity of the recognized object, assuming homogeneous Lambertian reflectivity for the used laser wave length.%
    PMObjectDynamics: category=STRUCTURE  # Represents the dynamics of the possible moving objects.
      namespaces:
        symbol props ara
        symbol props adi
        symbol props sensoritf
      15 x cpp implementation data type element:
        PMORPs: is-optional=true, type-reference={inplace=false, type-reference=ReferencePoints}  # Represent outer edges of the recognized object’s bounding box.
        PMOPosition: type-reference={inplace=false, type-reference=Point3D}  # Represents the position of the possible moving object, and the unit is {m,m,m}.
        PMOPositionError: type-reference={inplace=false, type-reference=Point3DError}  # Represents the Error value of the PMO position, the unit is {m,m,m}.
        PMOrientation: is-optional=true, type-reference={inplace=false, type-reference=Orientation3D}  # Represents the orientation of the possible moving object,with the unit {rad,rad,rad}.
        PMOrientationError: is-optional=true, type-reference={inplace=false, type-reference=Orientation3DError}  # Represents the Error value of the PMO orientation, with the unit {rad,rad,rad}.
        PMOVelocity: type-reference={inplace=false, type-reference=Point3D}  # Represents the velocity of the possible moving object, with the unit {m/s,m/s,m/s}.
        PMOVelocityError: is-optional=true, type-reference={inplace=false, type-reference=Point3DError}  # Represents the Error Value of the PMO velocity, with the unit {m/s,m/s,m/s}.
        PMOAcceleration: is-optional=true, type-reference={inplace=false, type-reference=Point3D}  # Represents the acceleration of the possible moving object, with the unit {m/s2,m/s2,m/s2}.
        PMOAccelerationError: is-optional=true, type-reference={inplace=false, type-reference=Point3DError}  # Represents the Error Value of the PMO acceleration, with the unit {m/s2,m/s2,m/s2}.
        KinematicPoint: is-optional=true, type-reference={inplace=false, type-reference=Point3D}  # Represents the position of the Kinematic Point, with the unit {m,m,m}.
        KPError: is-optional=true, type-reference={inplace=false, type-reference=Point3DError}  # Represents the Error Value of the Kinematic Point position, with the unit {m/s,m/s,m/s}.
        KPOrientation: is-optional=true, type-reference={inplace=false, type-reference=float}  # Represents the orientation rate kinematic point {yaw},{rad}.
        KPOrentationError: is-optional=true, type-reference={inplace=false, type-reference=float}  # Represents the Error Value of the Kinematic Point orientation,{rad}.
        PMORoadLevel: is-optional=true, type-reference={inplace=false, type-reference=Roadlevel}  # Represents the road level of the tracked object relenvant to the ego vehicle.
        PMOMovementStatus: is-optional=true, type-reference={inplace=false, type-reference=MovementStatus}  # Represents the movement status of the tracked object.
    PMObjectVector: category=VECTOR, cpp-template-argument{inplace=false, template-type=PMObject}  # Represents a list of PMO.
      namespaces:
        symbol props ara
        symbol props adi
        symbol props sensoritf
    PMObjects: category=STRUCTURE  # Represents the possible moving object informaiton provided by a camera,lidar, radar or Ultrasonic sensor.
      namespaces:
        symbol props ara
        symbol props adi
        symbol props sensoritf
      5 x cpp implementation data type element:
        PMOHeader: type-reference={inplace=false, type-reference=PMOHeader}  # Represents the header of a PMO interface.
        PMOCap: is-optional=true, type-reference={inplace=false, type-reference=uint16_t}  # To indicate the guarantted recongnized Possible Moving Objects.
        PMOStatus: is-optional=true, type-reference={inplace=false, type-reference=RecognizedStatus}  # The recongnized Possible Moving Objects status.
        NoValidPMO: type-reference={inplace=false, type-reference=uint16_t}  # The number of valid possible moving objects in the message.
        PMObjectList: type-reference={inplace=false, type-reference=PMObjectVector}  # Represents a list of PMO .
    PefSegmentInfo: category=STRUCTURE  # Represents the Performance sgement information.
      namespaces:
        symbol props ara
        symbol props adi
        symbol props sensoritf
      4 x cpp implementation data type element:
        PefStatus: type-reference={inplace=false, type-reference=SensorPerformanceStatus}  # Represents the performance status of a segment.
        PefFOVReductionInfo: type-reference={inplace=false, type-reference=FOVReductionInfo}  # Represents the performance FOV reduction related information.
        RealWorldODRates: is-optional=true, type-reference={inplace=false, type-reference=ObjectDetectionRates}  # Represents real world object detection rates.
        RefDetectionRates: is-optional=true, type-reference={inplace=false, type-reference=ReferenceTargetDetectionRates}  # Represents reference target detection rates.
    PefSegmentInfoVector: category=VECTOR, cpp-template-argument{inplace=false, template-type=PefSegmentInfo}  # Represents a list of performance segment information.
      namespaces:
        symbol props ara
        symbol props adi
        symbol props sensoritf
    PercentageSideLane: category=STRUCTURE  # Represents the percentage value of the object width in the corresponding {left, right} lane.
      namespaces:
        symbol props ara
        symbol props adi
        symbol props sensoritf
      cpp implementation data type element Left: type-reference=uint16_t  # Represents the left assignment of the object to specified lane in percent.
      cpp implementation data type element Right: type-reference=uint16_t  # Represents the right assignment of the object to specified lane in percent.
    PerformanceSegmentsInfo: category=STRUCTURE  # Represents the performance segments related information.
      namespaces:
        symbol props ara
        symbol props adi
        symbol props sensoritf
      cpp implementation data type element NoValidFoVSegments: type-reference=uint8_t  # The current Number of valid FOV segments.
      cpp implementation data type element PefSegmentsList: type-reference={inplace=false, type-reference=PefSegmentInfoVector}  # Represents a list of performance segments information.
    PersonPoseType:  # Represents the person pose possibility type.
      compu {0x00=kHead (The person head pose.), 0x01=kUpperBody (The person upper body pose.), 0x02=kLeftHand (Described angles are measured between the normal to the hand palm relative to the ego-vehicle axis system.), 0x03=kRightHand (Described angles are measured between the normal to the hand palm relative to the ego-vehicle axis system.), 0x04=kLeftLowerArm (Described angles are measured between long axis of the left lower arm relative to the ego-vehicle axis system.), 0x05=kRightLowerArm (Described angles are measured between long axis of the right lower arm relative to the ego-vehicle axis system.), 0x06=kRightUpperLeg (Described angles are measured between long axis of the right upper leg relative to the ego-vehicle axis system.), 0x07=kLeftUpperLeg (Described angles are measured between long axis of the left upper leg relative to the ego-vehicle axis system.), 0x08=kRightLowerLeg (Described angles are measured between long axis of the right lower leg relative to the ego-vehicle axis system.), 0x09=kLeftLowerLeg (Described angles are measured between long axis of the left lower leg relative to the ego-vehicle axis system.), 0x0A=kLeftFoot (Described angles are measured between long axis of the left foot relative to the ego-vehicle axis system.), 0x0B=kRightFoot (Described angles are measured between long axis of the right foot relative to the ego-vehicle axis system.), 0x0C=kUnknown (The person pose is unknown.)}
      range raw 0x00..0x0C
      type-reference=uint8_t
      namespaces:
        symbol props ara
        symbol props adi
        symbol props sensoritf
    Point2D: category=STRUCTURE  # Position with respect to the vehicle origin.
      namespaces:
        symbol props ara
        symbol props adi
        symbol props sensoritf
      cpp implementation data type element x: type-reference=float  # Represents in x dimension.
      cpp implementation data type element y: type-reference=float  # Represents in y dimension.
    Point2DError: category=STRUCTURE  # Error values for feature’s 2D position {x, y}.
      namespaces:
        symbol props ara
        symbol props adi
        symbol props sensoritf
      cpp implementation data type element x: type-reference=float  # Represents the Error value in x dimension.
      cpp implementation data type element y: type-reference=float  # Represents the Error value in y dimension.
    Point3D: category=STRUCTURE  # Represents a 3 dimension vector, the unit will be vary according to the refering data type.
      namespaces:
        symbol props ara
        symbol props adi
        symbol props sensoritf
      cpp implementation data type element x: type-reference=float  # Represents in x dimension.
      cpp implementation data type element y: type-reference=float  # Represents in y dimension.
      cpp implementation data type element z: is-optional=true, type-reference=float  # Represents in z dimension.
    Point3DError: category=STRUCTURE  # Represents Error value in 3 dimension vector, the unit will be vary according to the refering data type.
      namespaces:
        symbol props ara
        symbol props adi
        symbol props sensoritf
      cpp implementation data type element x: type-reference=float  # Represents the Error value in x dimension.
      cpp implementation data type element y: type-reference=float  # Represents the Error value in y dimension.
      cpp implementation data type element z: is-optional=true, type-reference=float  # Represents the Error value in z dimension.
    PolylineInfo: category=STRUCTURE  # Represents the Polyline related Information.
      namespaces:
        symbol props ara
        symbol props adi
        symbol props sensoritf
      cpp implementation data type element NoVertices: type-reference=uint8_t  # Number of valid vertices of a polyline. Polyline to describe a part of the shape border with one continuous segmented line.
      cpp implementation data type element Vertexpointlist: type-reference={inplace=false, type-reference=VertexPointInfoVector}  # Represents the Vertex point list.
    PolylineinfoVector: category=VECTOR, cpp-template-argument{inplace=false, template-type=PolylineInfo}  # Represents a list of Polyline information.
      namespaces:
        symbol props ara
        symbol props adi
        symbol props sensoritf
    Polylines: category=STRUCTURE  # Represents the Polylines Information.
      namespaces:
        symbol props ara
        symbol props adi
        symbol props sensoritf
      5 x cpp implementation data type element:
        NoConnections: type-reference=uint8_t  # Represents the number of connections.
        ConnectionList: type-reference={inplace=false, type-reference=ConnectionInfoVector}  # Represents the connection list.
        PInterpolationMethod: type-reference={inplace=false, type-reference=InterpolationMethod}  # Represent the used interpolation method for polylines.
        NoPolynomials: type-reference=uint8_t  # Number of valid polylines descriptions to describe a shape with multiple polylines.
        PolylineList: type-reference={inplace=false, type-reference=PolylineinfoVector}  # Represents the polyline list.
    PolynomialCoefficient: category=STRUCTURE  # Calculated coefficient. (m, 1, 1/m, 1/m2)
      namespaces:
        symbol props ara
        symbol props adi
        symbol props sensoritf
      4 x cpp implementation data type element, all with type-reference=float:
        C0  # Represents C0.
        C1  # Represents c1.
        C2  # Represents c2.
        C3  # Represents c3.
    PolynomialRange: category=STRUCTURE  # Valid range of the polynomial [x Start, x End].(m, m)
      namespaces:
        symbol props ara
        symbol props adi
        symbol props sensoritf
      cpp implementation data type element Start: type-reference=float  # The starting point.
      cpp implementation data type element End: type-reference=float  # The end point.
    Polynomials: category=STRUCTURE  # Represents the Polynomials related Information.
      namespaces:
        symbol props ara
        symbol props adi
        symbol props sensoritf
      4 x cpp implementation data type element:
        NoConnections: type-reference=uint8_t  # Represents the number of connections.
        ConnectionList: type-reference={inplace=false, type-reference=ConnectionInfoVector}  # Represents the connection list.
        NoPolynomials: type-reference=uint8_t  # Represents the number of Polynomials.
        PolynomialsList: type-reference={inplace=false, type-reference=PolynomialsInfoVector}  # Represents the polynomials list.
    PolynomialsInfo: category=STRUCTURE  # Represents the road marking type Information.
      namespaces:
        symbol props ara
        symbol props adi
        symbol props sensoritf
      11 x cpp implementation data type element:
        Coefficient: type-reference={inplace=false, type-reference=PolynomialCoefficient}  # Represents the coefficient parameters.
        PolynomialError: is-optional=true, type-reference={inplace=false, type-reference=float}  # Represents the Error Value.
        Range: type-reference={inplace=false, type-reference=PolynomialRange}  # Represents the range.
        WidthPolynomials: is-optional=true, type-reference={inplace=false, type-reference=float}  # The measured width at (x Start + x End)/2. The width is in the middle of the polyline resp. the polynomial. m
        WidthPolynomialsError: is-optional=true, type-reference={inplace=false, type-reference=float}  # The Error Value of the measured width at (x Start + x End)/2. m
        WidthPolynomialsConfidence: is-optional=true, type-reference={inplace=false, type-reference=ProPercentage}  # Represents the confidence of the width for the segment..
        HeightPolynomials: is-optional=true, type-reference={inplace=false, type-reference=float}  # The measured Height at (x Start + x End)/2. The height of the road boundary is added to the polyline resp. the polynomial.. m
        HeightPolynomialsError: is-optional=true, type-reference={inplace=false, type-reference=float}  # The Error Value of the measured Height at (x Start + x End)/2. m
        HeightPolynomialsConfidence: is-optional=true, type-reference={inplace=false, type-reference=ProPercentage}  # Represents the confidence of the Height for the segment.
        NoDataRanges: is-optional=true, type-reference={inplace=false, type-reference=uint8_t}  # Represents the number of valid data ranges for the polynomial line.
        DataRangeList: is-optional=true, type-reference={inplace=false, type-reference=SupportedDataRangeVector}  # Represents the data range list.
    PolynomialsInfoVector: category=VECTOR, cpp-template-argument{inplace=false, template-type=PolynomialsInfo}  # Represents a list of polynomials information.
      namespaces:
        symbol props ara
        symbol props adi
        symbol props sensoritf
    Pose: category=STRUCTURE  # Represents the Pose information including pose type and pose status.
      namespaces:
        symbol props ara
        symbol props adi
        symbol props sensoritf
      cpp implementation data type element PoseType: type-reference={inplace=false, type-reference=PersonPoseType}  # Represents one pose type of a tracked person.
      cpp implementation data type element PersonPoseInfo: type-reference={inplace=false, type-reference=Orientation3D}  # Represents the pose orientation .
      cpp implementation data type element PoseError: is-optional=true, type-reference={inplace=false, type-reference=Orientation3DError}  # The Error Value of the pose orientation.
    PoseVector: category=VECTOR, cpp-template-argument{inplace=false, template-type=Pose}  # Represents a list of Pose.
      namespaces:
        symbol props ara
        symbol props adi
        symbol props sensoritf
    Position3DSpheric: category=STRUCTURE  # Represents a 3 dimension vector, the unit will be vary according to the refering data type.
      namespaces:
        symbol props ara
        symbol props adi
        symbol props sensoritf
      cpp implementation data type element elevation: type-reference=float  # Represents in elevation dimension.
      cpp implementation data type element azimuth: type-reference=float  # Represents in azimuth dimension.
      cpp implementation data type element distance: is-optional=true, type-reference=float  # Represents in distance dimension.
    Position3DSphericError: category=STRUCTURE  # Error values of the {Azimuth, Elevation, Distance} to the Position {Azimuth, Elevation, Distance}.
      namespaces:
        symbol props ara
        symbol props adi
        symbol props sensoritf
      cpp implementation data type element elevation: type-reference=float  # Represents in elevation dimension.
      cpp implementation data type element azimuth: type-reference=float  # Represents in azimuth dimension.
      cpp implementation data type element distance: is-optional=true, type-reference=float  # Represents in distance dimension.
    ProPercentage: type-reference=float  # Represet probability in percentage.
      namespaces:
        symbol props ara
        symbol props adi
        symbol props sensoritf
    ROBoundaryType: category=STRUCTURE  # Represents the road boundary type Information.
      namespaces:
        symbol props ara
        symbol props adi
        symbol props sensoritf
      5 x cpp implementation data type element:
        Type: type-reference={inplace=false, type-reference=RoadBoundaryType}  # Represents the road boundary type.
        RoadBoundaryTypeConfidence: type-reference={inplace=false, type-reference=ProPercentage}  # Represents the road boundary type confidence.
        Role: type-reference={inplace=false, type-reference=LaneBoundaryRole}  # Represents the lande boundary role.
        LaneBoundaryRoleConfidence: type-reference={inplace=false, type-reference=ProPercentage}  # Represents the road boundary role confidence.
        RBProperties: is-optional=true, type-reference={inplace=false, type-reference=RoadBoundaryProperties}  # Only for Camera, Colour information.
    ROBoundaryTypeInfo: category=STRUCTURE  # Represents the road boundary type Information.
      namespaces:
        symbol props ara
        symbol props adi
        symbol props sensoritf
      cpp implementation data type element NoRoadBoundaryType: type-reference=uint8_t  # Represents the nubmer of the road boundary type list.
      cpp implementation data type element ROBoundaryTypeList: type-reference={inplace=false, type-reference=ROBoundaryTypeVector}  # Represents the road boundary type list.
    ROBoundaryTypeVector: category=VECTOR, cpp-template-argument{inplace=false, template-type=ROBoundaryType}  # Represents a list of road boundary type object information.
      namespaces:
        symbol props ara
        symbol props adi
        symbol props sensoritf
    ROMarkingT: category=STRUCTURE  # Represents the road marking type Information.
      namespaces:
        symbol props ara
        symbol props adi
        symbol props sensoritf
      10 x cpp implementation data type element:
        ROMarkingType: type-reference={inplace=false, type-reference=RoadMarkingType}  # Represents the road marking type.
        RoadMarkingTypeConfidence: type-reference={inplace=false, type-reference=ProPercentage}  # Represents the road markting type confidence.
        ArrowOrientation: is-optional=true, type-reference={inplace=false, type-reference=float}  # Represents the orientation of the arrow symbol on the ground plane with respect to the driving direction of the ego-vehicle. rad
        ArrowDirect: type-reference={inplace=false, type-reference=ArrowDirection}  # Represents the arrow direction.
        SignT: is-optional=true, type-reference={inplace=false, type-reference=SignType}  # Represents the sign type.
        SignTypeConfidence: is-optional=true, type-reference={inplace=false, type-reference=ProPercentage}  # Represents the sign type confidence.
        SignValue: is-optional=true, type-reference={inplace=false, type-reference=float}  # Represents the depicted numerical value on the sign.
        SignUnit: is-optional=true, type-reference={inplace=false, type-reference=SignValueUnit}  # Represnets the sign unit linked with the sign value.
        ColourValueList: is-optional=true, type-reference={inplace=false, type-reference=ColourValueVector}  # Definition of the colour value(s). Number of values depends on the Colour model type . %
        ColourConfidence: is-optional=true, type-reference={inplace=false, type-reference=ProPercentage}  # Represents the colour value confidence.
    ROMarkingTVector: category=VECTOR, cpp-template-argument{inplace=false, template-type=ROMarkingT}  # Represents a list of Road Marking type.
      namespaces:
        symbol props ara
        symbol props adi
        symbol props sensoritf
    RObjects: category=STRUCTURE  # Represents the road object informaiton provided by a camera,lidar, radar or Ultrasonic sensor.
      namespaces:
        symbol props ara
        symbol props adi
        symbol props sensoritf
      4 x cpp implementation data type element:
        ROheader: type-reference={inplace=false, type-reference=GeneralHeader}  # Represents the header of a Road Object interface.
        RoadSurface: is-optional=true, type-reference={inplace=false, type-reference=RoadSurface}  # Represents road surface information in a measurement cycle. At least one of Roadsurface, Roadmarking or Roadboundaries shall be in the inteface.
        ROmarkings: is-optional=true, type-reference={inplace=false, type-reference=Roadmarkings}  # Represents road marking information in a measurement cycle. At least one of Roadsurface, Roadmarking or Roadboundaries shall be in the inteface.
        ROBoundaries: is-optional=true, type-reference={inplace=false, type-reference=RoadBoundaries}  # Represents road boundary information in a measurement cycle. At least one of Roadsurface, Roadmarking or Roadboundaries shall be in the inteface.
    RadarDetection: category=STRUCTURE  # Represents the Radar detection information.
      namespaces:
        symbol props ara
        symbol props adi
        symbol props sensoritf
      cpp implementation data type element RDetectionStatus: type-reference={inplace=false, type-reference=DetectionStatus}  # Represnets the radar detection status.
      cpp implementation data type element RDetetionInfo: type-reference={inplace=false, type-reference=RadarDetectionInfo}  # Radar detection information.
    RadarDetectionInfo: category=STRUCTURE  # Represents the radar detection information.
      namespaces:
        symbol props ara
        symbol props adi
        symbol props sensoritf
      14 x cpp implementation data type element:
        PositionSpheric: type-reference={inplace=false, type-reference=Position3DSpheric}  # Represents the position of the detection, and the unit is {rad,rad,m}.
        PositionSphericError: type-reference={inplace=false, type-reference=Position3DSphericError}  # Represents the Error Value of the detection, the unit is {rad,rad,m}.
        RadialRelVelocity: type-reference={inplace=false, type-reference=float}  # Radial relative velocity (in direction to the sensor) of the detection. m/s
        RadialRelVelocityError: is-optional=true, type-reference={inplace=false, type-reference=float}  # Error value of the detection measured Radial relative velocity.m/s
        RCS: type-reference={inplace=false, type-reference=float}  # Radar cross section (RCS) of the detection.dB m2
        RCSError: is-optional=true, type-reference={inplace=false, type-reference=float}  # Error value of the detection’s Radar cross section. dB m2
        SNR: type-reference={inplace=false, type-reference=float}  # Signal to noise ratio of the detection. dB
        SNRError: is-optional=true, type-reference={inplace=false, type-reference=float}  # Error value of the detection’s Signal to noise ratio. dB
        MultiTargetPro: is-optional=true, type-reference={inplace=false, type-reference=ProPercentage}  # Describes the possibility if more than one real-world object has led to this detection.
        AmbiguityID: is-optional=true, type-reference={inplace=false, type-reference=uint16_t}  # Ambiguous measurement uses one Ambiguity ID for ambiguous detections candidates. Ambiguous detections (all detection candidates for the same measurement) are shown by the same Ambiguity ID
        DetectionAmbiguityPro: is-optional=true, type-reference={inplace=false, type-reference=ProPercentage}  # Probability for different hypothesis, sum is less or equal 100 % for all detections with the same Ambiguity ID . %
        FreeSpacePro: is-optional=true, type-reference={inplace=false, type-reference=ProPercentage}  # The Free space probability in the range [0, 100] % from the origin up to this detection, as given by the distance. %
        NoValidDetectionClass: is-optional=true, type-reference={inplace=false, type-reference=uint32_t}  # The current Number of valid detection classifications of the detection classifications. Classifications are defined by type and probability value.
        RDetectionClassTypeList: is-optional=true, type-reference={inplace=false, type-reference=DetectionClassTypeInfoVector}  # Represents a list of Radar detection class type .
    RadarDetectionVector: category=VECTOR, cpp-template-argument{inplace=false, template-type=RadarDetection}  # Represents a list of radar detection information.
      namespaces:
        symbol props ara
        symbol props adi
        symbol props sensoritf
    RadarDetections: category=STRUCTURE  # Represents the radar detection interface information.
      namespaces:
        symbol props ara
        symbol props adi
        symbol props sensoritf
      4 x cpp implementation data type element:
        Header: type-reference={inplace=false, type-reference=GeneralHeader}  # Represents the header of a radar detection interface.
        SensorMountingPos: type-reference={inplace=false, type-reference=SensorMountingInfo}  # The recongnized Ultrasonic features status.
        HeaderAmbiguityInfo: type-reference={inplace=false, type-reference=AmbiguityDomainInfo}  # The radar ambiguity information.
        RDetectionsInfo: type-reference={inplace=false, type-reference=RadarDetectionsInfo}  # Represents the radar detections information .
    RadarDetectionsInfo: category=STRUCTURE  # Represents the radar detections information.
      namespaces:
        symbol props ara
        symbol props adi
        symbol props sensoritf
      4 x cpp implementation data type element:
        RecognizedDetectionsCap: is-optional=true, type-reference=uint32_t  # To indicate the guaranted recongnized detections.
        RecognizedDetectionsStatus: is-optional=true, type-reference={inplace=false, type-reference=RecognizedStatus}  # The recongnized radar detections status.
        NoValidDetections: type-reference=uint32_t  # The number of valid radar detections in the message.
        RadarDetectionList: type-reference={inplace=false, type-reference=RadarDetectionVector}  # Represents a list of radar detections .
    RadialVelocityAmbiguityDomain: category=STRUCTURE  # The Doppler ambiguity caused by under sampling. m/s
      namespaces:
        symbol props ara
        symbol props adi
        symbol props sensoritf
      cpp implementation data type element Begin: type-reference=float  # The starting point.
      cpp implementation data type element End: type-reference=float  # The end point.
    RangeAmbiguityDomain: category=STRUCTURE  # The range of the ambiguity domain. m
      namespaces:
        symbol props ara
        symbol props adi
        symbol props sensoritf
      cpp implementation data type element Begin: type-reference=float  # The starting point.
      cpp implementation data type element End: type-reference=float  # The end point.
    RecognizedObjectType:  # Defines the overall blockage of the FOV segment.
      compu {0x00=kCar (Recognized entity is a car.), 0x01=kTruck (Recognized entity is a truck.), 0x02=kMotorBike (Recognized entity is a motor bike.), 0x03=kBicycle (Recognized entity is a bicycle.), 0x04=kPedestrian (Recognized entity is a pedestrian.), 0x05=kMovingObject (Recognized entity is an unknown moving object.), 0x06=kRoadBoundary (Recognized entity is a road boundary.), 0x07=kRoadMarking (Recognized entity is a road marking.), 0x08=kStaticObject (Recognized entity is a static object.), 0x09=kTrafficSign (Recognized entity is a traffic sign.), 0x0A=kTrafficLight (Recognized entity is a traffic light.), 0x0B=kUnknown (The Recognized Object Type is unknown.)}
      range raw 0x00..0x0B
      type-reference=uint8_t
      namespaces:
        symbol props ara
        symbol props adi
        symbol props sensoritf
    RecognizedStatus:  # To indicate the recognition process status of the sensor due to resource limitations.
      compu {0x00=kNormal (The performance of the sensor is enough to process all recognized entities. If additional entities would have been in the environment the sensor would have processed additional entities.), 0x01=kPreLimits (The performance of the sensor is close to the limits to process all recognized entities.), 0x02=kLimited (The performance of the sensor is not enough to process all recognized entities.), 0x03=kUnknown (The performance status of the sensor is unknown.)}
      range raw 0x00..0x03
      type-reference=uint8_t
      namespaces:
        symbol props ara
        symbol props adi
        symbol props sensoritf
    ReferTargetRateInfo: category=STRUCTURE  # Represents the Reference Target Rate information.
      namespaces:
        symbol props ara
        symbol props adi
        symbol props sensoritf
      6 x cpp implementation data type element:
        RCSRefTarget: is-optional=true, type-reference=float  # Radar cross section reference target of one defined reference target. Relevant: radar.
        ReflectivityRefTarget: is-optional=true, type-reference=float  # Reflectivity reference target (A.5.18) of one defined reference target. Relevant: lidar, ultrasonic
        DeltaEDiff: is-optional=true, type-reference=float  # This value is a measure of the minimum assumed colour difference of the shape relative to its background colour. Delta E is defined in ISO 11664-4. Relevant: camera
        RTSpeedRange: is-optional=true, type-reference={inplace=false, type-reference=RelativeSpeedRange}  # Relevant: radar.The relative Speed Range information.
        RTDetectionRange: type-reference={inplace=false, type-reference=DetectionRange}  # The reference target detection range information.
        SNRatio: type-reference=float  # Signal to noise ratio – supportive level (SNR) of the reference target detection.
    ReferTargetRateInfoVector: category=VECTOR, cpp-template-argument{inplace=false, template-type=ReferTargetRateInfo}  # Represents a list of Reference Target Rate information.
      namespaces:
        symbol props ara
        symbol props adi
        symbol props sensoritf
    ReferencePoints:  # Represent outer edges of the recognized object’s bounding box.
      compu {0x00=kFrontLeftTop (Front Left Top.), 0x01=kFrontMidwidthTop (Front Midwidth Top.), 0x02=kFrontRightTop (Front Right Top.), 0x03=kMidsideLeftTop (Midside Left Top.), 0x04=kMidsideMidwidthTop (Midside Midwidth Top.), 0x05=kMidsideRightTop (Midside Right Top.), 0x06=kRearLeftTop (Rear Left Top.), 0x07=kRearMidwidthTop (Rear Midwidth Top.), 0x08=kRearRightTop (Rear Right Top.), 0x09=kFrontLeftMidheight (Front Left Midheight.), 0x0A=kFrontMidwidthMidheight (Front Midwidth Midheight.), 0x0B=kFrontRightMidheight (Front Right Midheight.), 0x0C=kMidsideLeftMidheight (Midside Left Midheight.), 0x0D=kMidsideMidwidthMidheight (Midside Midwidth Midheight.), 0x0E=kMidsideRightMidheight (Midside Right Midheight.), 0x0F=kRearLeftMidheight (Rear Left Midheight.), 0x10=kRearMidwidthMidheight (Rear Midwidth Midheight.), 0x11=kRearRightMidheight (Rear Right Midheight.), 0x12=kFrontLeftBottom (Front Left Bottom.), 0x13=kFrontMidwidthBottom (Front Midwidth Bottom.), 0x14=kFrontRightBottom (Front Right Bottom.), 0x15=kMidsideLeftBottom (Midside Left Bottom.), 0x16=kMidsideMidwidthBottom (Midside Midwidth Bottom.), 0x17=kMidsideRightBottom (Midside Right Bottom.), 0x18=kRearLeftBottom (Rear Left Bottom.), 0x19=kRearMidwidthBottom (Rear Midwidth Bottom.), 0x1A=kRearRightBottom (Rear Right Bottom.), 0x1B=kUnknown (Unkonwn.)}
      range raw 0x00..0x1B
      type-reference=uint8_t
      namespaces:
        symbol props ara
        symbol props adi
        symbol props sensoritf
    ReferenceTargetDetectionRates: category=STRUCTURE  # Represents the Reference Target Rate related information.
      namespaces:
        symbol props ara
        symbol props adi
        symbol props sensoritf
      cpp implementation data type element NoValidRefDetectionClass: type-reference=uint8_t  # The current Number of valid reference detection classifications on detection level for reference targets.
      cpp implementation data type element ReferTargetRateList: type-reference={inplace=false, type-reference=ReferTargetRateInfoVector}  # Represents a list of refernece target Rates information.
    RelativePosition: compu {0x00=kAbove (Supplementary sign is above the main sign.), 0x01=kLeft (Message sign is full out of service.), 0x02=kBelow (Supplementary sign is below the main sign.), 0x03=kRight (Supplementary sign is right of the main sign.), 0x04=kUnknown (Relative position is unknown.)}, range raw 0x00..0x04, type-reference=uint8_t  # The relative position of the supplemental sign w.r.t. its main sign.
      namespaces:
        symbol props ara
        symbol props adi
        symbol props sensoritf
    RelativeSpeedRange: category=STRUCTURE  # Describes the relative radial speed range in the sensor coordinate system.
      namespaces:
        symbol props ara
        symbol props adi
        symbol props sensoritf
      cpp implementation data type element Min: type-reference=float  # The Minimum value.
      cpp implementation data type element Max: type-reference=float  # The Maximum.
    RoadBoundaries: category=STRUCTURE  # Represents the road boundaries Information.
      namespaces:
        symbol props ara
        symbol props adi
        symbol props sensoritf
      4 x cpp implementation data type element:
        RecognizedRoadBoundariesCap: is-optional=true, type-reference=uint16_t  # Represents the capability of the recognized road boundaries.
        RecognizedRoadBoundariesStatus: is-optional=true, type-reference={inplace=false, type-reference=RecognizedStatus}  # The recongnized road boundary Objects status.
        NoValidRoadBoundaries: type-reference=uint16_t  # Represents the number of valid road boundary objects.
        RoadBoundaryList: type-reference={inplace=false, type-reference=RoadBoundaryInfoVector}  # Represents the list of road boudary objects.
    RoadBoundaryInfo: category=STRUCTURE  # Represents the road boundary Information.
      namespaces:
        symbol props ara
        symbol props adi
        symbol props sensoritf
      5 x cpp implementation data type element:
        ROBoundaryStatus: type-reference={inplace=false, type-reference=ObjectStatus}  # Represents the road boundary object status.
        ExistancePro: type-reference={inplace=false, type-reference=ProPercentage}  # Represents the existance probability of a road boundary.
        ROBoundaryInfo: type-reference={inplace=false, type-reference=ROBoundaryTypeInfo}  # Represents the road boundary type information.
        RBPolynomialsInfor: is-optional=true, type-reference={inplace=false, type-reference=Polynomials}  # Represents the road boundary polynomials. Relevant: camera, lidar,radar.
        RBPolylines: is-optional=true, type-reference={inplace=false, type-reference=Polylines}  # Represents the road marking polylines. Relevant: camera, lidar,radar.
    RoadBoundaryInfoVector: category=VECTOR, cpp-template-argument{inplace=false, template-type=RoadBoundaryInfo}  # Represents a list of road boundary object information.
      namespaces:
        symbol props ara
        symbol props adi
        symbol props sensoritf
    RoadBoundaryProperties: category=STRUCTURE  # Road Boundary Colour information, only relevant to Camera.
      namespaces:
        symbol props ara
        symbol props adi
        symbol props sensoritf
      cpp implementation data type element ColourValueList: type-reference={inplace=false, type-reference=ColourValueVector}  # Represents the colour value list.
      cpp implementation data type element ColourConfidence: is-optional=true, type-reference={inplace=false, type-reference=ProPercentage}  # Represents colour confidence.
    RoadBoundaryType:  # Indicated the type of the road boundary.
      compu {0x00=kGuardrail (The road boundary is a guardrail.), 0x01=kFence (The road boundary is a fence.), 0x02=kWand (The road boundary is a wand, a wall, a building, etc.), 0x03=kBarrier (The road boundary is a barrier.), 0x04=kTensionCableSystem (The road boundary is a tension cable system.), 0x05=kRoadEdge (The road boundary is a road edge e.g. grass, vegetation, sand, gravel, soil, etc.), 0x06=kCurb (The road boundary is a curb stone.), 0x07=kUnclassifiedElevated (The road boundary is an unclassified elevated structure.), 0x08=kUnknown (The Road boundary type is unknown.)}
      range raw 0x00..0x08
      type-reference=uint8_t
      namespaces:
        symbol props ara
        symbol props adi
        symbol props sensoritf
    RoadConditionType: compu {0x00=kDry (Dry Road.), 0x01=kWet (Wet road.), 0x02=kSnow (Snow road.), 0x03=kIce (Ice Road.), 0x04=kUnknown (Road Condition is unknown.)}, range raw 0x00..0x04, type-reference=uint8_t  # To identify the ego-vehicle relevant type of the road surface.
      namespaces:
        symbol props ara
        symbol props adi
        symbol props sensoritf
    RoadMarkingType:  # To identify the ego-vehicle relevant type of the road surface.
      compu {0x00=kSolid (The road marking is solid. It could also be a stop line.), 0x01=kCentreLineDashedMarking (The centre line road marking is dashed.), 0x02=kEdgeLineDashedMarking (The edge line road marking is dashed.), 0x03=kTriangular (The road marking is a line of triangles.), 0x04=kDoubleLineSolid (The road marking has two lines and the most inner line (w.r.t. the ego-vehicle) is solid.), 0x05=kCentreLineDoubleLineDashed (The centre line road marking has two lines and the most inner line (w.r.t. the ego-vehicle) is dashed.), 0x06=kMultipleLineSolid (The road marking has more than two lines and the most inner line (w.r.t. the ego-vehicle) is solid.), 0x07=kCentreLineMultipleLineDashed (The centre line road marking has more than two lines and the most inner line (w.r.t. the ego-vehicle) is dashed.), 0x08=kEdgeLineMultipleLineDashed (The edge line road marking has more than two lines and the most inner line (w.r.t. the ego-vehicle) is dashed.), 0x09=kBottsDotsCatsEyes (The road marking consists of Botts' dots or cats' eyes.), 0x0A=kAttentionMarker (The road marking is an attention marker e.g. US, China and Japan.), 0x0B=kHatched (The edge line road marking is dashed.), 0x0C=kBox (The road marking of a junction.), 0x0D=kColouredArea (The road marking is a coloured area.), 0x0E=kArrow (The road marking is an arrow.), 0x0F=kZebraCrossing (The road marking is a zebra crossing / continental / ladder.), 0x10=kGenericSymbol (The edge line road marking has more than two lines and the most inner line (w.r.t. the ego-vehicle) is dashed.), 0x11=kTrafficSignOnLane (The road marking is a traffic sign.), 0x12=kGenericLine (The road marking is a generic line.), 0x13=kParkingArea (The edge line road marking is dashed.), 0x14=kTShapeMarkingBegin (The road marking is a parking T-shape beginning parking line.), 0x15=kTShapeMarkingEnd (The road marking is a parking T-shape ending parking line.), 0x16=kIShapeMarkingBegin (The road marking is a parking I-shape beginning parking line.), 0x17=kIShapeMarkingEnd (The road marking is a zebra crossing / continental / ladder.), 0x18=kLShapeMarkingBegin (The road marking is a parking L-shape beginning parking line.), 0x19=kLShapeMarkingEnd (The road marking is a parking L-shape ending parking line.), 0x1A=kNets (The road marking is a net, i.e. a non-stopping area.), 0x1B=kUnknown (The road marking is unknown.)}
      range raw 0x00..0x1B
      type-reference=uint8_t
      namespaces:
        symbol props ara
        symbol props adi
        symbol props sensoritf
    RoadMarkingTypeInfo: category=STRUCTURE  # Represents the road marking type Information.
      namespaces:
        symbol props ara
        symbol props adi
        symbol props sensoritf
      cpp implementation data type element NoRoadMarkingType: type-reference=uint8_t  # Represents the nubmer of the markeing type list.
      cpp implementation data type element ROMarkingTList: type-reference={inplace=false, type-reference=ROMarkingTVector}  # Represents the road marking type list.
    RoadSurface: category=STRUCTURE  # Represents the road suface Information.
      namespaces:
        symbol props ara
        symbol props adi
        symbol props sensoritf
      6 x cpp implementation data type element:
        ROType: type-reference={inplace=false, type-reference=RoadType}  # Represents the road type.
        NoRoadSurface: type-reference={inplace=false, type-reference=uint8_t}  # Represents the nubmer of the road surface type list.
        ROsurfaceList: type-reference={inplace=false, type-reference=RoadSurfaceClassVector}  # Represents the road surface type list.
        NoConditionClass: is-optional=true, type-reference={inplace=false, type-reference=uint8_t}  # Represents the nubmer of the road surface condition type list.
        ROsurfaceConList: type-reference={inplace=false, type-reference=RoadSurfaceConVector}  # Represents the road surface Condition type list.
        SurfaceRoughness: is-optional=true, type-reference={inplace=false, type-reference=float}  # For the ego-vehicle relevant roughness or unevenness of the road surface. [0..20], mm/m,The International Roughness Index (IRI) has a value range from 0 = smooth surface (equivalent to driving on a plate of glass) up to 20 mm/m (a very rough road).
    RoadSurfaceClass: category=STRUCTURE  # Represents the road suface type and probability.
      namespaces:
        symbol props ara
        symbol props adi
        symbol props sensoritf
      cpp implementation data type element ROSurfaceType: type-reference={inplace=false, type-reference=RoadSurfaceType}  # Represents the road surface type.
      cpp implementation data type element SurfaceProbability: type-reference={inplace=false, type-reference=ProPercentage}  # Represents the road surface probability.
    RoadSurfaceClassVector: category=VECTOR, cpp-template-argument{inplace=false, template-type=RoadSurfaceClass}  # Represents a list of Road Surface.
      namespaces:
        symbol props ara
        symbol props adi
        symbol props sensoritf
    RoadSurfaceCon: category=STRUCTURE  # Represents the road suface condition and probability.
      namespaces:
        symbol props ara
        symbol props adi
        symbol props sensoritf
      cpp implementation data type element ROSurfaceConType: type-reference={inplace=false, type-reference=RoadConditionType}  # Represents the road surface Condition type.
      cpp implementation data type element RoadConditionProbability: type-reference={inplace=false, type-reference=ProPercentage}  # Represents the road condition type probability.
    RoadSurfaceConVector: category=VECTOR, cpp-template-argument{inplace=false, template-type=RoadSurfaceCon}  # Represents a list of Road Surface condition.
      namespaces:
        symbol props ara
        symbol props adi
        symbol props sensoritf
    RoadSurfaceType: compu {0x00=kRomanRoad (Roman Road.), 0x01=kOffRoad (Off the road.), 0x02=kFlat (Flat surface.), 0x03=kBumpy (Bumpy surface.), 0x04=kUnknown (Surface type is unknown.)}, range raw 0x00..0x04, type-reference=uint8_t  # To identify the ego-vehicle relevant type of the road surface.
      namespaces:
        symbol props ara
        symbol props adi
        symbol props sensoritf
    RoadType: compu {0x00=kHighway (Represents the highway.), 0x01=kRural (Represents the rural road.), 0x02=kCity (Represents the city road.), 0x03=kOffRoad (Represents off the road.), 0x04=kUnknown (Represents the road type unknown.)}, range raw 0x00..0x04, type-reference=uint8_t  # To identify the ego-vehicle relevant type of the road.
      namespaces:
        symbol props ara
        symbol props adi
        symbol props sensoritf
    Roadlevel: compu {0x00=kUnknown (The road level is unknown.), 0x01=kEgoRoadLevel (The object is on the same road level of the ego vehicle.), 0x02=kRoadLevelAbove (The object is above the road level of the ego vehicle .), 0x03=kRoadLevelBelow (The object is below the road level of the ego vehicle .)}, range raw 0x00..0x03, type-reference=uint8_t  # Represent the relevance to ego vehicle road level.
      namespaces:
        symbol props ara
        symbol props adi
        symbol props sensoritf
    Roadmarking: category=STRUCTURE  # Represents the road marking Information.
      namespaces:
        symbol props ara
        symbol props adi
        symbol props sensoritf
      5 x cpp implementation data type element:
        ROStatus: type-reference={inplace=false, type-reference=ObjectStatus}  # Represents the road object status.
        ExistancePro: type-reference={inplace=false, type-reference=ProPercentage}  # Represents the existance probability of a road marking.
        ROmarkingTypeInfo: type-reference={inplace=false, type-reference=RoadMarkingTypeInfo}  # Represents the road marking type information.
        ROPolynomialsInfor: is-optional=true, type-reference={inplace=false, type-reference=Polynomials}  # Represents the road marking polynomials. Relevant: camera, lidar
        ROPolylines: is-optional=true, type-reference={inplace=false, type-reference=Polylines}  # Represents the road marking polylines. Relevant: camera, lidar
    RoadmarkingVector: category=VECTOR, cpp-template-argument{inplace=false, template-type=Roadmarking}  # Represents a list of road marking object information.
      namespaces:
        symbol props ara
        symbol props adi
        symbol props sensoritf
    Roadmarkings: category=STRUCTURE  # Represents the road marking Information.
      namespaces:
        symbol props ara
        symbol props adi
        symbol props sensoritf
      4 x cpp implementation data type element:
        RecognizedRoadMarkingCap: is-optional=true, type-reference=uint16_t  # Represents the capability of the recognized road marking.
        RecognizedRoadMarkingStatus: is-optional=true, type-reference={inplace=false, type-reference=RecognizedStatus}  # The recongnized road marking Objects status.
        NoValidRoadMarking: type-reference=uint16_t  # Represents the number of valid road marking objects.
        ROmarkinglist: type-reference={inplace=false, type-reference=RoadmarkingVector}  # Represents the list of road marking objects.
    SSginVector: category=VECTOR, cpp-template-argument{inplace=false, template-type=SSign}  # Represents a list of Supplementary sign.
      namespaces:
        symbol props ara
        symbol props adi
        symbol props sensoritf
    SSign: category=STRUCTURE  # Represents the Supplementary sign Information.
      namespaces:
        symbol props ara
        symbol props adi
        symbol props sensoritf
      4 x cpp implementation data type element:
        SSStatus: type-reference={inplace=false, type-reference=SubObjectStatus}  # Represents the supplementary sign status.
        SStype: type-reference={inplace=false, type-reference=SSignType}  # Represents the supplementary sign type information.
        SSInfo: type-reference={inplace=false, type-reference=SSignInfo}  # Represents the supplementary sign information.
        SSPos: type-reference={inplace=false, type-reference=SSignPos}  # Represents the supplementary sign position information.
    SSignInfo: category=STRUCTURE  # Represents the Supplementary sign Information.
      namespaces:
        symbol props ara
        symbol props adi
        symbol props sensoritf
      cpp implementation data type element SSignValue: type-reference=float  # Represents the supplementary sign value information.
      cpp implementation data type element SSignUnit: type-reference={inplace=false, type-reference=SignValueUnit}  # Represents the supplementary sign unit regarding the value.
      cpp implementation data type element SOoS: type-reference={inplace=false, type-reference=OutOfService}  # Represents the supplementary sign service status information
    SSignPos: category=STRUCTURE  # Represents the Supplementary sign position Information.
      namespaces:
        symbol props ara
        symbol props adi
        symbol props sensoritf
      cpp implementation data type element SSRelativePosition: type-reference={inplace=false, type-reference=RelativePosition}  # Represents the supplementary sign unit relative position.
      cpp implementation data type element RelativePosOrder: type-reference={inplace=false, type-reference=uint8_t}  # Represents the supplementary sign relative positon order.
    SSignType: category=STRUCTURE  # Represents the Supplementary sign type Information.
      namespaces:
        symbol props ara
        symbol props adi
        symbol props sensoritf
      cpp implementation data type element ExistPro: type-reference=ProPercentage  # Represents the Supplementary sign existance probablity.
      cpp implementation data type element Type: type-reference={inplace=false, type-reference=SupplementarySignType}  # Represents the Supplementary sign type.
      cpp implementation data type element SupplementarSignTypeConfidence: type-reference=ProPercentage  # Confidence information for the supplementary sign type. %
    SSigns: category=STRUCTURE  # Represents the Supplementary signs Information.
      namespaces:
        symbol props ara
        symbol props adi
        symbol props sensoritf
      cpp implementation data type element NoTrafficSupplementarSigns: type-reference=uint8_t  # Represents the number of valid supplementary signs.
      cpp implementation data type element SSignList: type-reference={inplace=false, type-reference=SSginVector}  # Represents the list of supplementary signs.
    ScopeOfInterfaces:  # To identify the related interface of the service.
      compu {0x00=kObjectLevelInterfaces (Object level interfaces.), 0x01=kFeatureLevelInterface (Feature level interface.), 0x02=kDetectionLevelInterface (Detection level interface.), 0x03=kFLIandDLI (Feature level and detection level interfaces.), 0x04=kPMOI (Potential Moving Objects Interface.), 0x05=kRDOI (Road Objects Interface.), 0x06=kSOI (Static Objects Interface.), 0x07=kAll (All interfaces.)}
      range raw 0x00..0x07
      type-reference=uint8_t
      namespaces:
        symbol props ara
        symbol props adi
        symbol props sensoritf
    SegmentPointsInfo: category=STRUCTURE  # Represents the segment points information.
      namespaces:
        symbol props ara
        symbol props adi
        symbol props sensoritf
      cpp implementation data type element NoValidPointsUltrasonic: type-reference=uint16_t  # The current Number of valid points.
      cpp implementation data type element ValidPointsList: type-reference={inplace=false, type-reference=ValidPointInfoVector}  # Represents a list of valid point information.
    SensorCaliInfo: category=STRUCTURE  # Represents the sensor caliberation related information.
      namespaces:
        symbol props ara
        symbol props adi
        symbol props sensoritf
      10 x cpp implementation data type element:
        NoValidSensorCalibratableComponents: type-reference=uint8_t  # The current Number of valid sensor calibratable components for different sensor components which may be calibrated.
        SensorCaliCompList: type-reference={inplace=false, type-reference=CaliComponentInfoVector}  # Represents a list of senosr caliberatable component status information.
        CoorectionOriginPos: is-optional=true, type-reference={inplace=false, type-reference=Point3D}  # Correction of the mounting position w.r.t. the nominal position. Correction is determined by e.g. internal calibration. (m, m, m)
        CoorectionOriginPosError: is-optional=true, type-reference={inplace=false, type-reference=Point3DError}  # Estimated error of the mounting position correction (Correction origin position {x, y, z} ) by e.g. internal calibration. (m, m, m)
        CoorectionPosLimitMin: is-optional=true, type-reference={inplace=false, type-reference=Point3D}  # Limits of position corrections. Minimum positions could be defined for each axis {x, y, z}. (m, m, m)
        CoorectionPosLimitMax: is-optional=true, type-reference={inplace=false, type-reference=Point3D}  # Limits of position corrections. Maximum positions could be defined for each axis {x, y, z}. (m, m, m)
        CoorectionOrientation: is-optional=true, type-reference={inplace=false, type-reference=Orientation3D}  # Correction of the mounting position orientation w.r.t. the nominal orientation. Correction is determined by e.g. internal calibration. (rad, rad, rad)
        CoorectionOrientationError: is-optional=true, type-reference={inplace=false, type-reference=Orientation3DError}  # Estimated error of the mounting orientation correction (Correction orientation {yaw, pitch, roll}) by e.g. internal calibration.. (rad, rad, rad)
        CoorectionAngleLimitMin: is-optional=true, type-reference={inplace=false, type-reference=Orientation3D}  # Limits of angle corrections. Minimum angles could be defined for each angle {yaw, pitch, roll}. (rad, rad, rad)
        CoorectionAngleLimitMax: is-optional=true, type-reference={inplace=false, type-reference=Orientation3D}  # Limits of angle corrections. Maximum angles could be defined for each angle {yaw, pitch, roll}.(rad, rad, rad)
    SensorCalibratableComponent: compu {0x00=kIntrinsic (Calibration status for the intrinsic parameters of the sensor.), 0x01=kExtrinsic (Calibration status for the extrinsic parameters of the sensor.), 0x02=kOnline (Calibration status for the online parameters of the sensor.), 0x03=kUnknown (The sensor calibratable component is unknown.)}, range raw 0x00..0x03, type-reference=uint8_t  # Enumeration for the sensor component which may be calibrated.
      namespaces:
        symbol props ara
        symbol props adi
        symbol props sensoritf
    SensorCalibrationStatus:  # Enumeration for the current calibration status of the Sensor calibratable component.
      compu {0x00=kCalibrated (Sensor calibration was successful and within nominal tolerance range.), 0x01=kNotCalibrated (Calibration not done or calibration failed.), 0x02=kDegraded (Sensor calibrated, however performance degraded due to limited correction accuracy.), 0x03=kInitialCalibrationNotPerformed (Sensor initial calibration not performed yet.), 0x04=kInitialCalibrationFailed (Sensor initial calibration process failed.), 0x05=kRecalibrationNeededIntrinsic (Recalibration of sensor’s intrinsic parameters required.), 0x06=kRecalibrationNeededExtrinsic (Recalibration of sensor’s extrinsic parameters required.), 0x07=kRecalibrationNeededFull (Recalibration of the complete sensor’s parameters required.), 0x08=kUnknown (The sensor Calibration status is unknown.)}
      range raw 0x00..0x08
      type-reference=uint8_t
      namespaces:
        symbol props ara
        symbol props adi
        symbol props sensoritf
    SensorDefectDetected: compu {0x00=kSensorFullyFunctional (Sensor has no defects detected.), 0x01=kNotFullyFunctionalDueToDefect (Sensor has detected defects. Sensor can measure with limited performance.), 0x02=kOutOfOrder (Sensor has detected defects and cannot perform measurements anymore.), 0x03=kUnknown (The sensor defect detected is unknown.)}, range raw 0x00..0x03, type-reference=uint8_t  # Signal for a sensor defect is detected.
      namespaces:
        symbol props ara
        symbol props adi
        symbol props sensoritf
    SensorDefectReason:  # Signal for detailed information why the signal Sensor defect detected is notifying a sensor problem.
      compu {0x00=kNoDefectDetected (No defects detected by the sensor.), 0x01=kInternalMemoryError (Sensor has detected an internal memory error.), 0x02=kElectronicDefect, 0x03=kThermalDefect (Sensor has detected a thermal problem error.), 0x04=kSurgeDefect (Sensor has detected a surge defect.), 0x05=kCalibrationError (Sensor has detected a calibration error.), 0x06=kImplausibleSensorParametrisation (Sensor has detected an implausible parametrisation.), 0x07=kMechanicalDefect (Sensor has detected a mechanical defect.), 0x08=kSoftwareDefect (Sensor has detected a software defect.), 0x09=kComputingPowerNotSufficient (Sensor has detected a to low power supply.), 0x10=kOutOfTimeSyncronisation (Sensor has detected an out of time synchronisation.), 0x11=kSensorExternalDisturbed (Sensor has detected an external disturbance.), 0x12=kUnknown (The sensor defect reason is unknown.)}
      range raw 0x00..0x0C
      type-reference=uint8_t
      namespaces:
        symbol props ara
        symbol props adi
        symbol props sensoritf
    SensorDiagnosticMode: compu {0x00=kIdle (Sensor not in diagnostic mode. Sensor in normal operation.), 0x01=kSensorInEndOfLineMode (End of line alignment in operation.), 0x02=kSensorInSelfDiagnoseMode (Sensor in self-diagnosis mode, normal sensor operation is not provided.), 0x03=kUnknown (The Sensor diagnostic mode is unknown.)}, range raw 0x00..0x03, type-reference=uint8_t  # Signal for the current Sensor diagnostic mode.
      namespaces:
        symbol props ara
        symbol props adi
        symbol props sensoritf
    SensorExternalDisturbed:  # Signal about the disturbance of the sensor by an external source.
      compu {0x00=kFullDisturbance (The sensor is completely disturbed, no more feature and functionality working due to external disturbance.), 0x01=kDisturbanceHighImpact (The sensor has detected an external disturbance which has a significant impact on sensor performance.), 0x02=kDisturbanceMediumImpact (The sensor has detected an external disturbance which already has impact on sensor performance.), 0x03=kDisturbanceLowImpact (The sensor detects that an external disturbance is present or is increasing, but the degree of disturbance has not yet had a significant impact on sensor performance and functionality.), 0x04=kNone (Normal mode.), 0x05=kUnknown (The sensor external disturbed status is unknown.)}
      range raw 0x00..0x05
      type-reference=uint8_t
      namespaces:
        symbol props ara
        symbol props adi
        symbol props sensoritf
    SensorHealthInfo: category=STRUCTURE  # Represents the sensor Health interface information.
      namespaces:
        symbol props ara
        symbol props adi
        symbol props sensoritf
      4 x cpp implementation data type element:
        SHHeader: type-reference={inplace=false, type-reference=GeneralHeader}  # Represents the header of an sensor health interface.
        SensorMountingPos: type-reference={inplace=false, type-reference=SensorMountingInfo}  # Represnets the Sensor Mounting position.
        SHStatus: is-optional=true, type-reference={inplace=false, type-reference=SensorHealthStatus}  # Represents the sensor health information .
        SensorCali: is-optional=true, type-reference={inplace=false, type-reference=SensorCaliInfo}  # Represnets the sensor caliberation information.All interface are possible, in the sequence SHHI, SPI, DLI, FLI, OLI.
    SensorHealthStatus: category=STRUCTURE  # Represents the sensor health related information.
      namespaces:
        symbol props ara
        symbol props adi
        symbol props sensoritf
      15 x cpp implementation data type element:
        OperationState: type-reference={inplace=false, type-reference=SensorOperationState}  # Represents sensor operation state information.
        OperationMode: type-reference={inplace=false, type-reference=SensorOperationMode}  # Represents sensor oepration mode information.
        DefectDetected: type-reference={inplace=false, type-reference=SensorDefectDetected}  # Represents sensor defected status information.
        DefectReason: type-reference={inplace=false, type-reference=SensorDefectReason}  # Represents sensor defect reeason information.
        DiagMode: type-reference={inplace=false, type-reference=SensorDiagnosticMode}  # Represents sensor diagnostic mode information.
        SupplyVoltage: type-reference={inplace=false, type-reference=StatusSupplyVoltage}  # Represents the supply voltage information.
        TempStatus: type-reference={inplace=false, type-reference=SensorTemperatureStatus}  # Represents the sensor temperature status information.
        NoValidSensorInput: type-reference={inplace=false, type-reference=uint8_t}  # Represents the number of Valid sensor input signals.
        ValidSenorInputSignalList: type-reference={inplace=false, type-reference=InputSignalInfoVector}  # Represents a list of senosr input singals status information.
        ExternalDisturbed: is-optional=true, type-reference={inplace=false, type-reference=SensorExternalDisturbed}  # Represents the external distrubed information.
        TPReduced: is-optional=true, type-reference={inplace=false, type-reference=SensorTransmitPowerReduced}  # Represents the transmit power reduced information.
        HeatingStatus: is-optional=true, type-reference={inplace=false, type-reference=StatusSensorHeating}  # Represents the heating status information.
        CleaningStatus: is-optional=true, type-reference={inplace=false, type-reference=StatusSensorCleaning}  # Represents the cleaning status information.
        TSYStatus: is-optional=true, type-reference={inplace=false, type-reference=StatusTimSync}  # Represents the time synchronization information.
        SensorTimeSynccOffset: is-optional=true, type-reference={inplace=false, type-reference=float}  # Value of the sensor time synchronisation offset.
    SensorInputSignalStatus:  # Enumeration if valid input signals for Sensor input signal – type are received by the sensor.
      compu {0x00=kValid (Normal mode.), 0x01=kImplausible (Signal in context of sensor signals is not plausible compared with other signals or internal calculations.), 0x02=kMissing (Signal was never received.), 0x03=kOufOfRange (Signal violated the signal range.), 0x04=kTimeout (Signal was received, however not in time period as expected.), 0x05=kUnknown (The sensor input signal status is unknown.)}
      range raw 0x00..0x05
      type-reference=uint8_t
      namespaces:
        symbol props ara
        symbol props adi
        symbol props sensoritf
    SensorInputSignalType: compu {0x00=kDynamicMotionControl (Dynamic motion control sensor input signals.), 0x01=kVehicleDynamic (Vehicle dynamic sensor input signals.), 0x02=kUnknown (Sensor input signal type is unknown.)}, range raw 0x00..0x02, type-reference=uint8_t  # Classification of the Sensor input signal – type , which defines a group of sensor input signals received by the sensor.
      namespaces:
        symbol props ara
        symbol props adi
        symbol props sensoritf
    SensorMountingInfo: category=STRUCTURE  # Sensor Mounting information in vehicle coordinate system.
      namespaces:
        symbol props ara
        symbol props adi
        symbol props sensoritf
      4 x cpp implementation data type element:
        OriginPosition: type-reference={inplace=false, type-reference=Point3D}  # The sensor original mounting position {x,y,z}.The unit is {m,m,m}.
        OriginPositionError: is-optional=true, type-reference={inplace=false, type-reference=Point3DError}  # The Error of the sensor origin poistion.The unit is {m,m,m}.
        OriginOrientation: type-reference={inplace=false, type-reference=Orientation3D}  # The relative orientation of the sensor axis system with respect to the vehicle axis system.The unit is {rad,rad,rad}.
        OriginOrientationError: is-optional=true, type-reference={inplace=false, type-reference=Orientation3DError}  # The uncertaity of the sensor mouting position with respect to the vehicle axis system using Error value.The unit is {rad,rad,rad}.
    SensorOperationMode: compu {0x00=kSensorMeasuringActive (Sensor is active and performs measurements.), 0x01=kSensorMeasuringDisabled (Sensor is disabled and performs no measurement at the moment.), 0x02=kSensorMeasuringTestmode (Sensor is in active measurement mode, however in test mode.), 0x03=kUnknown (The Sensor operation mode is unknown.)}, range raw 0x00..0x03, type-reference=uint8_t  # Status information of the sensor.
      namespaces:
        symbol props ara
        symbol props adi
        symbol props sensoritf
    SensorOperationState:  # Status information of the sensor.
      compu {0x00=kNormal (All sensor components up and running: e.g. all initialization given and communication fully established.), 0x01=kLimited (Only limited processing power available.), 0x02=kOff (Status during shut-off.), 0x03=kError (Internal error detected: e.g. memory check.), 0x04=kInitializing (During sensor initialization is carried out.), 0x05=kNotDefined (Sensor operation state is not defined.), 0x06=kUnknown (The sensor operation state is unknown.)}
      range raw 0x00..0x06
      type-reference=uint8_t
      namespaces:
        symbol props ara
        symbol props adi
        symbol props sensoritf
    SensorPerformance: category=STRUCTURE  # Represents the sensor performance interface information.
      namespaces:
        symbol props ara
        symbol props adi
        symbol props sensoritf
      5 x cpp implementation data type element:
        SPHeader: type-reference={inplace=false, type-reference=GeneralHeader}  # Represents the header of an sensor performance interface.
        SPScopeIntf: is-optional=true, type-reference={inplace=false, type-reference=ScopeOfInterfaces}  # The scope of the sensor performance interfce.
        SensorMountingPos: type-reference={inplace=false, type-reference=SensorMountingInfo}  # Represnets the Sensor Mounting position.
        VPInfo: is-optional=true, type-reference={inplace=false, type-reference=VanishingPointInfo}  # Represents the Vanishing points information .
        PerformanceSegments: type-reference={inplace=false, type-reference=PerformanceSegmentsInfo}  # Represnets the performance segments information.
    SensorPerformanceStatus: category=STRUCTURE  # Represents the sensor performance information.
      namespaces:
        symbol props ara
        symbol props adi
        symbol props sensoritf
      6 x cpp implementation data type element:
        HAngle: type-reference={inplace=false, type-reference=HorizontalAngle}  # Represents the Horizontal Angle information.
        VerticalAngle: type-reference={inplace=false, type-reference=VerticalAngle}  # Represents the Vertical Angle information.
        SResolution: is-optional=true, type-reference={inplace=false, type-reference=SensorResolution}  # Represents the sensor resolution information。
        BeamDivergence: is-optional=true, type-reference={inplace=false, type-reference=BeamDivergence}  # Represents the sensor beam deivergence informantion.
        RangeGain: is-optional=true, type-reference={inplace=false, type-reference=ProPercentage}  # The Range gain (A.5.5) describes the range difference in this segment compared to a defined normative value. A value of 100 % means the same range as the initially defined segment, values beyond 100 % would be a corresponding range increase and below 100 % a range loss.
        BStatus: type-reference={inplace=false, type-reference=BlockageStatus}  # Represents the blockage informantion.
    SensorResolution: category=STRUCTURE  # The resolution of the sensor within the specified segment is the angle between the maxima of two adjacent measurement points. (rad, rad)
      namespaces:
        symbol props ara
        symbol props adi
        symbol props sensoritf
      cpp implementation data type element Horizontal: type-reference=float  # The Horizontal Angle.
      cpp implementation data type element Vertical: type-reference=float  # The Vertiacal Angle.
    SensorTemperatureStatus: compu {0x00=kUnderTemperature (No measurement updates available.), 0x01=kPreUnderTemperature (Close before under temperature.), 0x02=kTemperatureInLimits (Normal mode.), 0x03=kPreOverTemperature (Close before over temperature.), 0x04=kOverTemperature (No measurement updates available.), 0x05=kUnknown (The sensor temperature status is unknown.)}, type-reference=uint8_t  # Signal for the current Sensor temperature status status.
      namespaces:
        symbol props ara
        symbol props adi
        symbol props sensoritf
    SensorTransmitPowerReduced: compu {0x00=kNormalOperation (Transmit output power normal.), 0x01=kOutputPowerLimited (Transmit output power reduced.), 0x02=kUnknown (Sensor Transmit Power status is unknown.)}, type-reference=uint8_t  # Enumeration if the sensor works with full output power.
      namespaces:
        symbol props ara
        symbol props adi
        symbol props sensoritf
    ShapeClassType: compu-method=ShapeClassType, range raw 0x00..0x10, type-reference=uint8_t  # The classification type for the shape.
      namespaces:
        symbol props ara
        symbol props adi
        symbol props sensoritf
    ShapeClassTypeInfo: category=STRUCTURE  # Represents the shape class type information.
      namespaces:
        symbol props ara
        symbol props adi
        symbol props sensoritf
      cpp implementation data type element CShapeClassType: type-reference={inplace=false, type-reference=ShapeClassType}  # Represents the shape class type.
      cpp implementation data type element ShapeClassProValue: type-reference={inplace=false, type-reference=ProPercentage}  # Classification probability of the shape segment's possible content.
    ShapeClassTypeInfoVector: category=VECTOR, cpp-template-argument{inplace=false, template-type=ShapeClassTypeInfo}  # Represents a list of shape class type information.
      namespaces:
        symbol props ara
        symbol props adi
        symbol props sensoritf
    ShapeClassVariant: compu {0x00=kTrue (Shape is shape classification type.), 0x01=kFalse (Shape is not shape classification type.), 0x02=kUnknown (ShapeClassVariant is unknown.)}, range raw 0x00..0x02, type-reference=uint8_t  # Description of the segment's possible content for Shape classification type (ShapeClassification_False means confidence less tahn 50 % otherwise “ShapeClassification_True”).
      namespaces:
        symbol props ara
        symbol props adi
        symbol props sensoritf
    ShapeInfo: category=STRUCTURE  # Represents the shape related information.
      namespaces:
        symbol props ara
        symbol props adi
        symbol props sensoritf
      5 x cpp implementation data type element:
        CFShapeType: type-reference={inplace=false, type-reference=ShapeType}  # Represents the shape type.
        NoValidShapeClass: type-reference={inplace=false, type-reference=uint8_t}  # Represents the number of valid shape class .
        CFShapeClassTypeList: type-reference={inplace=false, type-reference=ShapeClassTypeInfoVector}  # Represents a list of shape class type information.
        ColourValueList: type-reference={inplace=false, type-reference=ColourValueVector}  # Definition of the colour value(s). Number of values depends on the Colour model type . %
        ColourPro: is-optional=true, type-reference={inplace=false, type-reference=ProPercentage}  # Represents the colour value confidence.
    ShapePointInfo: category=STRUCTURE  # Represents the Shape points information.
      namespaces:
        symbol props ara
        symbol props adi
        symbol props sensoritf
      cpp implementation data type element PointExistPro: type-reference=ProPercentage  # Existence probability of the point.
      cpp implementation data type element Position3D: type-reference={inplace=false, type-reference=Point3D}  # 3D point in vehicle coordinate system
      cpp implementation data type element Position3DError: type-reference={inplace=false, type-reference=Point3DError}  # Represents the Error Value of the object, the unit is {m,m,m}.
    ShapePointInfoVector: category=VECTOR, cpp-template-argument{inplace=false, template-type=ShapePointInfo}  # Represents a list of shape point information.
      namespaces:
        symbol props ara
        symbol props adi
        symbol props sensoritf
    ShapePoints: category=STRUCTURE  # Represents the Shape points related information.
      namespaces:
        symbol props ara
        symbol props adi
        symbol props sensoritf
      cpp implementation data type element NoValidShapePoints: type-reference=uint16_t  # Represents the number of valid shape points.
      cpp implementation data type element ShapePointsList: type-reference={inplace=false, type-reference=ShapePointInfoVector}  # Represents a list of shape point information.
    ShapeReferPointInfo: category=STRUCTURE  # Represents the Shape reference points information.
      namespaces:
        symbol props ara
        symbol props adi
        symbol props sensoritf
      11 x cpp implementation data type element:
        PointExistPro: type-reference=ProPercentage  # Existence probability of the point.
        Position3D: type-reference={inplace=false, type-reference=Point3D}  # 3D point in vehicle coordinate system
        Position3DError: type-reference={inplace=false, type-reference=Point3DError}  # Represents the Error Value of the object, the unit is {m,m,m}.
        OrientationNormal: is-optional=true, type-reference={inplace=false, type-reference=Point3D}  # Normal vector of the shape’s approximated tangential plane at the 3D Position {x, y, z}
        OrientationNormalError: is-optional=true, type-reference={inplace=false, type-reference=Point3DError}  # The Error of Orientation normal {x, y, z} vector of the shape’s approximated tangential plane at the 3D Position {x, y, z}.
        TranslationRate: is-optional=true, type-reference={inplace=false, type-reference=Point3D}  # Scaled translation of the shape’s approximated tangential plane at the 3D Position {x, y, z} . Longitudinally (along the view axis) that is the inverse time to collision.(1/s, 1/s, 1/s)
        TranslationRateError: is-optional=true, type-reference={inplace=false, type-reference=Point3DError}  # The Error of Scaled translation rate {x, y, z} of the shape’s approximated tangential plane at the 3D Position {x, y, z} .(1/s, 1/s, 1/s)
        RotationRate: is-optional=true, type-reference={inplace=false, type-reference=Orientation3D}  # Rotation change of the shape’s approximated tangential plane at the 3D Position {x, y, z} (rad/s, rad/s, rad/s)
        RotationRateError: is-optional=true, type-reference={inplace=false, type-reference=Orientation3DError}  # Error of Rotation rate {yaw, pitch, roll} change of the shape’s approximated tangential plane at the 3D Position {x, y, z} (rad/s, rad/s, rad/s)
        ScaleChange: is-optional=true, type-reference=float  # 3D point in vehicle coordinate system.
        ScaleChangeError: is-optional=true, type-reference=float  # Error of Scale change – feature level of the shape’s approximated tangential plane at the 3D Position {x, y, z}.
    ShapeReferPointInfoVector: category=VECTOR, cpp-template-argument{inplace=false, template-type=ShapeReferPointInfo}  # Represents a list of shape Reference point information.
      namespaces:
        symbol props ara
        symbol props adi
        symbol props sensoritf
    ShapeReferPoints: category=STRUCTURE  # Represents the Shape Reference points related information.
      namespaces:
        symbol props ara
        symbol props adi
        symbol props sensoritf
      cpp implementation data type element NoValidShapeRPs: type-reference=uint8_t  # Represents the number of valid reference shape points.
      cpp implementation data type element ShapeReferPointsList: type-reference={inplace=false, type-reference=ShapeReferPointInfoVector}  # Represents a list of shape reference point information.
    ShapeType: compu {0x00=kPoint (Shape is a point.), 0x01=kBox (Shape is a box (2 or 3 points).), 0x02=kEllipse (Shape is an ellipse (2 or 3 points).), 0x03=kPolygon (Shape is a polygon (3 or more points).), 0x04=kPolyline (Shape is a polyline (2 or more points).), 0x05=kPointCloud (Shape is a point cloud (2 or more points).), 0x06=kUnknown (Shape type is unknown.)}, range raw 0x00..0x06, type-reference=uint8_t  # Classification of the general landmark.
      namespaces:
        symbol props ara
        symbol props adi
        symbol props sensoritf
    SignGeometry:  # The shape of the sign.
      compu {0x00=kCircle (Circle shape as sign geometry.), 0x01=kTriangleTop (Triangle with tip pointing downwards as sign geometry.), 0x02=kTriangleDown (Triangle with tip pointing upwards as sign geometry.), 0x03=kSquare (Square shape as sign geometry.), 0x04=kPole (Pole shape as sign geometry.), 0x05=kRectangle (Rectangle shape as sign geometry.), 0x06=kPlate (Plate with multiple traffic information.), 0x07=kDiamond (Diamond shape as sign geometry.), 0x08=kArrowLeft (Arrow left five edge shape as sign geometry.), 0x09=kArrowRight (Arrow right five edge shape as sign geometry.), 0x0A=kOctagon (Octagon shape as sign geometry.), 0x0B=kUnknown (The sign geometry is unknown.)}
      range raw 0x00..0x0B
      type-reference=uint8_t
      namespaces:
        symbol props ara
        symbol props adi
        symbol props sensoritf
    SignType:  # To identify the type of the sign as main traffic sign or road marking.
      compu {0x00=kStopSign (Stop sign.), 0x01=kYieldSign (Yield sign.), 0x02=kSpeedLimitSign (Speed limit sign.), 0x03=kNoMainSign (No main sign, only supplementary signs.), 0x04=kGreenArrowSign (Green Arrow Sign.), 0x05=kHeightLimitSign (Height limit sign.), 0x06=kEmptySign (Sign may be a changeable traffic sign without displaying a traffic sign symbol.), 0x07=kUnknown (The Sign type is unknown.)}
      range raw 0x00..0x07
      type-reference=uint8_t
      namespaces:
        symbol props ara
        symbol props adi
        symbol props sensoritf
    SignValueUnit: compu {0x00=kKilometrePerHour (Kilometre per hour), 0x01=kMilePerHour (Mile per hour), 0x02=kMeter, 0x03=kKilometre, 0x04=kFeet, 0x05=kMile, 0x06=kMetricTon (Metric Ton), 0x07=kShortTon (Short Ton), 0x08=kLongTon (LongTon.), 0x09=kMinute, 0x0A=kHour, 0x0B=Day, 0x0C=kWeekday, 0x0D=kPercentage, 0x0E=kUnknown (Unknown.)}, range raw 0x00..0x0E, type-reference=uint8_t  # To identify the value unit of the linked sign.
      namespaces:
        symbol props ara
        symbol props adi
        symbol props sensoritf
    StaticObjects: category=STRUCTURE  # Represents the static object informaiton provided by a camera,lidar, radar or Ultrasonic sensor.
      namespaces:
        symbol props ara
        symbol props adi
        symbol props sensoritf
      4 x cpp implementation data type element:
        Header: type-reference={inplace=false, type-reference=GeneralHeader}  # Represents the header of a Static Object interface.
        SOLandmarks: is-optional=true, type-reference={inplace=false, type-reference=GeneralLandmarks}  # Represents general landmark information in a measurement cycle. At least one of landmarks, traffic light or traffic sign shall be in the inteface.
        SOTrafficSigns: is-optional=true, type-reference={inplace=false, type-reference=TrafficSigns}  # Represents traffic signs information in a measurement cycle. At least one of landmarks, traffic light or traffic sign shall be in the inteface.
        SOTrafficLights: is-optional=true, type-reference={inplace=false, type-reference=TrafficLights}  # Represents traffic lights information in a measurement cycle. At least one of Roadsurface, Roadmarking or Roadboundaries shall be in the inteface.
    StatusSensorCleaning: compu {0x00=kCleaningIdle (Sensor cleaning is not active.), 0x01=kCleaningActive (Sensor cleaning is active), 0x02=kCleaningNeeded (Sensor cleaning should be performed.), 0x03=kUnknown (The sensor cleaning status is unknown.)}, range raw 0x00..0x03, type-reference=uint8_t  # Status of the sensor cleaning.
      namespaces:
        symbol props ara
        symbol props adi
        symbol props sensoritf
    StatusSensorHeating: compu {0x00=kHeatingOff (No heating active.), 0x01=kHeatingLevel (Sensor heating active.), 0x02=kHeatingError (Sensor heating is defect.), 0x03=kUnknown (The sensor heating status is unknown.)}, range raw 0x00..0x03, type-reference=uint8_t  # Status of the sensor heating.
      namespaces:
        symbol props ara
        symbol props adi
        symbol props sensoritf
    StatusSupplyVoltage:  # Signal for the current Status supply voltage status.
      compu {0x00=kWithinLimits (Supply voltage is optimal.), 0x01=kLow (Supply voltage is out of valid range. Supply voltage is too low.), 0x02=kPreLow (Supply voltage still in the valid range, but close to the limit and expected to leave the valid range soon.), 0x03=kPreHigh (Supply voltage still in the valid range, but close to the limit and expected to leave the valid range soon.), 0x04=kHigh (Supply voltage is out of valid range. Supply voltage is too high.), 0x05=kUnknown (The sensor supply voltage status is unknown.)}
      range raw 0x00..0x05
      type-reference=uint8_t
      namespaces:
        symbol props ara
        symbol props adi
        symbol props sensoritf
    StatusTimSync:  # Status of the sensor time synchronisation.
      compu {0x00=kWithinLimits (Time synchronization inside limits.), 0x01=kOutOfLimits (Time synchronization time accuracy limits violated.), 0x02=kTimeout (Time synchronization timeout elapsed (no valid time synchronization cycle within timeout interval).), 0x03=kOffset (Time offset value. Requires: Sensor time sync offset value), 0x04=kUnknown (The time synchronization status is unknown.)}
      range raw 0x00..0x04
      type-reference=uint8_t
      namespaces:
        symbol props ara
        symbol props adi
        symbol props sensoritf
    StructureLightType: compu {0x00=kVertical3 (Three light sources vertical.), 0x01=kHorizontal3 (Three light sources horizontal.), 0x02=kDogHouse (Multi light sources.), 0x03=kUnknown (Structure is unknown.)}, range raw 0x00..0x03, type-reference=uint8_t  # The traffic light can have different shapes.
      namespaces:
        symbol props ara
        symbol props adi
        symbol props sensoritf
    SubObjectStatus: category=STRUCTURE  # Represents the dynamics of the static object.
      namespaces:
        symbol props ara
        symbol props adi
        symbol props sensoritf
      4 x cpp implementation data type element:
        Age: type-reference=uint64_t  # Represents the amount of time that this object has been currently tracked.
        Observation: is-optional=true, type-reference=uint32_t  # Represents the last 32 cycles in which this object has been currently tracked..
        TrackQuality: is-optional=true, type-reference=uint16_t  # Represents the track quality in a linear manner between 0 and 100 .
        PMOMeasurementStatus: type-reference={inplace=false, type-reference=MeasurementStatus}  # Represents the movement status of the Object .
    SupplementarySignType: compu {0x00=kValidInformationBegin (Begin of valid zone.), 0x01=kValidInformationEnd (End of valid zone.), 0x02=kFrost (Frost sign.), 0x03=kWetRoad (Wet road sign.), 0x04=kDistance (Distance information.), 0x05=kLimitation (Limitation information.), 0x06=kUnknown (Supplementary Sign type is unknown.)}, range raw 0x00..0x06, type-reference=uint8_t  # The type of the sign.
      namespaces:
        symbol props ara
        symbol props adi
        symbol props sensoritf
    SupportedDataRange: category=STRUCTURE  # Supported range of the polynomial [x Start, x End] covered with measured points.
      namespaces:
        symbol props ara
        symbol props adi
        symbol props sensoritf
      cpp implementation data type element Start: type-reference=float  # The starting point.
      cpp implementation data type element End: type-reference=float  # The end point.
    SupportedDataRangeVector: category=VECTOR, cpp-template-argument{inplace=false, template-type=SupportedDataRange}  # Represents a list of supported data range information.
      namespaces:
        symbol props ara
        symbol props adi
        symbol props sensoritf
    TrackingMotionModel: compu {0x00=kConstantVelocity (Motion model uses constant velocity.), 0x01=kConstantAcceleration (Motion model uses constant acceleration.), 0x02=kConstantTurnRate (Motion model uses constant turn rate.)}, range raw 0x00..0x02, type-reference=uint8_t  # The motion model for tracking moving objects.
      namespaces:
        symbol props ara
        symbol props adi
        symbol props sensoritf
    TrafficLight: category=STRUCTURE  # Represents the traffic light Information.
      namespaces:
        symbol props ara
        symbol props adi
        symbol props sensoritf
      5 x cpp implementation data type element:
        TLightStatus: type-reference={inplace=false, type-reference=ObjectStatus}  # Represents the Traffic light status.
        TLightTypeCer: type-reference={inplace=false, type-reference=TrafficLightTypeInfo}  # Represents the traffic light type certainty.
        TLightPos: type-reference={inplace=false, type-reference=TrafficLightPos}  # Represents the traffic light position information.
        TLightBox: is-optional=true, type-reference={inplace=false, type-reference=BboxInfo}  # Represents the traffic light bounding box information. It is only relevant to camera
        TLightSpots: type-reference={inplace=false, type-reference=TrafficLightSpots}  # Represents the traffic light spots infromation.
    TrafficLightColour: category=STRUCTURE  # Represents the trafic light colour type certainty Information.
      namespaces:
        symbol props ara
        symbol props adi
        symbol props sensoritf
      cpp implementation data type element NoValidColourClass: type-reference=uint8_t  # Represents the nubmer of the valid colour type list.
      cpp implementation data type element ColourTypeList: type-reference={inplace=false, type-reference=ColourTypeInfoVector}  # Represents the colour type list.
      cpp implementation data type element ColourConfidence: type-reference=ProPercentage  # Represents the colour type confidence. %
    TrafficLightModeType: category=STRUCTURE  # Represents the trafic light traffic light mode type certainty Information.
      namespaces:
        symbol props ara
        symbol props adi
        symbol props sensoritf
      cpp implementation data type element NoValidLightMode: type-reference=uint8_t  # The current Number of valid light mode classifications of the light modes. Classifications are defined by type and probability value.
      cpp implementation data type element LightModeTypeList: type-reference={inplace=false, type-reference=LightModeTypeInfoVector}  # Represents the traffic light mode type list.
      cpp implementation data type element LightModeConfidence: type-reference=ProPercentage  # Represents the traffic light mode type confidence. %
    TrafficLightPos: category=STRUCTURE  # Represents the traffic light position.
      namespaces:
        symbol props ara
        symbol props adi
        symbol props sensoritf
      6 x cpp implementation data type element:
        MinimumVisibilityDistance: type-reference=uint16_t  # Minimum distance to the traffic light until the traffic light is still in the FOV of the sensor.
        RPs: is-optional=true, type-reference={inplace=false, type-reference=ReferencePoints}  # Represent outer edges of the recognized object’s bounding box.
        Position: type-reference={inplace=false, type-reference=Point3D}  # Represents the position of the object, and the unit is {m,m,m}.
        PositionError: type-reference={inplace=false, type-reference=Point3DError}  # Represents the Error Value of the object, the unit is {m,m,m}.
        OrientationVertical: is-optional=true, type-reference=float  # Represents the rotation of the static object at the given [x, y, z] coordinates around the vertical axis of the object. rad
        OrientationVerticalError: is-optional=true, type-reference=float  # Represents the Error Value of the object orientation, with the unit rad.
    TrafficLightSpot: category=STRUCTURE  # Represents the traffic light sopt Information.
      namespaces:
        symbol props ara
        symbol props adi
        symbol props sensoritf
      6 x cpp implementation data type element:
        TLightSpotStatus: type-reference={inplace=false, type-reference=SubObjectStatus}  # Represents the Traffic light spot status.
        TLightSpotTypeCertainty: type-reference={inplace=false, type-reference=ProPercentage}  # Represents the traffic light spot type certainty.
        TLightSpotColour: type-reference={inplace=false, type-reference=TrafficLightColour}  # Represents the traffic light spot colour information.
        TLightModeType: type-reference={inplace=false, type-reference=TrafficLightModeType}  # Represents the traffic light mode type information.
        TLightSpotShape: type-reference={inplace=false, type-reference=TrafficLightSpotShape}  # Represents the traffic light spot shape infromation.
        TLightSpotPos: type-reference={inplace=false, type-reference=TrafficLightSpotPos}  # Represents the traffic light spot position infromation.
    TrafficLightSpotPos: category=STRUCTURE  # Represents the Traffic Light Spot position.
      namespaces:
        symbol props ara
        symbol props adi
        symbol props sensoritf
      cpp implementation data type element Position: type-reference={inplace=false, type-reference=Point3D}  # Represents the position of the object, and the unit is {m,m,m}.
      cpp implementation data type element PositionError: is-optional=true, type-reference={inplace=false, type-reference=Point3DError}  # Represents the Error Value of the object, the unit is {m,m,m}.
    TrafficLightSpotShape: category=STRUCTURE  # Represents the trafic light spot shape Information.
      namespaces:
        symbol props ara
        symbol props adi
        symbol props sensoritf
      cpp implementation data type element TLightSpotShape: type-reference={inplace=false, type-reference=LightShape}  # Represents the traffic light spot shape.
      cpp implementation data type element LightShapeConfidence: type-reference={inplace=false, type-reference=ProPercentage}  # Confidence information of the Light shape.
      cpp implementation data type element LightShapeValue: is-optional=true, type-reference={inplace=false, type-reference=uint8_t}  # Represents additional countdown value of the Light shape. Link to the enumerator kCountdownSecond or kCountdownPercent.
    TrafficLightSpotVector: category=VECTOR, cpp-template-argument{inplace=false, template-type=TrafficLightSpot}  # Represents a list of traffic light spot.
      namespaces:
        symbol props ara
        symbol props adi
        symbol props sensoritf
    TrafficLightSpots: category=STRUCTURE  # Represents the trafic light spots Information.
      namespaces:
        symbol props ara
        symbol props adi
        symbol props sensoritf
      4 x cpp implementation data type element:
        NoTrafficLightSpots: is-optional=true, type-reference=uint8_t  # Estimation of Total number of traffic light spots which are part of this structure.
        NoTrafficLightSpotsConfidence: is-optional=true, type-reference=ProPercentage  # Confidence information for the Total number of traffic light spots. %
        NoValidLightSpots: type-reference=uint8_t  # The current Number of valid light sopt. Classifications are defined by type and probability value.
        TrafficSLightSpotList: type-reference={inplace=false, type-reference=TrafficLightSpotVector}  # Represents the traffic light spot list.
    TrafficLightTypeInfo: category=STRUCTURE  # Represents the traffic light type certainty Information.
      namespaces:
        symbol props ara
        symbol props adi
        symbol props sensoritf
      cpp implementation data type element ExistPro: type-reference=ProPercentage  # Represents the traffic light existance probablity.
      cpp implementation data type element TLightType: type-reference={inplace=false, type-reference=StructureLightType}  # Represents the traffic light type.
      cpp implementation data type element StructureLightTypeConfidence: type-reference=ProPercentage  # Confidence information of the light’s structure type. %
    TrafficLightVector: category=VECTOR, cpp-template-argument{inplace=false, template-type=TrafficLight}  # Represents a list of traffic light.
      namespaces:
        symbol props ara
        symbol props adi
        symbol props sensoritf
    TrafficLights: category=STRUCTURE  # Represents the traffic lights Information.
      namespaces:
        symbol props ara
        symbol props adi
        symbol props sensoritf
      4 x cpp implementation data type element:
        RecognizedTrafficLightsCap: is-optional=true, type-reference=uint16_t  # Represents the capability of the recognized traffic lights.
        RecognizedTrafficLightsStatus: is-optional=true, type-reference={inplace=false, type-reference=RecognizedStatus}  # The recongnized traffic lights status.
        NoValidTrafficLights: type-reference=uint8_t  # Represents the number of valid traffic lights .
        TrafficLightList: type-reference={inplace=false, type-reference=TrafficLightVector}  # Represents the list of traffic lights .
    TrafficSign: category=STRUCTURE  # Represents the traffic sign Information.
      namespaces:
        symbol props ara
        symbol props adi
        symbol props sensoritf
      5 x cpp implementation data type element:
        MainSignstatus: type-reference={inplace=false, type-reference=ObjectStatus}  # Represents the main sign status.
        MainSignType: type-reference={inplace=false, type-reference=MSignTypeInfo}  # Represents the main sign type information.
        MainSignInfo: type-reference={inplace=false, type-reference=MSignInfo}  # Represents the maisn sign information.
        MainSignPos: type-reference={inplace=false, type-reference=MSignPos}  # Represents the main sign position information.
        SupplementarySigns: type-reference={inplace=false, type-reference=SSigns}  # Represents the supplementary sings infromation.
    TrafficSignVector: category=VECTOR, cpp-template-argument{inplace=false, template-type=TrafficSign}  # Represents a list of traffic sign.
      namespaces:
        symbol props ara
        symbol props adi
        symbol props sensoritf
    TrafficSigns: category=STRUCTURE  # Represents the traffic sings Information.
      namespaces:
        symbol props ara
        symbol props adi
        symbol props sensoritf
      4 x cpp implementation data type element:
        RecognizedTrafficSignsCap: is-optional=true, type-reference=uint16_t  # Represents the capability of the recognized traffic signs.
        RecognizedTrafficSignsStatus: is-optional=true, type-reference={inplace=false, type-reference=RecognizedStatus}  # The recongnized traffic signs status.
        NoValidTrafficSigns: type-reference=uint16_t  # Represents the number of valid traffic signs.
        TrafficSignsList: type-reference={inplace=false, type-reference=TrafficSignVector}  # Represents the list of traffic signs.
    TrilaterationStatus: compu {0x00=kNormal (The 2D position {x, y} measurement is based on at least three points.), 0x01=kNotTrilaterated (The 2D position {x, y} measurement is based on less than three points.), 0x02=kUnknown (The trilateration status is unknown.)}, range raw 0x00..0x02, type-reference=uint8_t  # Information if feature is trilaterated with multiple signal ways or is not trilaterated.
      namespaces:
        symbol props ara
        symbol props adi
        symbol props sensoritf
    UltrasonicDetection: category=STRUCTURE  # Represents the Ultrasonic detection information.
      namespaces:
        symbol props ara
        symbol props adi
        symbol props sensoritf
      cpp implementation data type element UltrasonicDetectionStatus: type-reference={inplace=false, type-reference=DetectionStatus}  # Represnets the Ultrasonic detection status.
      cpp implementation data type element UltrasonicDetetionInfo: type-reference={inplace=false, type-reference=UltrasonicDetectionInfo}  # Ultrasonic detection information.
    UltrasonicDetectionInfo: category=STRUCTURE  # Represents the Ultrasonic detection information.
      namespaces:
        symbol props ara
        symbol props adi
        symbol props sensoritf
      6 x cpp implementation data type element:
        Reflectivity: is-optional=true, type-reference=float  # Reflectivity of the detection w.r.t. norm target.%
        EllipseSemiMinorAxis: type-reference=float  # Distributed sender/receiver sensor (virtual sensor) the distance is the ellipse’s semi-minor axis of the detection. m
        EllipseSemiMajorAxis: is-optional=true, type-reference=float  # Distributed sender/receiver sensor (virtual sensor) the distance is the ellipse’s semi-major axis of the detection. Relevant: virtual sensor. m
        UltrasonicEllipseAxesError: type-reference={inplace=false, type-reference=EllipseAxesError}  # EDistributed sender/receiver sensor (virtual sensor) the distance is the ellipse’s semi-major axis of the detection. Single sensor (real sensor) the semi-major axis is the radius of the detection。
        HeightUltrasonic: is-optional=true, type-reference=float  # Estimated height of the detection in sensor coordinate system. m
        HeightUltrasonicError: is-optional=true, type-reference=float  # Error of the estimated height of the detection in sensor coordinate system. m
    UltrasonicDetectionVector: category=VECTOR, cpp-template-argument{inplace=false, template-type=UltrasonicDetection}  # Represents a list of Ultrasonic detection information.
      namespaces:
        symbol props ara
        symbol props adi
        symbol props sensoritf
    UltrasonicDetections: category=STRUCTURE  # Represents the Ultrasonic detection interface information.
      namespaces:
        symbol props ara
        symbol props adi
        symbol props sensoritf
      cpp implementation data type element Header: type-reference={inplace=false, type-reference=GeneralHeader}  # Represents the header of a Ultrasonic detection interface.
      cpp implementation data type element SensorMountingPos: type-reference={inplace=false, type-reference=SensorMountingInfo}  # The recongnized Ultrasonic Mounting position.
      cpp implementation data type element UltrasonicDetectionsInfo: type-reference={inplace=false, type-reference=UltrasonicDetectionsInfo}  # Represents the Ultrasonic detections information .
    UltrasonicDetectionsInfo: category=STRUCTURE  # Represents the Ultrasonic detections information.
      namespaces:
        symbol props ara
        symbol props adi
        symbol props sensoritf
      4 x cpp implementation data type element:
        RecognizedDetectionsCap: is-optional=true, type-reference=uint32_t  # To indicate the guaranted recongnized detections.
        RecognizedDetectionsStatus: is-optional=true, type-reference={inplace=false, type-reference=RecognizedStatus}  # The recongnized Ultrasonic detections status.
        NoValidDetections: type-reference=uint32_t  # The number of valid Ultrasonic detections in the message.
        UltrasonicDetectionList: type-reference={inplace=false, type-reference=UltrasonicDetectionVector}  # Represents a list of Ultrasonic detections .
    UltrasonicFeature: category=STRUCTURE  # Represents the Ultrasonic feature information.
      namespaces:
        symbol props ara
        symbol props adi
        symbol props sensoritf
      cpp implementation data type element UltrasonicFStatus: type-reference={inplace=false, type-reference=FeatureStatus}  # Represnets the Ultrasonic feature status.
      cpp implementation data type element SegInfo: type-reference={inplace=false, type-reference=UltrasonicSegmentInfo}  # Ultrasonic Segment information.
      cpp implementation data type element SegmentPointsList: type-reference={inplace=false, type-reference=SegmentPointsInfo}  # Ultrasonic points information.
    UltrasonicFeatureType: compu {0x00=kPoint (Defined by one point.), 0x01=kLineSegment (Defined by two or more points.), 0x02=kUnknown (The Ultrasonic feature type is unknown.)}, range raw 0x00..0x02, type-reference=uint8_t  # Ultrasonic feature type contains information about the current measurement of this feature.
      namespaces:
        symbol props ara
        symbol props adi
        symbol props sensoritf
    UltrasonicFeatureVector: category=VECTOR, cpp-template-argument{inplace=false, template-type=UltrasonicFeature}  # Represents a list of Ultrasonic feature information.
      namespaces:
        symbol props ara
        symbol props adi
        symbol props sensoritf
    UltrasonicFeatures: category=STRUCTURE  # Represents the Ultrasonic feature interface information.
      namespaces:
        symbol props ara
        symbol props adi
        symbol props sensoritf
      5 x cpp implementation data type element:
        UltrasonicFHeader: type-reference={inplace=false, type-reference=GeneralHeader}  # Represents the header of a Camera feature interface.
        RecognizedFeaturesCap: is-optional=true, type-reference={inplace=false, type-reference=uint32_t}  # To indicate the guaranted recongnized features.
        RecognizedFeaturesStatus: is-optional=true, type-reference={inplace=false, type-reference=RecognizedStatus}  # The recongnized Ultrasonic features status.
        NoValidFeatures: type-reference={inplace=false, type-reference=uint32_t}  # The number of valid Ultrasonic features in the message.
        UltrasonicFeatueList: type-reference={inplace=false, type-reference=UltrasonicFeatureVector}  # Represents a list of Ultrasonic features .
    UltrasonicSegmentInfo: category=STRUCTURE  # Represents the Ultrasonic segmengt type information.
      namespaces:
        symbol props ara
        symbol props adi
        symbol props sensoritf
      cpp implementation data type element UltrasonicFType: type-reference={inplace=false, type-reference=UltrasonicFeatureType}  # Represents the Ultrasonic feature class type.
      cpp implementation data type element UltrasonicProValue: type-reference={inplace=false, type-reference=ProPercentage}  # Probability of the ultrasonic feature type.
    ValidPointInfo: category=STRUCTURE  # Represents the valid points information.
      namespaces:
        symbol props ara
        symbol props adi
        symbol props sensoritf
      10 x cpp implementation data type element:
        Position2D: type-reference={inplace=false, type-reference=Point2D}  # 2D point in vehicle coordinate system
        Position2DError: type-reference={inplace=false, type-reference=Point2DError}  # Represents the Error Value of the feature, the unit is {m,m}.
        OrientationUltrasonic: is-optional=true, type-reference={inplace=false, type-reference=float}  # The orientation of the feature of the plane. rad
        OrientationUltrasonicError: is-optional=true, type-reference={inplace=false, type-reference=float}  # Error value for feature’s Orientation – feature level {vertical},rad.
        HeightUltrasonic: is-optional=true, type-reference={inplace=false, type-reference=float}  # Information about the height of the point, resp. upper edge of the feature.Height with respect to the vehicle origin.m
        HeightUltrasonicError: is-optional=true, type-reference={inplace=false, type-reference=float}  # Error value for feature’s Height – feature level. m
        VelocityUltrasonic: is-optional=true, type-reference={inplace=false, type-reference=Point2D}  # Velocity {x, y} over ground of the feature in the vehicle coordinate system (see Vehicle coordinate system type. (m/s, m/s)
        VelocityUltrasonicError: is-optional=true, type-reference={inplace=false, type-reference=Point2DError}  # Error values for feature Velocity {x, y} in the vehicle coordinate system (see Vehicle coordinate system type. (m/s, m/s)
        TriStatus: type-reference={inplace=false, type-reference=TrilaterationStatus}  # The Trilateration Status
        FeatureMStatus: is-optional=true, type-reference={inplace=false, type-reference=MeasurementStatusFeature}  # The feature measurement status.
    ValidPointInfoVector: category=VECTOR, cpp-template-argument{inplace=false, template-type=ValidPointInfo}  # Represents a list of shape points information.
      namespaces:
        symbol props ara
        symbol props adi
        symbol props sensoritf
    VanishingPointDirection2DSpheric: category=STRUCTURE  # A set of lines in the image plane that corresponds to a set of parallel surface lines in the 3D world space converges to a common point in the image space known as the Vanishing point {azimuth, elevation}.The unit is {rad,rad}.
      namespaces:
        symbol props ara
        symbol props adi
        symbol props sensoritf
      cpp implementation data type element Azimuth: type-reference=float  # The azimuth angle.
      cpp implementation data type element Elevation: type-reference=float  # The elevation angle.
    VanishingPointDirection2DSphericError: category=STRUCTURE  # Uncertainty of the Vanishing point {azimuth, elevation},using Error value.The unit is {rad,rad}.
      namespaces:
        symbol props ara
        symbol props adi
        symbol props sensoritf
      cpp implementation data type element Azimuth: type-reference=float  # The azimuth angle.
      cpp implementation data type element Elevation: type-reference=float  # The elevation angle.
    VanishingPointInfo: category=STRUCTURE  # Represents the vanishing point info.
      namespaces:
        symbol props ara
        symbol props adi
        symbol props sensoritf
      cpp implementation data type element VPDirection: type-reference={inplace=false, type-reference=VanishingPointDirection2DSpheric}  # Represents the vanishing point {azimuth, elevation}.
      cpp implementation data type element VPError: is-optional=true, type-reference={inplace=false, type-reference=VanishingPointDirection2DSphericError}  # Represents the Error of the vanishing point {azimuth, elevation}.
    VariableMessageSign: compu {0x00=kStatic (Message sign is no variable message sign.), 0x01=kVariable (Spline interpolation between two sequential points.), 0x02=kNotAvailable (Message sign is out of service.), 0x03=kUnknown (Message changable is unknown.)}, range raw 0x00..0x03, type-reference=uint8_t  # Describing whether or not the message of the sign is variable/changeable, static or if that information is not available.
      namespaces:
        symbol props ara
        symbol props adi
        symbol props sensoritf
    VehicleCoordinateSystemType: compu {0x00=kRearAxle (Use vehicle rear axle coordinate system.), 0x01=kRoadLevel (Use vehicle road level coordinate system.)}, range raw 0x00..0x01, type-reference=uint8_t  # Defines the reference vehicle coordinate system for the interfaces of the sensor.
      namespaces:
        symbol props ara
        symbol props adi
        symbol props sensoritf
    Version: category=STRUCTURE  # Represents the version of the service.
      namespaces:
        symbol props ara
        symbol props adi
        symbol props sensoritf
      cpp implementation data type element Major: type-reference=uint8_t  # Service Major Version
      cpp implementation data type element Minor: type-reference=uint8_t  # Service Minor Version
      cpp implementation data type element Patch: type-reference=uint8_t  # Service Patch Version
    VertexPointConfidence: category=STRUCTURE  # Measured longitudinal, lateral and vertical distance of the vertex confidence.
      namespaces:
        symbol props ara
        symbol props adi
        symbol props sensoritf
      cpp implementation data type element Vpcx: type-reference=float  # Represents in x dimension.
      cpp implementation data type element Vpcy: type-reference=float  # Represents in y dimension.
      cpp implementation data type element Vpcz: type-reference=float  # Represents in z dimension.
    VertexPointInfo: category=STRUCTURE  # Represents the vertex point Information.
      namespaces:
        symbol props ara
        symbol props adi
        symbol props sensoritf
      9 x cpp implementation data type element:
        VertexPoint: type-reference={inplace=false, type-reference=Point3D}  # Measured longitudinal, lateral and vertical distance of the vertex. {m,m,m}
        VertexPointError: type-reference={inplace=false, type-reference=Point3DError}  # Represents the Error Value.
        Confidence: is-optional=true, type-reference={inplace=false, type-reference=VertexPointConfidence}  # Represents the condidence of the Vertex Point.
        WidthVertex: is-optional=true, type-reference={inplace=false, type-reference=float}  # Measured width of the vertex at the middle of the vertex.. m
        WidthVertexError: is-optional=true, type-reference={inplace=false, type-reference=float}  # The Error Value of the measured width at the middle of the vertex. m
        WidthVertexConfidence: is-optional=true, type-reference={inplace=false, type-reference=ProPercentage}  # Represents the confidence of the width for the vertex.
        HeightVertex: is-optional=true, type-reference={inplace=false, type-reference=float}  # The measured height of the vertex at the middle of the vertex. m
        HeightVertexError: is-optional=true, type-reference={inplace=false, type-reference=float}  # The Error Value of the measured height at the middle of the vertex.. m
        HeightVertexConfidence: is-optional=true, type-reference={inplace=false, type-reference=ProPercentage}  # The confidence of the height at the middle of the vertex. %
    VertexPointInfoVector: category=VECTOR, cpp-template-argument{inplace=false, template-type=VertexPointInfo}  # Represents a list of vertex points information.
      namespaces:
        symbol props ara
        symbol props adi
        symbol props sensoritf
    VerticalAngle: category=STRUCTURE  # FOV defined by opening angles in sensor XZ-plane. (rad, rad)
      namespaces:
        symbol props ara
        symbol props adi
        symbol props sensoritf
      cpp implementation data type element Begin: type-reference=float  # The starting point.
      cpp implementation data type element End: type-reference=float  # The end point.

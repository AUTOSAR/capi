AUTOSAR XML (schema 00049)
package /ISOFT/PlatformComponents/cryptox509
  persistency file storage interface cryptox509d_FileStorage_interface_cert: redundancy-handlings=persistency-redundancy-crc={algorithm-family=CRC_32P4, length=32}, max-number-of-files=32

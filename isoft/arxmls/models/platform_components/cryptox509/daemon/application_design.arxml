AUTOSAR XML (schema 00049)
package /ISOFT/PlatformComponents/cryptox509
  adaptive application sw component type swc_type_cryptox509
    provide/require port prPort_fileStorage_cert: provided-required-interface=cryptox509d_FileStorage_interface_cert
  executable cryptox509d: category=PLATFORM_LEVEL, build-type=BUILD-TYPE-DEBUG, logging-behavior=USES-LOGGING, minimum-timer-granularity=0.001, reporting-behavior=REPORTS-EXECUTION-STATE, version=1.0.0
    root sw component prototype cryptox509d_swc_root: application-type=swc_type_cryptox509
  process design cryptox509_proc_design: executable=cryptox509d

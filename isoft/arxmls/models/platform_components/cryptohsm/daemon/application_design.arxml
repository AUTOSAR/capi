AUTOSAR XML (schema 00049)
package /ISOFT/PlatformComponents/cryptohsm
  adaptive application sw component type swc_type_cryptohsm
    provide/require port prPort_kvStorage_hsmKeySlot: provided-required-interface=cryptohsmd_kvStorage_interface_keySlot
  executable cryptohsmd: category=PLATFORM_LEVEL, build-type=BUILD-TYPE-DEBUG, logging-behavior=USES-LOGGING, minimum-timer-granularity=0.001, reporting-behavior=REPORTS-EXECUTION-STATE, version=1.0.0
    root sw component prototype cryptohsmd_swc_root: application-type=swc_type_cryptohsm
  process design cryptohsm_proc_design: executable=cryptohsmd

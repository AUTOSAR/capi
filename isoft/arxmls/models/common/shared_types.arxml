AUTOSAR XML (schema 00049)
package /ISOFT/SharedTypes
  std cpp implementation data type ByteArray: category=VECTOR, cpp-template-argument=uint8_t, type-emitter=TYPE_EMITTER_ARA
  std cpp implementation data type String: category=STRING, type-emitter=TYPE_EMITTER_ARA

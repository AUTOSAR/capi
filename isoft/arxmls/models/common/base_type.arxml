AUTOSAR XML (schema 00049)
standard types defined: double, float
package /iSOFT/Usability/SwBaseType
  12 x base type, all with category=FIXED_LENGTH:
    bool: base-type-size=8, base-type-encoding=BOOLEAN
    int16_t: base-type-size=16, base-type-encoding=2C
    int32_t: base-type-size=32, base-type-encoding=2C
    int64_t: base-type-size=64, base-type-encoding=2C
    int8_t: base-type-size=8, base-type-encoding=2C
    uint16_t: base-type-size=16, base-type-encoding=NONE
    uint32_t: base-type-size=32, base-type-encoding=NONE
    uint64_t: base-type-size=64, base-type-encoding=NONE
    uint8_t: base-type-size=8, base-type-encoding=NONE
    utf16be: base-type-size=16, base-type-encoding=UTF-16, byte-order=big-endian
    utf16le: base-type-size=16, base-type-encoding=UTF-16, byte-order=little-endian
    utf8: base-type-size=8, base-type-encoding=UTF-8

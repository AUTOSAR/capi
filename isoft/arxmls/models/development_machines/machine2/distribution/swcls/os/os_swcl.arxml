AUTOSAR XML (schema 00049)
package /ISOFT/Development/SoftwareClusters2
  software cluster os: category=ISOFT_CORE_OS, type-approval=e1*2024/123*4567*89, vendor-id=1, version=20.4.2

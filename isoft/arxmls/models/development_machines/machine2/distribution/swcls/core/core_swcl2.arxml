AUTOSAR XML (schema 00049)
package /ISOFT/Development/SoftwareClusters2
  software cluster core:
    category=PLATFORM_CORE
    claimed-function-group=MachineFG
    contained-ar-element=[Machine2, smd, ResetMachine, shutdown, shell_request_client]
    contained-process=[cgd_proc2, nsomeip_routing_proc2, daemon_proc2, nm_daemon_proc2, phmd_process2, state_manager, tsync_daemon_proc2, package_manager, ucmm2, reset_machine_process, shutdown_process, shell_request_proc]
    depends-on={category=FUNCTIONAL_DEPENDENCY, operator=LOGICAL-AND, parts=[{compare-type=IS-GREATER-THAN-OR-EQUAL, consider-build-number=false, software-cluster=framework, version=1.0.0}, {compare-type=IS-GREATER-THAN-OR-EQUAL, consider-build-number=false, software-cluster=os, version=20.4.2}]}
    software-cluster-doip-diagnostic-address{address-semantics=PHYSICAL-ADDRESS, diagnostic-address=1002}
    diagnostic-extract=DiagnosticContributionSet_core
    module-instantiation=doip
    type-approval=e1*2024/123*4567*89
    vendor-id=1
    version=1.0.0

AUTOSAR XML (schema 00049)
package /ISOFT/Development/DiagnosticContributionSet/Machine2
  diagnostic contribution set DiagnosticContributionSet_core: category=DIAGNOSTICS_SWCL_EXTRACT, service-tables=[DiagnosticServiceTable_common, DiagnosticServiceTable_sm]
    elements:
      DiagnosticAccessPermission_0
      DiagnosticEcuResetClass_0
      DiagnosticEcuReset_0x01
      DiagnosticEcuReset_0x01
      DiagnosticEcuReset_0x03
      DiagnosticEcuReset_0x03
      DiagnosticEcuReset_0x04
      DiagnosticEcuReset_0x04
      DiagnosticServiceTable_common
      DiagnosticServiceTable_sm
      DiagnosticSessionControlClass
      DiagnosticSessionControl_0x01
      DiagnosticSession_0x01

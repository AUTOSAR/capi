AUTOSAR XML (schema 00049)
package /ISOFT/Development/SoftwareClusters2
  software cluster framework: category=ISOFT_FRAMEWORK, contained-ar-element=[cgd, nsomeipd, cryptod, dmd, logd, nmd, phmd, tsyncd, ucmd, ucmmd], type-approval=e1*2024/123*4567*89, vendor-id=1, version=1.0.0

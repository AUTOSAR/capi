AUTOSAR XML (schema 00049)
package /ISOFT/Development/CryptoServiceCertificates2
  crypto service certificate vendorServiceCert: algorithm-family=RSA, format=CVC, maximum-length=1
  crypto service certificate packagerServiceCert: algorithm-family=RSA, format=CVC, maximum-length=1
package /ISOFT/Development/ComCertificateToCryptoCertificateMapping2
  com certificate to crypto certificate mapping vendorCertificateMapping: crypto-certificate=vendor_certificate, crypto-service-certificate=vendorServiceCert
  com certificate to crypto certificate mapping packagerCertificateMapping: crypto-certificate=packager_certificate, crypto-service-certificate=packagerServiceCert

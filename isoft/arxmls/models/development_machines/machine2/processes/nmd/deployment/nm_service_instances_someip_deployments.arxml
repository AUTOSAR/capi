AUTOSAR XML (schema 00049)
package /ara/nm/instance
  provided someip service instance ProvidedInstanceNetworkState_1_machine2: service-interface-deployment=NetworkState, sd-server-config=nm_SomeipServerServiceInstanceConfig2, service-instance-id=200
    6 x someip provided event group, all with multicast-threshold=0:
      ProvidedEventgroup12: event-group=NetworkCurrentStateEventgroup1
      ProvidedEventgroup22: event-group=NetworkRequestedStateEventgroup
      NotifyPresentNodeList12: event-group=NotifyPresentNodeList1
      NotifyEtherStateChanged12: event-group=NotifyEtherStateChanged1
      NotifyPassivePnRequest12: event-group=NotifyPassivePnRequest1
      NotifyPassivePnRelease12: event-group=NotifyPassivePnRelease1

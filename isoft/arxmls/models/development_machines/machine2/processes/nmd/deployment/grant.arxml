AUTOSAR XML (schema 00049)
package /ISOFT/Development
  machine Machine2
    iam module instantiation IamModuleInstantiation: grant=[nmfieldNetworkRequestedStategrant2, nmfiledgrantcurrent2, nmoffergrant2]
package /ISOFT/Development/iam
  com field grant nmfieldNetworkRequestedStategrant2: service-instance=ProvidedInstanceNetworkState_1_machine2, role=GETTER-SETTER, service-deployment=NetworkRequestedState
  com field grant nmfiledgrantcurrent2: service-instance=ProvidedInstanceNetworkState_1_machine2, role=GETTER, service-deployment=NetworkCurrentState
  com offer service grant nmoffergrant2: design=nmofferservicegrantdesign, service-instance=ProvidedInstanceNetworkState_1_machine2

AUTOSAR XML (schema 00049)
package /ISOFT/PlatformComponents/nm
  process nm_daemon_proc2: design=network_manager_design, executable=nmd, state-dependent-startup-config{execution-dependency=processStatMachine.Running, function-group-state=[MachineFG.Restart, MachineFG.Startup, MachineFG.Verify], resource-group=DefaultResourceGroup, startup-config=normal}
    process state machine processStatMachine: type=ProcessStateMachine
  startup config set nm_daemon_startup_configs2
    startup config normal: scheduling-policy=SCHED_OTHER, scheduling-priority=12, termination-behavior=PROCESS-IS-NOT-SELF-TERMINATING

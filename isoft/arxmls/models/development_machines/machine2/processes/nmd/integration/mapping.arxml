AUTOSAR XML (schema 00049)
package /ServerMapping2
  dlt log channel to process mapping dltLogChannelToProcessMapping_3: dlt-log-channel=nm_dlt, process=nm_daemon_proc2
  process to machine mapping set mappingSet
    process to machine mapping ServerMapping: machine=Machine2, process=nm_daemon_proc2

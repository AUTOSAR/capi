AUTOSAR XML (schema 00049)
package /ISOFT/PlatformComponents/phm/mapping2
  process to machine mapping set process_to_machine_set
    process to machine mapping phm_mapping2: machine=Machine2, process=phmd_process2
  dlt log channel to process mapping dltLogChannelToProcessMapping: dlt-log-channel=phm_dlt, process=phmd_process2

AUTOSAR XML (schema 00049)
package /ISOFT/PlatformComponents/tsync/tsync_daemon_mapping2
  process to machine mapping set process_to_machine_set
    process to machine mapping item: machine=Machine2, process=tsync_daemon_proc2
  dlt log channel to process mapping dltLogChannelToProcessMapping_2: dlt-log-channel=tsync_dlt, process=tsync_daemon_proc2

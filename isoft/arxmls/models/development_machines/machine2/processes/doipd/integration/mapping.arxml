AUTOSAR XML (schema 00049)
package /ISOFT/PlatformComponents/diag/DltLogChannelToProcessMapping
  dlt log channel to process mapping doipd_dlt: dlt-log-channel=doipd_dlt, process=doipd
package /ISOFT/PlatformComponents/diag/ProcessToMachineMappingSet
  process to machine mapping set doipd
    process to machine mapping doipd: machine=Machine2, process=doipd

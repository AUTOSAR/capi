AUTOSAR XML (schema 00049)
package /ara/ucm_master/mapping2
  process to machine mapping set DevelopmentMachineMappings
    process to machine mapping VehiclePackageManagerToMachineMapping: machine=Machine2, process=ucmm2
  someip service instance to machine mapping ProvidedInstanceToMachineMapping: communication-connector=CommunicationConnector1, service-instance=[ProvidedSomeIpVehicleDriverApplicationInstance2, ProvidedSomeIpVehicleStateManagerInstance2, ProvidedSomeIpVehiclePackageManagementInstance2], tcp-port=32000, udp-port=32000
  service instance to port prototype mapping ProvidedVehicleDriverApplicationInstanceToPortMapping: port-prototype=ucmm_root.VehicleDriverApplicationPPort, process-design=ucmm_design, process=ucmm2, service-instance=ProvidedSomeIpVehicleDriverApplicationInstance2
  service instance to port prototype mapping ProvidedVehiclePackageManagementInstanceToPortMapping: port-prototype=ucmm_root.VehiclePackageManagementPPort, process-design=ucmm_design, process=ucmm2, service-instance=ProvidedSomeIpVehiclePackageManagementInstance2
  service instance to port prototype mapping ProvidedVehicleStateManagerInstanceToPortMapping: port-prototype=ucmm_root.VehicleStateManagerPPort, process-design=ucmm_design, process=ucmm2, service-instance=ProvidedSomeIpVehicleStateManagerInstance2
  someip service instance to machine mapping RequiredInstanceToMachineMapping: communication-connector=CommunicationConnector1, service-instance=RequiredSomeIpPackageManagementInstance2, tcp-port=32001, udp-port=32001
  service instance to port prototype mapping RequiredPackageManagementInstanceToPortMapping: port-prototype=ucmm_root.PackageManagementRPort, process-design=ucmm_design, process=ucmm2, service-instance=RequiredSomeIpPackageManagementInstance2
  persistency port prototype to key value storage mapping SwPackageTransferStatusDatabaseToPortMapping: port-prototype=ucmm_root.SwPackageTransferStatusPRPort, process=ucmm2, key-value-storage=SwPackageTransferStatusDatabase
  persistency port prototype to key value storage mapping CampaignHistoryDatabaseToPortMapping: port-prototype=ucmm_root.CampaignHistoryPRPort, process=ucmm2, key-value-storage=CampaignHistoryDatabase
  dlt log channel to process mapping dltLogChannelToProcessMapping: dlt-log-channel=ucmm_dlt, process=ucmm2

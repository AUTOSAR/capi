AUTOSAR XML (schema 00049)
package /ara/ucm_master/PersistencyKeyValueDatabases2
  persistency key value storage SwPackageTransferStatusDatabase: maximum-allowed-size=4194304, minimum-sustained-size=4096, uri=ucmm/master_per_kv
  persistency key value storage CampaignHistoryDatabase: maximum-allowed-size=4194304, minimum-sustained-size=4096, uri=ucmm/master_per_kv

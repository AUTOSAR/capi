AUTOSAR XML (schema 00049)
package /ara/ucm_master/instance
  provided someip service instance ProvidedSomeIpVehicleStateManagerInstance2: service-interface-deployment=VehicleStateManagerSomeIp, sd-server-config=SomeIpServerServiceInstanceConfig, service-instance-id=200
    someip provided event group SafetyPolicy_provided_eventgroup: event-group=SafetyPolicy_eventgroup

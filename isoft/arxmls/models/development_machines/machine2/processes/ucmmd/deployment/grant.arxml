AUTOSAR XML (schema 00049)
package /ISOFT/Development
  machine Machine2
    iam module instantiation IamModuleInstantiation: grant=[ucmm_ucmfieldgrant2, ucmm_ucmfindservicegrant_2, ucmm_ucmofferservicegrant1_2, ucmm_ucmofferservicegrant2_2, ucmm_ucmofferservicegrant3_2]
package /ISOFT/Development/iam
  com field grant ucmm_ucmfieldgrant2: service-instance=RequiredSomeIpPackageManagementInstance2, role=GETTER, service-deployment=CurrentStatus
  com find service grant ucmm_ucmfindservicegrant_2: design=ucmm_ucmfindservicegrantdesign, service-instance=RequiredSomeIpPackageManagementInstance2
  com offer service grant ucmm_ucmofferservicegrant1_2: design=ucmm_ucmofferservicegrantdesign1, service-instance=ProvidedSomeIpVehicleDriverApplicationInstance2
  com offer service grant ucmm_ucmofferservicegrant2_2: design=ucmm_ucmofferservicegrantdesign2, service-instance=ProvidedSomeIpVehiclePackageManagementInstance2
  com offer service grant ucmm_ucmofferservicegrant3_2: design=ucmm_ucmofferservicegrantdesign3, service-instance=ProvidedSomeIpVehicleStateManagerInstance2

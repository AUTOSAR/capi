AUTOSAR XML (schema 00049)
package /ara/ucm_master/instance
  provided someip service instance ProvidedSomeIpVehicleDriverApplicationInstance2: service-interface-deployment=VehicleDriverApplicationSomeIp, sd-server-config=SomeIpServerServiceInstanceConfig, service-instance-id=200
    4 x someip provided event group:
      Approvalprovided_provided_eventgroup: event-group=ApprovalRequired_eventgroup
      CampaignState_provided_eventgroup: event-group=CampaignState_eventgroup
      SafetyPolicy_provided_eventgroup: event-group=SafetyPolicy_eventgroup
      SafetyState_provided_eventgroup: event-group=SafetyState_eventgroup

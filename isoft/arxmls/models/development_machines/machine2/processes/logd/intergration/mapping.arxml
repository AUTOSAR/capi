AUTOSAR XML (schema 00049)
package /ISOFT/PlatformComponents/log/daemon_mapping2
  process to machine mapping set process_to_machine_set
    process to machine mapping item: machine=Machine2, process=daemon_proc2

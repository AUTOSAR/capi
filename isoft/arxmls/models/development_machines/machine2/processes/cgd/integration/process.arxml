AUTOSAR XML (schema 00049)
package /ISOFT/PlatformComponents/cg
  process cgd_proc2: design=cgd_proc_design, executable=cgd, state-dependent-startup-config{execution-dependency=processStatMachine.Running, function-group-state=[MachineFG.Restart, MachineFG.Startup, MachineFG.Verify], resource-group=DefaultResourceGroup, startup-config=server}
    process state machine processStatMachine: type=ProcessStateMachine
  startup config set cgd_startup_configs2
    startup config server: scheduling-policy=SCHED_OTHER, scheduling-priority=12, termination-behavior=PROCESS-IS-NOT-SELF-TERMINATING
    startup config verify: scheduling-policy=SCHED_OTHER, scheduling-priority=12, termination-behavior=PROCESS-IS-NOT-SELF-TERMINATING

AUTOSAR XML (schema 00049)
package /iSOFT/Machine2/core/cg/ServiceInstanceToPortPrototypeMapping
  4 x service instance to port prototype mapping, all with process-design=cgd_proc_design, process=cgd_proc2:
    SomeipCGProvidedDiagnosticResetServerInstance2: port-prototype=root_swc.CgServerPDiagnosticResetServer, service-instance=SomeipProvidedDiagnosticResetServerInstance2
    SomeipCGProvidedPowerModeServerInstance2: port-prototype=root_swc.CgServerPPowerModeServer, service-instance=SomeipProvidedPowerModeServerInstance2
    SomeipCGRequiredDiagnosticResetClientInstance2: port-prototype=root_swc.CgServerRDiagnosticResetClient, service-instance=SomeipRequiredDiagnosticResetClientInstance2
    SomeipCGRequiredPowerModeClientInstance2: port-prototype=root_swc.CgServerRPowerModeClient, service-instance=SomeipRequiredPowerModeClientInstance2
package /iSOFT/Machine2/core/cg/SomeipServiceInstanceToMachineMapping
  someip service instance to machine mapping ProvidedInstanceToMachineMapping: communication-connector=CommunicationConnector1, service-instance=[SomeipProvidedDiagnosticResetServerInstance2, SomeipProvidedPowerModeServerInstance2], tcp-port=32000, udp-port=32000
  someip service instance to machine mapping RequiredInstanceToMachineMapping: communication-connector=CommunicationConnector1, service-instance=[SomeipRequiredDiagnosticResetClientInstance2, SomeipRequiredPowerModeClientInstance2], tcp-port=32001, udp-port=32001

AUTOSAR XML (schema 00049)
package /ISOFT/PlatformComponents/cg/nsomeip_routing_mapping2
  dlt log channel to process mapping dltLogChannelToProcessMapping_2: dlt-log-channel=cgd_dlt, process=cgd_proc2
  process to machine mapping set process_to_machine_set
    process to machine mapping item: machine=Machine2, process=cgd_proc2

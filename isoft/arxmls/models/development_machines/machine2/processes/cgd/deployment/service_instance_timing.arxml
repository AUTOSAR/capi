AUTOSAR XML (schema 00049)
package /iSOFT/Machine2/core/cg/timing
  someip sd client event group timing config cgd_DiagnosticReset_Client_EventGroup_Config2: time-to-live=8
  someip sd client service instance config cgd_DiagnosticReset_Client_InstanceConfig2: service-find-time-to-live=8
  someip sd server service instance config cgd_DiagnosticReset_Server_InstanceConfig2: initial-offer-behavior={initial-delay-max-value=0.1, initial-delay-min-value=0.01, initial-repetitions-base-delay=0.2, initial-repetitions-max=3}, offer-cyclic-delay=2.0, request-response-delay={max-value=1.5, min-value=1.5}, service-offer-time-to-live=8
  someip sd client event group timing config cgd_PowerMode_Client_EventGroup_Config2: time-to-live=8
  someip sd client service instance config cgd_PowerMode_Client_InstanceConfig2: service-find-time-to-live=8
  someip sd server service instance config cgd_PowerMode_Server_InstanceConfig2: initial-offer-behavior={initial-delay-max-value=0.1, initial-delay-min-value=0.01, initial-repetitions-base-delay=0.2, initial-repetitions-max=3}, offer-cyclic-delay=2.0, request-response-delay={max-value=1.5, min-value=1.5}, service-offer-time-to-live=8

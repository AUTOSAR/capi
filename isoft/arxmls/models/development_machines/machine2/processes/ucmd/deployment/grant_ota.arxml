AUTOSAR XML (schema 00049)
package /ISOFT/Development
  machine Machine2
    iam module instantiation IamModuleInstantiation: grant=[ucm_ota_ucmm_fieldgrant2, ucm_ota_ucmm_offerservicegrant2]
package /ISOFT/Development/iam
  com field grant ucm_ota_ucmm_fieldgrant2: service-instance=ProvidedSomeIpPackageManagementInstance2, role=GETTER, service-deployment=CurrentStatus
  com offer service grant ucm_ota_ucmm_offerservicegrant2: design=ucm_ota_ucmm_offerservicegrantdesign, service-instance=ProvidedSomeIpPackageManagementInstance2

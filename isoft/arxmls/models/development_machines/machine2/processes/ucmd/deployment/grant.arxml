AUTOSAR XML (schema 00049)
package /ISOFT/Development
  machine Machine2
    iam module instantiation IamModuleInstantiation: grant=[ucm_sm_findservicegrant2, ucm_sm_methodgrant1_2, ucm_sm_methodgrant2_2, ucm_sm_methodgrant3_2, ucm_sm_methodgrant4_2, ucm_sm_methodgrant5_2, ucm_sm_methodgrant6_2]
package /ISOFT/Development/iam
  com find service grant ucm_sm_findservicegrant2: design=ucm_sm_findservicegrantdesign, service-instance=RequiredSomeIpUpdateRequestInstance2
  6 x com method grant, all with service-instance=RequiredSomeIpUpdateRequestInstance2:
    ucm_sm_methodgrant1_2: design=ucm_sm_methodgrantdesign1, service-deployment=SM_StartUpdateSession
    ucm_sm_methodgrant2_2: design=ucm_sm_methodgrantdesign2, service-deployment=SM_StopUpdateSession
    ucm_sm_methodgrant3_2: design=ucm_sm_methodgrantdesign3, service-deployment=SM_ResetMachine
    ucm_sm_methodgrant4_2: design=ucm_sm_methodgrantdesign4, service-deployment=SM_PrepareUpdate
    ucm_sm_methodgrant5_2: design=ucm_sm_methodgrantdesign5, service-deployment=SM_VerifyUpdate
    ucm_sm_methodgrant6_2: design=ucm_sm_methodgrantdesign6, service-deployment=SM_PrepareRollback

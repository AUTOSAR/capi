AUTOSAR XML (schema 00049)
package /ISOFT/PlatformComponents/ucm2
  process package_manager: design=package_manager_design, executable=ucmd, function-cluster-affiliation=ISOFT_UCM, state-dependent-startup-config{execution-dependencys=[processStatMachine.Running, processStatMachine.Running], function-group-state=[MachineFG.Restart, MachineFG.Startup, MachineFG.Verify, MachineFG.Fallback], resource-group=DefaultResourceGroup, startup-config=server}
    process state machine processStatMachine: type=ProcessStateMachine
  startup config set package_manager_startup_configs
    startup config server: process-arguments=[--disable-authn, true], scheduling-policy=SCHED_OTHER, scheduling-priority=12, termination-behavior=PROCESS-IS-NOT-SELF-TERMINATING

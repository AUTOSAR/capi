AUTOSAR XML (schema 00049)
package /ara/ucm/mapping2
  process to machine mapping set DevelopmentMachineMappings
    process to machine mapping PackageManagerToMachineMapping: machine=Machine2, process=package_manager
  someip service instance to machine mapping ProvidedInstanceToMachineMapping: communication-connector=CommunicationConnector1, service-instance=ProvidedSomeIpPackageManagementInstance2, tcp-port=32000, udp-port=32000
  service instance to port prototype mapping ProvidedPackageManagementInstanceToPortMapping: port-prototype=package_manager_root.PackageManagement, process-design=package_manager_design, process=package_manager, service-instance=ProvidedSomeIpPackageManagementInstance2
  someip service instance to machine mapping RequiredInstanceToMachineMapping: communication-connector=CommunicationConnector1, service-instance=RequiredSomeIpUpdateRequestInstance2, tcp-port=32001, udp-port=32001
  service instance to port prototype mapping RequiredUpdateRequestInstanceToPortMapping: port-prototype=package_manager_root.UpdateRequestRPort, process-design=package_manager_design, process=package_manager, service-instance=RequiredSomeIpUpdateRequestInstance2
  persistency port prototype to key value storage mapping SwPackageTransferStatusDatabaseToPortMapping: port-prototype=package_manager_root.SwPackageTransferStatusPRPort, process=package_manager, key-value-storage=SwPackageTransferStatusDatabase
  dlt log channel to process mapping dltLogChannelToProcessMapping: dlt-log-channel=ucm_dlt, process=package_manager
  dlt log channel to process mapping dltDefaultLogChannelToProcessMapping: dlt-log-channel=ucm_dlt_default, process=package_manager

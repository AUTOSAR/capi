AUTOSAR XML (schema 00049)
package /ara/sm_shell_request_client/processes2
  process shell_request_proc: design=shell_request_client_design, executable=shell_request_client

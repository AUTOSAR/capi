AUTOSAR XML (schema 00049)
package /sm_shell_request_client_machine_mapping2
  process to machine mapping set DevelopmentMachineMappings
    process to machine mapping PackageManagerSampleToMachineMapping: machine=Machine2, process=shell_request_proc
  dlt log channel to process mapping dltLogChannelToProcessMapping_2: dlt-log-channel=shell_request_client, process=shell_request_proc

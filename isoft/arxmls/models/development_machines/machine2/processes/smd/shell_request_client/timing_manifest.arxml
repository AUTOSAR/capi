AUTOSAR XML (schema 00049)
package /ara/sm_shell_request_client/timing2
  someip sd client service instance config SomeipClientServiceInstanceConfig: initial-find-behavior={initial-delay-max-value=0.1, initial-delay-min-value=0.01, initial-repetitions-base-delay=0.2, initial-repetitions-max=3}, service-find-time-to-live=8

AUTOSAR XML (schema 00049)
package /ISOFT/Development
  machine Machine2
    iam module instantiation IamModuleInstantiation: grant=[shell_sm_findservicegrant2, shell_sm_methodgrant21, shell_sm_methodgrant22, shell_sm_methodgrant23, shell_sm_methodgrant24]
package /ISOFT/Development/iam
  com find service grant shell_sm_findservicegrant2: design=shell_sm_findservicegrantdesign, service-instance=RequiredSomeIpShellRequestInstance2
  5 x com method grant, all with service-instance=RequiredSomeIpShellRequestInstance2:
    shell_sm_methodgrant21: design=shell_sm_methodgrantdesign1, service-deployment=SM_SetSMState
    shell_sm_methodgrant22: design=shell_sm_methodgrantdesign2, service-deployment=SM_GetSMState
    shell_sm_methodgrant23: design=shell_sm_methodgrantdesign3, service-deployment=SM_SetFGState
    shell_sm_methodgrant24: design=shell_sm_methodgrantdesign4, service-deployment=SM_GetFGState
    shell_sm_methodgrant25: design=shell_sm_methodgrantdesign5, service-deployment=SM_GetAllFunctionGroupsInfo

AUTOSAR XML (schema 00049)
package /ResetMachineApp2
  process reset_machine_process: executable=ResetMachine, state-dependent-startup-config{function-group-state=MachineFG.Restart, resource-group=DefaultResourceGroup, startup-config=restart}
    process state machine processStatMachine: type=ProcessStateMachine
  startup config set startup_set
    startup config restart: scheduling-policy=SCHED_OTHER, scheduling-priority=12, termination-behavior=PROCESS-IS-SELF-TERMINATING

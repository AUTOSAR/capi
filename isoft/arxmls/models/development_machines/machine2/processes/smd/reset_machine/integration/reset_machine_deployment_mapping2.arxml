AUTOSAR XML (schema 00049)
package /ResetMachineMapping2
  dlt log channel to process mapping dltLogChannelToProcessMapping_2: dlt-log-channel=reset_machine, process=reset_machine_process
  process to machine mapping set mappingSet
    process to machine mapping ResetMachineMapping: machine=Machine2, process=reset_machine_process

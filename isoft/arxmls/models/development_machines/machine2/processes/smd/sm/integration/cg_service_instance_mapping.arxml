AUTOSAR XML (schema 00049)
package /iSOFT/Machine2/core/sm/ServiceInstanceToPortPrototypeMapping
  service instance to port prototype mapping SomeipCGRequiredDiagnosticResetServerInstance: port-prototype=state_manager.CgServerRDiagnosticResetServer, process-design=state_manager_instance_design, process=state_manager, service-instance=SomeipRequiredDiagnosticResetServerInstance2
  service instance to port prototype mapping SomeipCGRequiredPowerModeServerInstance: port-prototype=state_manager.CgServerRPowerModeServer, process-design=state_manager_instance_design, process=state_manager, service-instance=SomeipRequiredPowerModeServerInstance2
package /iSOFT/Machine2/core/sm/SomeipServiceInstanceToMachineMapping
  someip service instance to machine mapping RequiredInstanceToMachineMapping: communication-connector=CommunicationConnector1, service-instance=[SomeipRequiredDiagnosticResetServerInstance2, SomeipRequiredPowerModeServerInstance2], tcp-port=32001, udp-port=32001

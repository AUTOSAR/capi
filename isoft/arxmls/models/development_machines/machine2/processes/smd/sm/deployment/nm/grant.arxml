AUTOSAR XML (schema 00049)
package /ISOFT/Development
  machine Machine2
    iam module instantiation IamModuleInstantiation: grant=[sm_nm_field_currentfieldgrant2, sm_nm_fieldrequeststategrant2, sm_nm_findservicegrant2]
package /ISOFT/Development/iam
  com field grant sm_nm_field_currentfieldgrant2: service-instance=RequiredSomeIpNetworkStateInstance1, design=sm_nm_field_currentfieldgrantdesign, service-deployment=NetworkCurrentState
  com field grant sm_nm_fieldrequeststategrant2: service-instance=RequiredSomeIpNetworkStateInstance1, design=sm_nm_fieldrequeststategrantdesign, role=GETTER-SETTER, service-deployment=NetworkRequestedState
  com find service grant sm_nm_findservicegrant2: design=sm_nm_findservicegrantdesign, service-instance=RequiredSomeIpNetworkStateInstance1

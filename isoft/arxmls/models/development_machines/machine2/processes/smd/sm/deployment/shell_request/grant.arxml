AUTOSAR XML (schema 00049)
package /ISOFT/Development
  machine Machine2
    iam module instantiation IamModuleInstantiation: grant=sm_shell_offerservicegrant2
package /ISOFT/Development/iam
  com offer service grant sm_shell_offerservicegrant2: design=sm_shell_offerservicegrantdesign, service-instance=state_manager_instance_ShellRequest_Provided2

AUTOSAR XML (schema 00049)
package /iSOFT/Machine2/core/sm/DiagnosticReset/Required
  required someip service instance SomeipRequiredDiagnosticResetServerInstance2: service-interface-deployment=DiagnosticResetServer, required-service-instance-id=ANY, sd-client-config=SomeipSdClientServiceInstanceConfig
    someip required event group RequiredEventGroupDiagnosticResetServerRespones2: event-group=EventGroupDiagnosticResetServer
package /iSOFT/Machine2/core/sm/PowerMode/Required
  required someip service instance SomeipRequiredPowerModeServerInstance2: service-interface-deployment=PowerModeServer, required-service-instance-id=ANY, sd-client-config=SomeipSdClientServiceInstanceConfig
    someip required event group RequiredEventGroupPowerModeServerRespones2: event-group=EventGroupPowerModeServer

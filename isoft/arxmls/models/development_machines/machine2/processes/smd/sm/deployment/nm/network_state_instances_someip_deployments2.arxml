AUTOSAR XML (schema 00049)
package /ara/sm/instances2
  required someip service instance RequiredSomeIpNetworkStateInstance1: service-interface-deployment=NetworkState, required-minor-version=0, required-service-instance-id=200, sd-client-config=SomeipSdClientServiceInstanceConfig

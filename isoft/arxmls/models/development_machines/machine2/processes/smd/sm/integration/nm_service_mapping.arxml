AUTOSAR XML (schema 00049)
package /ISOFT/PlatformComponents/sm/mapping2
  service instance to port prototype mapping RequiredNetworkStateInstanceToPortMapping1: port-prototype=state_manager.NetworkState_ln1, process-design=state_manager_instance_design, process=state_manager, service-instance=RequiredSomeIpNetworkStateInstance1
  someip service instance to machine mapping state_manager_instance_NetworkState_Required_toMachine: communication-connector=CommunicationConnector1, service-instance=RequiredSomeIpNetworkStateInstance1, tcp-port=32001, udp-port=32001

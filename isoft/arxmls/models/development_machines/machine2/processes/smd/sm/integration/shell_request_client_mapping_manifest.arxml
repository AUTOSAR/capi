AUTOSAR XML (schema 00049)
package /ara/sm_shell_request_client/mapping2
  someip service instance to machine mapping RequiredShellRequestInstanceToMachineMapping: communication-connector=CommunicationConnector1, service-instance=RequiredSomeIpShellRequestInstance2, udp-port=5000
  service instance to port prototype mapping RequiredShellRequestInstanceToPortMapping: port-prototype=shell_request_client_root.ShellRequestRPort, process=shell_request_proc, service-instance=RequiredSomeIpShellRequestInstance2

AUTOSAR XML (schema 00049)
package /ISOFT/PlatformComponents/sm2
  provided someip service instance state_manager_instance_ShellRequest_Provided2: service-interface-deployment=SSC_ShellRequest, sd-server-config=SomeipServerServiceInstanceConfig, service-instance-id=200
    someip provided event group NotifyStateMachineStateChangedGroup: event-group=SM_NotifyStateMachineStateChangedGroup, multicast-threshold=0

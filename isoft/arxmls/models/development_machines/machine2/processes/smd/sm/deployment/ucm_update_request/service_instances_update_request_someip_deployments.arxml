AUTOSAR XML (schema 00049)
package /ISOFT/PlatformComponents/sm2
  provided someip service instance state_manager_instance_UpdateRequest_Provided2: service-interface-deployment=SSC_UpdateRequest, sd-server-config=SomeipServerServiceInstanceConfig, service-instance-id=200

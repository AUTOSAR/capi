AUTOSAR XML (schema 00049)
package /ISOFT/NmDemoFGSet
  function group set NmDemoCommonFGs2
    function-groups:
      mode declaration group prototype NMDemoFG: type=NMDemoFG

AUTOSAR XML (schema 00049)
package /ISOFT/PlatformComponents/com
  process nsomeip_routing_proc2: design=nsomeip_routing_proc_design, executable=nsomeipd, state-dependent-startup-config{function-group-state=[MachineFG.Restart, MachineFG.Startup, MachineFG.Verify, MachineFG.Fallback], resource-group=DefaultResourceGroup, startup-config=server}
    process state machine processStatMachine: type=ProcessStateMachine
  startup config set nsomeip_routing_startup_configs2
    startup config server: environment-variables=tag-with-optional-value={key=proxy, value=192.168.1.2}, scheduling-policy=SCHED_OTHER, scheduling-priority=12, termination-behavior=PROCESS-IS-NOT-SELF-TERMINATING
    startup config verify: scheduling-policy=SCHED_OTHER, scheduling-priority=12, termination-behavior=PROCESS-IS-NOT-SELF-TERMINATING

AUTOSAR XML (schema 00049)
package /ISOFT/Development
  machine Machine2
    module-instantiations:
      log and trace instantiation log: dlt-ecu-id=ECU2
        24 x dlt log channel:
          cgd_dlt: application-id=CGD, context-id=#DFT, log-trace-default-log-level=INFO, log-trace-file-path=/var/redirected/, log-trace-log-modes=CONSOLE
          doipd_dlt: application-id=DOIPD, context-id=#DFT, log-trace-default-log-level=INFO, log-trace-file-path=/var/redirected/, log-trace-log-modes=CONSOLE
          emd_dlt: application-id=EMD, context-id=#DFT, log-trace-default-log-level=VERBOSE, log-trace-file-path=/var/redirected/, log-trace-log-modes=CONSOLE
          nm_dlt: application-id=NMD, context-id=#DFT, log-trace-default-log-level=VERBOSE, log-trace-file-path=/var/redirected/, log-trace-log-modes=CONSOLE
          phm_dlt: application-id=PHMD, context-id=#DFT, log-trace-default-log-level=DEBUG, log-trace-file-path=/var/redirected/, log-trace-log-modes=CONSOLE
          route_dlt: application-id=CMSD, context-id=#DFT, log-trace-default-log-level=INFO, log-trace-file-path=/var/redirected/, log-trace-log-modes=CONSOLE
          sm_1: application-id=SMD, context-id=MAIN, log-trace-default-log-level=INFO, log-trace-file-path=/var/redirected/, log-trace-log-modes=CONSOLE
          sm_2: application-id=SMD, context-id=#NAI, log-trace-default-log-level=INFO, log-trace-file-path=/var/redirected/, log-trace-log-modes=CONSOLE
          sm_3: application-id=SMD, context-id=#COM, log-trace-default-log-level=INFO, log-trace-file-path=/var/redirected/, log-trace-log-modes=CONSOLE
          sm_4: application-id=SMD, context-id=#CFG, log-trace-default-log-level=INFO, log-trace-file-path=/var/redirected/, log-trace-log-modes=CONSOLE
          sm_5: application-id=SMD, context-id=#CMG, log-trace-default-log-level=INFO, log-trace-file-path=/var/redirected/, log-trace-log-modes=CONSOLE
          sm_6: application-id=SMD, context-id=#EVM, log-trace-default-log-level=INFO, log-trace-file-path=/var/redirected/, log-trace-log-modes=CONSOLE
          sm_7: application-id=SMD, context-id=#SMM, log-trace-default-log-level=INFO, log-trace-file-path=/var/redirected/, log-trace-log-modes=CONSOLE
          sm_8: application-id=SMD, context-id=#STO, log-trace-default-log-level=INFO, log-trace-file-path=/var/redirected/, log-trace-log-modes=CONSOLE
          reset_machine: application-id=RTMN, context-id=#DFT, log-trace-default-log-level=VERBOSE, log-trace-file-path=/var/redirected/, log-trace-log-modes=CONSOLE
          shell_request_client: application-id=TIDM, context-id=#DFT, log-trace-default-log-level=WARN, log-trace-file-path=/var/redirected/, log-trace-log-modes=[CONSOLE, FILE]
          shutdown: application-id=STDN, context-id=#DFT, log-trace-default-log-level=VERBOSE, log-trace-file-path=/var/redirected/, log-trace-log-modes=CONSOLE
          tsync_dlt: application-id=TSYD, context-id=#DFT, log-trace-default-log-level=INFO, log-trace-file-path=/var/redirected/, log-trace-log-modes=CONSOLE
          ucm_dlt: application-id=UCMD, context-id=#UCM, log-trace-default-log-level=DEBUG, log-trace-file-path=/var/redirected/, log-trace-log-modes=CONSOLE
          ucm_dlt_default: application-id=UCMD, context-id=#DFT, log-trace-default-log-level=DEBUG, log-trace-file-path=/var/redirected/, log-trace-log-modes=CONSOLE
          ucmm_dlt: application-id=UCMM, context-id=#DFT, log-trace-default-log-level=DEBUG, log-trace-file-path=/var/redirected/, log-trace-log-modes=CONSOLE
          default_dlt: application-description=default, application-id=DFT, context-description=default log channel, context-id=#DFT, log-trace-default-log-level=WARN, log-trace-log-modes=CONSOLE
          default_dlt_COM: application-description=default, application-id=DFT, context-description=default log channel for COM, context-id=#COM, log-trace-default-log-level=WARN, log-trace-log-modes=CONSOLE
          default_dlt_NAI: application-description=default, application-id=DFT, context-description=default log channel for NAI, context-id=#NAI, log-trace-default-log-level=WARN, log-trace-log-modes=CONSOLE

AUTOSAR XML (schema 00049)
package /ISOFT/Development
  machine Machine2
    module-instantiations:
      nm instantiation nm1_machine2
        nm network handle ln1: partial-network=parking

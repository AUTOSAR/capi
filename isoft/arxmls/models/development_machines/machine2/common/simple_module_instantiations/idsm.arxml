AUTOSAR XML (schema 00049)
package /ISOFT/Development
  machine Machine2
    time sync module instantiation idsm_timeSync
      synchronized time base provider synchronizedTimeBaseProvider_idsm: network-time-provider=globalTimeEthMaster_Idsm, time-sync-correction={allow-provider-rate-correction=true, offset-correction-adaption-interval=10.0, offset-correction-jump-threshold=20.0, rate-corrections-per-measurement-duration=10, rate-deviation-measurement-duration=10.0}

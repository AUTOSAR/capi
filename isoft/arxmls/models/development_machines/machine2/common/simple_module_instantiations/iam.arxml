AUTOSAR XML (schema 00049)
package /ISOFT/Development
  machine Machine2
    iam module instantiation IamModuleInstantiation: local-com-access-control-enabled=false, remote-access-control-enabled=false

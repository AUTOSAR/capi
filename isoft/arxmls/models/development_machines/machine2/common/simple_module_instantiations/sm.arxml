AUTOSAR XML (schema 00049)
package /ISOFT/Development
  machine Machine2
    generic module instantiation StateManagementModuleInstantiation
package /ara/sm/StateMachineTiming2
  someip sd server service instance config SomeipServerServiceInstanceConfig: initial-offer-behavior={initial-delay-max-value=0.1, initial-delay-min-value=0.01, initial-repetitions-base-delay=0.2, initial-repetitions-max=3}, offer-cyclic-delay=2.0, request-response-delay={max-value=1.5, min-value=1.5}, service-offer-time-to-live=8

AUTOSAR XML (schema 00049)
package /ISOFT/Development
  machine Machine2
    ucm module instantiation ucm: identifier=DevelopmentMachineUCM2

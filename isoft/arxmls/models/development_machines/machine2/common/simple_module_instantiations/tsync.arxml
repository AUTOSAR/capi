AUTOSAR XML (schema 00049)
package /ISOFT/Development
  machine Machine2
    time sync module instantiation timeSyncModuleInstantiation_0
      synchronized time base consumer synchronizedTimeBaseConsumer_0: network-time-consumer=globalTimeEthSlave_0
      synchronized time base consumer offsetTimeBaseConsumer_0: network-time-consumer=globalTimeEthSlave_0

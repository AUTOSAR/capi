AUTOSAR XML (schema 00049)
package /ISOFT/DiagnosticSession
  diagnostic session DiagnosticSession_0x01: id=1, p-2-server-max=60.0, p-2-star-server-max=600.0

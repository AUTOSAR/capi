AUTOSAR XML (schema 00049)
package /ISOFT/DiagnosticProtocol
  diagnostic protocol DiagnosticProtocol_doip: priority=0, protocol-kind=DoIP

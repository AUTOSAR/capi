AUTOSAR XML (schema 00049)
package /ISOFT/DiagnosticSessionControl
  diagnostic session control class DiagnosticSessionControlClass
  diagnostic session control DiagnosticSessionControl_0x01: access-permission=DiagnosticAccessPermission_0, diagnostic-session=DiagnosticSession_0x01, session-control-class=DiagnosticSessionControlClass

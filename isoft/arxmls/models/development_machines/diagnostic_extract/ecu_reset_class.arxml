AUTOSAR XML (schema 00049)
package /ISOFT/DiagnosticEcuResetClass
  diagnostic ecu reset class DiagnosticEcuResetClass_0: respond-to-reset=RESPOND-BEFORE-RESET

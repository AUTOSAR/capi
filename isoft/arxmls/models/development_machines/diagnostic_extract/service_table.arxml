AUTOSAR XML (schema 00049)
package /ISOFT/DiagnosticServiceTable
  diagnostic service table DiagnosticServiceTable_common: protocol-kind=DoIP, service-instance=DiagnosticSessionControl_0x01
  diagnostic service table DiagnosticServiceTable_nm: protocol-kind=DoIP, service-instance=[DiagnosticReadDTCInformation_nm, DiagnosticReadDataByIdentifier_0x0064]
  diagnostic service table DiagnosticServiceTable_sm: protocol-kind=DoIP, service-instance=[DiagnosticEcuReset_0x01, DiagnosticEcuReset_0x03, DiagnosticEcuReset_0x04]

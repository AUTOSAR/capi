AUTOSAR XML (schema 00049)
package /ISOFT/DiagnosticEcuReset
  diagnostic ecu reset DiagnosticEcuReset_0x01: category=HARD_RESET, access-permission=DiagnosticAccessPermission_0, ecu-reset-class=DiagnosticEcuResetClass_0
  diagnostic ecu reset DiagnosticEcuReset_0x03: category=SOFT_RESET, access-permission=DiagnosticAccessPermission_0, ecu-reset-class=DiagnosticEcuResetClass_0
  diagnostic ecu reset DiagnosticEcuReset_0x04: category=ENABLE_RAPID_POWER_SHUT_DOWN, access-permission=DiagnosticAccessPermission_0, ecu-reset-class=DiagnosticEcuResetClass_0

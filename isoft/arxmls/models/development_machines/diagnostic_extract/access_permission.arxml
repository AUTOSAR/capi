AUTOSAR XML (schema 00049)
package /ISOFT/DiagnosticAccessPermission
  diagnostic access permission DiagnosticAccessPermission_0: diagnostic-session=DiagnosticSession_0x01

AUTOSAR XML (schema 00049)
package /ISOFT/DiagnosticFreezeFrame
  diagnostic freeze frame DiagnosticFreezeFrame_nm: record-number=1, trigger=CONFIRMED, update=true

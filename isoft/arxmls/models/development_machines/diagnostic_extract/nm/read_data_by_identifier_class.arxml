AUTOSAR XML (schema 00049)
package /ISOFT/DiagnosticReadDataByIdentifierClass
  diagnostic read data by identifier class DiagnosticReadDataByIdentifierClass_0x0064: max-did-to-read=1

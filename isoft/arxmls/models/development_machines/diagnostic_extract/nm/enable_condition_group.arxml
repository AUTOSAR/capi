AUTOSAR XML (schema 00049)
package /ISOFT/DiagnosticEnableConditionGroup
  diagnostic enable condition group DiagnosticEnableConditionGroup_nm: enable-conditions=DiagnosticEnableCondition_nm

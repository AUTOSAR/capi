AUTOSAR XML (schema 00049)
package /ISOFT/DiagnosticTroubleCodeGroup
  diagnostic trouble code group DiagnosticTroubleCodeGroup_nm: dtcs=DiagnosticTroubleCodeUds_nm, group-number=11

AUTOSAR XML (schema 00049)
package /ISOFT/DiagnosticTroubleCodeUds
  diagnostic trouble code uds DiagnosticTroubleCodeUds_nm: dtc-props=DiagnosticTroubleCodeUdsProps_nm, severity=IMMEDIATELY, uds-dtc-value=1

AUTOSAR XML (schema 00049)
package /ISOFT/DiagnosticOperationCycle
  diagnostic operation cycle DiagnosticOperationCycle_nm: automatic-end=true, cycle-autostart=true, cycle-status-storage=false, type=OTHER

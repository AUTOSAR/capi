AUTOSAR XML (schema 00049)
package /ISOFT/DiagnosticDataIdentifierSet
  diagnostic data identifier set DiagnosticDataIdentifierSet_0x0064: data-identifier=DiagnosticDataIdentifier_0x0064

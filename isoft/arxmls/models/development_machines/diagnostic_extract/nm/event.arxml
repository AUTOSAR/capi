AUTOSAR XML (schema 00049)
package /ISOFT/DiagnosticEvent
  diagnostic event DiagnosticEvent_nm: associated-event-identification=0, clear-event-allowed-behavior=ONLY-THIS-CYCLE-AND-READINESS, confirmation-threshold=1, event-clear-allowed=ALWAYS, recoverable-in-same-operation-cycle=true
  diagnostic event to enable condition group mapping DiagnosticEvent_nm_EnableConditionGroup: diagnostic-event=DiagnosticEvent_nm, enable-condition-group=DiagnosticEnableConditionGroup_nm
  diagnostic event to operation cycle mapping DiagnosticEvent_nm_OperationCycle: diagnostic-event=DiagnosticEvent_nm, operation-cycle=DiagnosticOperationCycle_nm
  diagnostic event to trouble code uds mapping DiagnosticEvent_nm_TroubleCodeUds: diagnostic-event=DiagnosticEvent_nm, trouble-code-uds=DiagnosticTroubleCodeUds_nm

AUTOSAR XML (schema 00049)
package /ISOFT/DiagnosticReadDTCInformation
  diagnostic read dtc information class DiagnosticReadDTCInformationClass_nm: access-permission=DiagnosticAccessPermission_0, access-permission-validity=ACCES-PERRMISSION-SERVICE-CLASS
  diagnostic read dtc information DiagnosticReadDTCInformation_nm: category=REPORT_DTC_SNAPSHOT_RECORD_BY_DTC_NUMBER, access-permission=DiagnosticAccessPermission_0, read-dtc-information-class=DiagnosticReadDTCInformationClass_nm

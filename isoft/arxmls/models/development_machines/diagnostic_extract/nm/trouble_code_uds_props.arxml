AUTOSAR XML (schema 00049)
package /ISOFT/DiagnosticTroubleCodeUdsProps
  diagnostic trouble code props DiagnosticTroubleCodeUdsProps_nm: extended-data-records=DiagnosticExtendedDataRecord_0x0064, freeze-frames=DiagnosticFreezeFrame_nm, immediate-nv-data-storage=true, max-number-freeze-frame-records=1, memory-destination=DiagnosticMemoryDestinationPrimary_nm, priority=1, significance=OCCURENCE, snapshot-record-contents=DiagnosticDataIdentifierSet_0x0064

AUTOSAR XML (schema 00049)
package /ISOFT/DiagnosticExtendedDataRecord
  diagnostic provided data mapping DiagnosticExtendedDataRecord_0_Element_0x0064: data-element=DiagnosticDataElement_0x0064, data-provider=DEM_AGINGCTR_DOWNCNT
  diagnostic extended data record DiagnosticExtendedDataRecord_0x0064: record-number=1, trigger=CUSTOM, update=false
    diagnostic-parameter bit-offset=0:
      diagnostic data element DiagnosticDataElement_0x0064

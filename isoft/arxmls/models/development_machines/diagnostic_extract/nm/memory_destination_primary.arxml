AUTOSAR XML (schema 00049)
package /ISOFT/DiagnosticMemoryDestinationPrimary
  diagnostic memory destination primary DiagnosticMemoryDestinationPrimary_nm: dtc-status-availability-mask=255, event-displacement-strategy=NONE, max-number-of-event-entries=10, memory-entry-storage-trigger=CONFIRMED, type-of-freeze-frame-record-numeration=CONFIGURED, type-of-dtc-supported=ISO-14229--1

AUTOSAR XML (schema 00049)
package /ISOFT/DiagnosticEnableCondition
  diagnostic enable condition DiagnosticEnableCondition_nm: init-value=true

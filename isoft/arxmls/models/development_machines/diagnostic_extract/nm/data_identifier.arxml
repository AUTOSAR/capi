AUTOSAR XML (schema 00049)
package /ISOFT/DiagnosticDataIdentifier
  diagnostic data identifier DiagnosticDataIdentifier_0x0064: id=100, did-size=1
    diagnostic-parameter bit-offset=0:
      diagnostic data element DataElement_0x0064

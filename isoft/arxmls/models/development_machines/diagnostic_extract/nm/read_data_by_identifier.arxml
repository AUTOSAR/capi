AUTOSAR XML (schema 00049)
package /ISOFT/DiagnosticReadDataByIdentifier
  diagnostic read data by identifier DiagnosticReadDataByIdentifier_0x0064: access-permission=DiagnosticAccessPermission_0, data-identifier=DiagnosticDataIdentifier_0x0064, read-class=DiagnosticReadDataByIdentifierClass_0x0064

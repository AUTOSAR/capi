AUTOSAR XML (schema 00049)
package /ISOFT/Development/Network
  ethernet cluster EthCluster1
    ethernet physical channel EthPhysChannel1
      5 x network endpoint:
        NetworkEndpoint1: network-endpoint-addresses=ipv-4-configuration={default-gateway=192.168.14.1, ipv-4-address=192.168.14.98, ipv-4-address-source=FIXED, network-mask=255.255.255.0}
        NetworkEndpoint2: network-endpoint-addresses=ipv-4-configuration={default-gateway=192.168.14.1, ipv-4-address=192.168.14.99, ipv-4-address-source=FIXED, network-mask=255.255.255.0}
        NetworkEndpoint_Idsr: network-endpoint-addresses=ipv-4-configuration=ipv-4-address=127.0.0.1
        SDNetworkEndpoint1: network-endpoint-addresses=ipv-4-configuration=ipv-4-address=239.0.0.1
        SDNetworkEndpoint2: network-endpoint-addresses=ipv-4-configuration=ipv-4-address=239.0.0.1

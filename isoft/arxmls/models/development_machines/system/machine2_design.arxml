AUTOSAR XML (schema 00049)
package /ISOFT/Development
  machine design MachineDesign2: pn-reset-timer=2.5, pnc-prepare-sleep-timer=7.0, service-discover-configs=someip-service-discovery={multicast-sd-ip-address=SDNetworkEndpoint2, someip-service-discovery-port=30490}
    ethernet communication connector CommunicationConnector1: maximum-transmission-unit=1500, pnc-filter-data-mask=65536, unicast-network-endpoint=NetworkEndpoint2

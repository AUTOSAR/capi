AUTOSAR XML (schema 00049)
package /ISOFT
  nm config ap_udpnm_config
    udp nm cluster udp_nm_cluster1: communication-cluster=EthCluster1, nm-node-id-enabled=true, nm-pnc-participation=true, network-configuration={ipv-4-multicast-ip-address=239.0.0.1, udp-port=30928}, nm-cbv-position=0, nm-immediate-nm-cycle-time=1.0, nm-immediate-nm-transmissions=5, nm-msg-cycle-time=2.0, nm-network-timeout=10.0, nm-nid-position=1, nm-repeat-message-time=14.0, nm-user-data-length=0, nm-user-data-offset=0, nm-wait-bus-sleep-time=10.0
      udp nm node machine1: machine=MachineDesign1, nm-node-id=101, all-nm-messages-keep-awake=false, communication-connector=CommunicationConnector1, nm-msg-cycle-offset=1.2, nm-pn-handle-multiple-network-requests=true
      udp nm node machine2: machine=MachineDesign2, nm-node-id=102, all-nm-messages-keep-awake=false, communication-connector=CommunicationConnector1, nm-msg-cycle-offset=1.5, nm-pn-handle-multiple-network-requests=true

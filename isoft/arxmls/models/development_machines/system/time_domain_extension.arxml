AUTOSAR XML (schema 00049)
package /ISOFT/GlobalTimeDomains
  global time domain UTC
  global time domain offsetTD

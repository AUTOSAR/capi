AUTOSAR XML (schema 00049)
package /ISOFT/FunctionGroupModes
  mode declaration group MachineFG: initial-mode=Off
    6 x mode:
      Off
      Restart
      Shutdown
      Startup
      Fallback
      Verify
package /ISOFT/ProcessModes
  mode declaration group ProcessStateMachine
    mode Running
    mode Terminated
package /ISOFT/StateMachineModes
  mode declaration group MachineSM: initial-mode=Initial
    5 x mode:
      Initial
      Fallback
      Final
      Shutdown
      Restart

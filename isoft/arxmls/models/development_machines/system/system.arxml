AUTOSAR XML (schema 00049)
package /ISOFT/Development
  system systemnm: pnc-vector-length=55, pnc-vector-offset=2
    system mapping systemmapping1
      pnc-mapping physical-channel=EthPhysChannel1, pnc-identifier=16:
        ident parking

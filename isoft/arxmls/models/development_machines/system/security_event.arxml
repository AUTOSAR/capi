AUTOSAR XML (schema 00049)
package /ISOFT/Custom
  security event definition SecurityEventDefinition_auth: id=40000  # login authentication
  security event definition SecurityEventDefinition_fw: id=50000

AUTOSAR XML (schema 00049)
package /ISOFT/GlobalTimeDomains
  global time domain UTC:
    debounce-time=0.001
    domain-id=0
    follow-up-timeout-value=2.0
    global-time-correction-props={offset-correction-adaption-interval=10.0, offset-correction-jump-threshold=20.0, rate-correction-measurement-duration=10.0, rate-corrections-per-measurement-duration=2}
    global-time-domain-propertys=eth-global-time-domain-props={crc-flags={crc-correction-field=true, crc-domain-number=true, crc-message-length=true, crc-precise-origin-timestamp=true, crc-sequence-id=true, crc-source-port-identity=true}, destination-physical-address=01:00:5E:00:00:0E, fup-data-id-lists=[1, 2, 3, 4, 5, 6, 7, 8, 9, 10, 11, 12, 13, 14, 15, 16], eth-global-time-managed-coupling-port{pdelay-latency-threshold=0.001, pdelay-request-period=5.0, pdelay-resp-and-resp-follow-up-timeout=2.0, pdelay-response-enabled=true}, message-compliance=IEEE802-1AS-AUTOSAR}
    sync-loss-threshold=0.0
    sync-loss-timeout=5.0
    global-time-masters:
      global time eth master globalTimeEthMaster_0: communication-connector=CommunicationConnector1, immediate-resume-time=0.01, is-system-wide-global-time-master=true, sync-period=2.0, crc-secured=CRC-SUPPORTED, sub-tlv-config={ofs-sub-tlv=true, status-sub-tlv=true, time-sub-tlv=true, user-data-sub-tlv=true}
    global time eth slave globalTimeEthSlave_0: communication-connector=CommunicationConnector1, follow-up-timeout-value=2.0, time-leap-future-threshold=10.0, time-leap-healing-counter=10, time-leap-past-threshold=10.0, crc-validated=CRC-OPTIONAL, time-hardware-correction-threshold=5.0
    global time eth slave globalTimeEthSlave_0_machine1: communication-connector=CommunicationConnector1, follow-up-timeout-value=2.0, time-leap-future-threshold=10.0, time-leap-healing-counter=10, time-leap-past-threshold=10.0, crc-validated=CRC-OPTIONAL, time-hardware-correction-threshold=5.0
  global time domain UTC_Idsm:
    debounce-time=0.001
    domain-id=1
    follow-up-timeout-value=2.0
    global-time-correction-props={offset-correction-adaption-interval=10.0, offset-correction-jump-threshold=20.0, rate-correction-measurement-duration=10.0, rate-corrections-per-measurement-duration=2}
    global-time-domain-propertys=eth-global-time-domain-props={crc-flags={crc-correction-field=true, crc-domain-number=true, crc-message-length=true, crc-precise-origin-timestamp=true, crc-sequence-id=true, crc-source-port-identity=true}, destination-physical-address=01:00:5E:00:00:0E, fup-data-id-lists=[1, 2, 3, 4, 5, 6, 7, 8, 9, 10, 11, 12, 13, 14, 15, 16], eth-global-time-managed-coupling-port{pdelay-latency-threshold=0.001, pdelay-request-period=5.0, pdelay-resp-and-resp-follow-up-timeout=2.0, pdelay-response-enabled=true}, message-compliance=IEEE802-1AS-AUTOSAR}
    sync-loss-threshold=0.0
    sync-loss-timeout=5.0
    global-time-masters:
      global time eth master globalTimeEthMaster_Idsm: communication-connector=CommunicationConnector1, immediate-resume-time=0.01, is-system-wide-global-time-master=true, sync-period=2.0, crc-secured=CRC-SUPPORTED, sub-tlv-config={ofs-sub-tlv=true, status-sub-tlv=true, time-sub-tlv=true, user-data-sub-tlv=true}
    global time eth slave globalTimeEthSlave_Idsm: communication-connector=CommunicationConnector1, follow-up-timeout-value=2.0, time-leap-future-threshold=10.0, time-leap-healing-counter=10, time-leap-past-threshold=10.0, crc-validated=CRC-OPTIONAL, time-hardware-correction-threshold=5.0
  global time domain offsetTD:
    debounce-time=0.001
    domain-id=16
    follow-up-timeout-value=2.0
    global-time-correction-props={offset-correction-adaption-interval=10.0, offset-correction-jump-threshold=30.0, rate-correction-measurement-duration=1.0, rate-corrections-per-measurement-duration=10}
    global-time-domain-propertys=eth-global-time-domain-props={crc-flags={crc-correction-field=true, crc-domain-number=true, crc-message-length=true, crc-precise-origin-timestamp=true, crc-sequence-id=true, crc-source-port-identity=true}, destination-physical-address=01:00:5E:00:00:0E, fup-data-id-lists=[1, 2, 3, 4, 5, 6, 7, 8, 9, 10, 11, 12, 13, 14, 15, 16], eth-global-time-managed-coupling-port{pdelay-latency-threshold=0.001, pdelay-request-period=5.0, pdelay-resp-and-resp-follow-up-timeout=2.0, pdelay-response-enabled=true}, message-compliance=IEEE802-1AS-AUTOSAR}
    offset-time-domain=UTC
    sync-loss-threshold=0.0
    sync-loss-timeout=5.0
    global-time-masters:
      global time eth master globalTimeEthMaster_0: communication-connector=CommunicationConnector1, immediate-resume-time=0.01, is-system-wide-global-time-master=true, sync-period=2.0, crc-secured=CRC-SUPPORTED, sub-tlv-config={ofs-sub-tlv=true, status-sub-tlv=true, time-sub-tlv=true, user-data-sub-tlv=true}
    global time eth slave globalTimeEthSlave_0: communication-connector=CommunicationConnector1, follow-up-timeout-value=2.0, time-leap-future-threshold=10.0, time-leap-healing-counter=10, time-leap-past-threshold=10.0, crc-validated=CRC-OPTIONAL, time-hardware-correction-threshold=5.0

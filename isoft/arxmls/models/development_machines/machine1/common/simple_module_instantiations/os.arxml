AUTOSAR XML (schema 00049)
package /ISOFT/Development
  machine Machine1
    os module instantiation OS
      resource group DefaultResourceGroup: cpu-usage=50, mem-usage=1024000000

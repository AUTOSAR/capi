AUTOSAR XML (schema 00049)
package /ISOFT/Development
  machine Machine1
    module-instantiations:
      do ip instantiation doip:
        eid=0x000000000000
        entity-status-max-byte-field-use=false
        gid=0x000000000000
        gid-invalidity-pattern=0
        logical-address=0x0001
        max-request-bytes=65535
        network-interfaces=do-ip-network-configuration={eid-use-mac=true, is-activation-line-dependent=false, max-initial-vehicle-announcement-time=0.5, max-tester-connections=10, network-configuration=doip, network-interface-id=0, tcp-alive-check-response-timeout=0.5, tcp-general-inactivity-time=300.0, tcp-initial-inactivity-time=2.0, vehicle-announcement-count=3, vehicle-announcement-interval=0.5, vehicle-identification-sync-status=true}
        vin-invalidity-pattern=0
        request-configurations:
          end-address=0x0dff, request-type=PHYSICAL, start-address=0x0001
          end-address=0x7fff, request-type=PHYSICAL, start-address=0x1000
          end-address=0xefff, request-type=FUNCTIONAL, start-address=0xe400
package /ISOFT/Development/PlatformModuleEthernetEndpointConfiguration
  platform module ethernet endpoint configuration doip: communication-connector=CommunicationConnector1, tcp-port=13400, udp-port=13400

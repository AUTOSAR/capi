AUTOSAR XML (schema 00049)
package /ISOFT/Development
  machine Machine1
    module-instantiations:
      nm instantiation nm1_machine1
        nm network handle ln1: partial-network=parking

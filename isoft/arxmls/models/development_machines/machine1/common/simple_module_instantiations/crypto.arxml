AUTOSAR XML (schema 00049)
package /ISOFT/Development
  machine Machine1
    crypto module instantiation CryptoModuleInstantiation
      crypto certificate vendor_certificate: is-private=false
      crypto certificate packager_certificate: is-private=false

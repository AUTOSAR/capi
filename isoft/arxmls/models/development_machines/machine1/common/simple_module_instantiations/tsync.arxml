AUTOSAR XML (schema 00049)
package /ISOFT/Development
  machine Machine1
    time sync module instantiation timeSyncModuleInstantiation_0
      synchronized time base provider synchronizedTimeBaseProvider_0: network-time-provider=globalTimeEthMaster_0, time-sync-correction={allow-provider-rate-correction=true, offset-correction-adaption-interval=10.0, offset-correction-jump-threshold=20.0, rate-corrections-per-measurement-duration=2, rate-deviation-measurement-duration=10.0}
      synchronized time base provider offsetTimeBaseProvider_0: network-time-provider=globalTimeEthMaster_0, time-sync-correction={allow-provider-rate-correction=true, offset-correction-adaption-interval=10.0, offset-correction-jump-threshold=20.0, rate-corrections-per-measurement-duration=2, rate-deviation-measurement-duration=10.0}
      synchronized time base consumer synchronizedTimeBaseConsumer_0_machine1: network-time-consumer=globalTimeEthSlave_0_machine1

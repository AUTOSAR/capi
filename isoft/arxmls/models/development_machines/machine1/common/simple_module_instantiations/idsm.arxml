AUTOSAR XML (schema 00049)
package /ISOFT/Development
  machine Machine1
    idsm module instantiation IdsmModuleInstantiation: time-bases=synchronizedTimeBaseConsumer_idsm
    crypto module instantiation idsm_cryptod
      crypto provider idsmCryptoProvider_puhua
        crypto key slot key_slot_idsm: allocate-shadow-copy=true, crypto-alg-id=aesecb, crypto-object-type=PRIVATE-KEY, key-slot-allowed-modification={allow-content-type-change=true, exportability=true, max-number-of-allowed-updates=222, restrict-update=true}, key-slot-content-allowed-usages=[allowed-keyslot-usage=ALLOW-DATA-ENCRYPTION, allowed-keyslot-usage=ALLOW-DATA-DECRYPTION], slot-capacity=2048, slot-type=MACHINE
    time sync module instantiation idsm_timeSync
      synchronized time base consumer synchronizedTimeBaseConsumer_idsm: network-time-consumer=globalTimeEthSlave_Idsm

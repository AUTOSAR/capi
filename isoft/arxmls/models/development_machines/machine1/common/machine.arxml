AUTOSAR XML (schema 00049)
package /ISOFT/Development
  machine Machine1: default-application-timeout={enter-timeout-value=5.0, exit-timeout-value=5.0}, machine-design=MachineDesign1, trusted-platform-executable-launch-behavior=MONITOR-MODE

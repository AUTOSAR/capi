AUTOSAR XML (schema 00049)
package /ISOFT/FunctionGroupSet
  function group set Machine1
    function-groups:
      mode declaration group prototype MachineFG: type=MachineFG

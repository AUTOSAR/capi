AUTOSAR XML (schema 00049)
package /ISOFT/Development/SoftwarePackages1/Delta_Update_SWPs/VER_150
  software package framework: action-type=UPDATE, compressed-software-package-size=6592760, delta-package-applicable-version=1.0.0, maximum-supported-ucm-version=2.0.0, minimum-supported-ucm-version=1.0.0, packager-id=42, software-cluster=framework, uncompressed-software-cluster-size=6845749

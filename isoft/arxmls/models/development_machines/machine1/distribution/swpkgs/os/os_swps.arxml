AUTOSAR XML (schema 00049)
package /ISOFT/Development/SoftwarePackages1/Update_SWPs/VER_20_4_3
  software package os: action-type=UPDATE, compressed-software-package-size=6592760, maximum-supported-ucm-version=2.0.0, minimum-supported-ucm-version=1.0.0, packager-id=42, software-cluster=os, uncompressed-software-cluster-size=6845749

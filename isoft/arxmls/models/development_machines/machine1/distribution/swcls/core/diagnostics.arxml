AUTOSAR XML (schema 00049)
package /ISOFT/Development/DiagnosticContributionSet/Machine1
  diagnostic contribution set DiagnosticContributionSet_core: category=DIAGNOSTICS_SWCL_EXTRACT, common-properties={aging-requires-tested-cycle=false, clear-dtc-limitation=ALL-SUPPORTED-DTCS, default-endianness=big-endian, memory-entry-storage-trigger=CONFIRMED, occurrence-counter-processing=CONFIRMED-DTC-BIT, reset-confirmed-bit-on-overflow=false, status-bit-storage-test-failed=true}, service-tables=[DiagnosticServiceTable_common, DiagnosticServiceTable_sm]
    elements:
      DiagnosticAccessPermission_0
      DiagnosticEcuResetClass_0
      DiagnosticEcuReset_0x01
      DiagnosticEcuReset_0x01
      DiagnosticEcuReset_0x03
      DiagnosticEcuReset_0x03
      DiagnosticEcuReset_0x04
      DiagnosticEcuReset_0x04
      DiagnosticProtocol_doip
      DiagnosticServiceTable_common
      DiagnosticServiceTable_sm
      DiagnosticSessionControlClass
      DiagnosticSessionControl_0x01
      DiagnosticSession_0x01

AUTOSAR XML (schema 00049)
package /ISOFT/Development/SoftwareClusters1
  software cluster core:
    category=PLATFORM_CORE
    claimed-function-group=MachineFG
    contained-ar-element=[Machine1, Machine1, smd, ResetMachine, shutdown, shell_request_client]
    contained-process=[idsm_process1, cgd_proc, nsomeip_routing_proc, cryptod_proc, cryptohsmd_proc, cryptox509d_proc, dmd, fwdaemon_proc, dlt_daemon_proc, nm_daemon_proc1, phmd_process1, state_manager, tsync_daemon_proc1, package_manager, ucmm, reset_machine_process, shutdown_process, shell_request_proc]
    depends-on={category=FUNCTIONAL_DEPENDENCY, operator=LOGICAL-AND, parts=[{compare-type=IS-GREATER-THAN-OR-EQUAL, consider-build-number=false, software-cluster=framework, version=1.0.0}, {compare-type=IS-GREATER-THAN-OR-EQUAL, consider-build-number=false, software-cluster=os, version=20.4.2}]}
    software-cluster-doip-diagnostic-address{address-semantics=PHYSICAL-ADDRESS, diagnostic-address=1001}
    diagnostic-extract=DiagnosticContributionSet_core
    module-instantiation=doip
    type-approval=e1*2024/123*4567*89
    vendor-id=1
    version=1.0.0

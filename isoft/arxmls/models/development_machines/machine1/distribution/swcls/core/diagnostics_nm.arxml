AUTOSAR XML (schema 00049)
package /ISOFT/Development/DiagnosticContributionSet/Machine1
  diagnostic contribution set DiagnosticContributionSet_core: service-tables=DiagnosticServiceTable_nm
    elements:
      DiagnosticDataIdentifierSet_0x0064
      DiagnosticDataIdentifier_0x0064
      DiagnosticEnableConditionGroup_nm
      DiagnosticEnableCondition_nm
      DiagnosticEvent_nm
      DiagnosticEvent_nm_EnableConditionGroup
      DiagnosticEvent_nm_Monitor
      DiagnosticEvent_nm_OperationCycle
      DiagnosticEvent_nm_TroubleCodeUds
      DiagnosticExtendedDataRecord_0_Element_0x0064
      DiagnosticExtendedDataRecord_0x0064
      DiagnosticFreezeFrame_nm
      DiagnosticMemoryDestinationPrimary_nm
      DiagnosticOperationCycle_nm
      DiagnosticReadDTCInformationClass_nm
      DiagnosticReadDTCInformation_nm
      DiagnosticReadDataByIdentifierClass_0x0064
      DiagnosticReadDataByIdentifier_0x0064
      DiagnosticReadDataByIdentifier_nm
      DiagnosticTroubleCodeGroup_nm
      DiagnosticTroubleCodeUdsProps_nm
      DiagnosticTroubleCodeUds_nm
package /ISOFT/nm/DiagnosticDesignDtcMapping
  diagnostic event port mapping DiagnosticEvent_nm_Monitor: diagnostic-event=DiagnosticEvent_nm, process=network_manager_design, swc-service-dependency-in-executable=network_manager_root.DiagnosticEvent_nm_Monitor
  diagnostic service generic mapping DiagnosticReadDataByIdentifier_nm: diagnostic-service-instance=DiagnosticReadDataByIdentifier_0x0064, process=network_manager_design, swc-service-dependency-in-executable=network_manager_root.DiagnosticDataIdentifierGeneric_nm

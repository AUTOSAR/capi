AUTOSAR XML (schema 00049)
package /ServerMapping1
  dlt log channel to process mapping dltLogChannelToProcessMapping_3: dlt-log-channel=nm_dlt, process=nm_daemon_proc1
  process to machine mapping set mappingSet
    process to machine mapping ServerMapping: machine=Machine1, process=nm_daemon_proc1

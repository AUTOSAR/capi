AUTOSAR XML (schema 00049)
package /ServerMapping1
  someip service instance to machine mapping NetworkState_ProvidedServiceInstance_toMachine_1: communication-connector=CommunicationConnector1, service-instance=ProvidedInstanceNetworkState_1, tcp-port=32000, udp-port=32000
  service instance to port prototype mapping NetworkState_ProvidedServiceInstance_toPort_1: port-prototype=network_manager_root.NetworkState_ln1, process-design=network_manager_design, process=nm_daemon_proc1, service-instance=ProvidedInstanceNetworkState_1

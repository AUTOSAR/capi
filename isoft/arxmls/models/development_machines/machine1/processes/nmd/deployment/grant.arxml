AUTOSAR XML (schema 00049)
package /ISOFT/Development
  machine Machine1
    iam module instantiation IamModuleInstantiation: grant=[nmfieldNetworkRequestedStategrant, nmfiledgrantcurrent, nmoffergrant]
package /ISOFT/Development/iam
  com field grant nmfieldNetworkRequestedStategrant: service-instance=ProvidedInstanceNetworkState_1, role=GETTER-SETTER, service-deployment=NetworkRequestedState
  com field grant nmfiledgrantcurrent: service-instance=ProvidedInstanceNetworkState_1, role=GETTER, service-deployment=NetworkCurrentState
  com offer service grant nmoffergrant: design=nmofferservicegrantdesign, service-instance=ProvidedInstanceNetworkState_1

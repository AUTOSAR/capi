AUTOSAR XML (schema 00049)
package /ara/nm/instance
  provided someip service instance ProvidedInstanceNetworkState_1: service-interface-deployment=NetworkState, sd-server-config=nm_SomeipServerServiceInstanceConfig1, service-instance-id=100
    6 x someip provided event group, all with multicast-threshold=0:
      ProvidedEventgroup1: event-group=NetworkCurrentStateEventgroup1
      ProvidedEventgroup2: event-group=NetworkRequestedStateEventgroup
      NotifyPresentNodeList1: event-group=NotifyPresentNodeList1
      NotifyEtherStateChanged1: event-group=NotifyEtherStateChanged1
      NotifyPassivePnRequest1: event-group=NotifyPassivePnRequest1
      NotifyPassivePnRelease1: event-group=NotifyPassivePnRelease1

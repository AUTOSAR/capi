AUTOSAR XML (schema 00049)
package /ShutdownApp1
  process shutdown_process: executable=shutdown, state-dependent-startup-config{function-group-state=MachineFG.Shutdown, resource-group=DefaultResourceGroup, startup-config=shutdown}
    process state machine processStatMachine: type=ProcessStateMachine
  startup config set startup_set
    startup config shutdown: scheduling-policy=SCHED_OTHER, scheduling-priority=12, termination-behavior=PROCESS-IS-SELF-TERMINATING

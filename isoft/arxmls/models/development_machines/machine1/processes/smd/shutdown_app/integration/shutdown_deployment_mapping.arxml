AUTOSAR XML (schema 00049)
package /ShutdownMapping1
  dlt log channel to process mapping dltLogChannelToProcessMapping: dlt-log-channel=shutdown, process=shutdown_process
  process to machine mapping set mappingSet
    process to machine mapping ShutdownMapping: machine=Machine1, process=shutdown_process

AUTOSAR XML (schema 00049)
package /ara/sm_shell_request_client/instance
  required someip service instance RequiredSomeIpShellRequestInstance1: service-interface-deployment=SSC_ShellRequest, required-minor-version=0, required-service-instance-id=100, sd-client-config=SomeipClientServiceInstanceConfig

AUTOSAR XML (schema 00049)
package /ISOFT/Development
  machine Machine1
    iam module instantiation IamModuleInstantiation: grant=[shell_sm_findservicegrant1, shell_sm_methodgrant11, shell_sm_methodgrant12, shell_sm_methodgrant13, shell_sm_methodgrant14]
package /ISOFT/Development/iam
  com find service grant shell_sm_findservicegrant1: design=shell_sm_findservicegrantdesign, service-instance=RequiredSomeIpShellRequestInstance1
  5 x com method grant, all with service-instance=RequiredSomeIpShellRequestInstance1:
    shell_sm_methodgrant11: design=shell_sm_methodgrantdesign1, service-deployment=SM_SetSMState
    shell_sm_methodgrant12: design=shell_sm_methodgrantdesign2, service-deployment=SM_GetSMState
    shell_sm_methodgrant13: design=shell_sm_methodgrantdesign3, service-deployment=SM_SetFGState
    shell_sm_methodgrant14: design=shell_sm_methodgrantdesign4, service-deployment=SM_GetFGState
    shell_sm_methodgrant15: design=shell_sm_methodgrantdesign5, service-deployment=SM_GetAllFunctionGroupsInfo

AUTOSAR XML (schema 00049)
package /iSOFT/Machine1/core/sm/DiagnosticMapping
  diagnostic service generic mapping DiagnosticEcuReset_0x01: diagnostic-service-instance=DiagnosticEcuReset_0x01, process=state_manager_instance_design, swc-service-dependency-in-executable=state_manager.DiagnosticEcuResetDependence
  diagnostic service generic mapping DiagnosticEcuReset_0x03: diagnostic-service-instance=DiagnosticEcuReset_0x03, process=state_manager_instance_design, swc-service-dependency-in-executable=state_manager.DiagnosticEcuResetDependence
  diagnostic service generic mapping DiagnosticEcuReset_0x04: diagnostic-service-instance=DiagnosticEcuReset_0x04, process=state_manager_instance_design, swc-service-dependency-in-executable=state_manager.DiagnosticEcuResetDependence

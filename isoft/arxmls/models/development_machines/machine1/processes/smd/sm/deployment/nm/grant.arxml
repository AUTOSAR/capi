AUTOSAR XML (schema 00049)
package /ISOFT/Development
  machine Machine1
    iam module instantiation IamModuleInstantiation: grant=[sm_nm_field_currentfieldgrant, sm_nm_fieldrequeststategrant, sm_nm_findservicegrant]
package /ISOFT/Development/iam
  com field grant sm_nm_field_currentfieldgrant: service-instance=RequiredSomeIpNetworkStateInstance1, design=sm_nm_field_currentfieldgrantdesign, service-deployment=NetworkCurrentState
  com field grant sm_nm_fieldrequeststategrant: service-instance=RequiredSomeIpNetworkStateInstance1, design=sm_nm_fieldrequeststategrantdesign, role=GETTER-SETTER, service-deployment=NetworkRequestedState
  com find service grant sm_nm_findservicegrant: design=sm_nm_findservicegrantdesign, service-instance=RequiredSomeIpNetworkStateInstance1

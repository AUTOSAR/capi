AUTOSAR XML (schema 00049)
package /ISOFT/Development
  machine Machine1
    iam module instantiation IamModuleInstantiation: grant=sm_ucm_offerservicegrant
package /ISOFT/Development/iam
  com offer service grant sm_ucm_offerservicegrant: design=sm_ucm_offerservicegrantdesign, service-instance=state_manager_instance_UpdateRequest_Provided1

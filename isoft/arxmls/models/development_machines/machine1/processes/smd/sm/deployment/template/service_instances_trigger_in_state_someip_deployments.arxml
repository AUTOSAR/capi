AUTOSAR XML (schema 00049)
package /SomeipInstancesDeployments
  provided someip service instance state_manager_instance_TriggerIn_State_Provided1: service-interface-deployment=TriggerIn_State, sd-server-config=SomeipServerServiceInstanceConfig, service-instance-id=100

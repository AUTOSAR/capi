AUTOSAR XML (schema 00049)
package /ISOFT/NmDemoFGSet
  function group set NmDemoCommonFGs1
    function-groups:
      mode declaration group prototype NMDemoFG: type=NMDemoFG

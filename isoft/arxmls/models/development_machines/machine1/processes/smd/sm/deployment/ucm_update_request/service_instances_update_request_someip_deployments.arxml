AUTOSAR XML (schema 00049)
package /ISOFT/PlatformComponents/sm1
  provided someip service instance state_manager_instance_UpdateRequest_Provided1: service-interface-deployment=SSC_UpdateRequest, sd-server-config=SomeipServerServiceInstanceConfig, service-instance-id=100

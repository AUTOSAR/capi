AUTOSAR XML (schema 00049)
package /SomeipInstancesDeployments
  provided someip service instance state_manager_instance_TriggerInOut_State_Provided1: service-interface-deployment=TriggerInOut_State, sd-server-config=SomeipServerServiceInstanceConfig, service-instance-id=100
    someip provided event group Trigger_provided_eventgroup: event-group=Notifier_eventgroup, multicast-threshold=0

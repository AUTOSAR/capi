AUTOSAR XML (schema 00049)
package /ara/sm/instances1
  required someip service instance RequiredSomeIpNetworkStateInstance1: service-interface-deployment=NetworkState, required-minor-version=0, required-service-instance-id=100, sd-client-config=SomeipSdClientServiceInstanceConfig

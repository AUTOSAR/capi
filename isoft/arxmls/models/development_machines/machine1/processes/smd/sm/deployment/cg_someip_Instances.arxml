AUTOSAR XML (schema 00049)
package /iSOFT/Machine1/core/sm/DiagnosticReset/Required
  required someip service instance SomeipRequiredDiagnosticResetServerInstance: service-interface-deployment=DiagnosticResetServer, required-service-instance-id=ANY, sd-client-config=SomeipSdClientServiceInstanceConfig
    someip required event group RequiredEventGroupDiagnosticResetServerRespones: event-group=EventGroupDiagnosticResetServer
package /iSOFT/Machine1/core/sm/PowerMode/Required
  required someip service instance SomeipRequiredPowerModeServerInstance: service-interface-deployment=PowerModeServer, required-service-instance-id=ANY, sd-client-config=SomeipSdClientServiceInstanceConfig
    someip required event group RequiredEventGroupPowerModeServerRespones: event-group=EventGroupPowerModeServer

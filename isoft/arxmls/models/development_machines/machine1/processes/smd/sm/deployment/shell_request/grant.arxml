AUTOSAR XML (schema 00049)
package /ISOFT/Development
  machine Machine1
    iam module instantiation IamModuleInstantiation: grant=sm_shell_offerservicegrant
package /ISOFT/Development/iam
  com offer service grant sm_shell_offerservicegrant: design=sm_shell_offerservicegrantdesign, service-instance=state_manager_instance_ShellRequest_Provided1

AUTOSAR XML (schema 00049)
package /ISOFT/PlatformComponents/sm1
  process state_manager: design=state_manager_instance_design, executable=smd, function-cluster-affiliation=STATE_MANAGEMENT, state-dependent-startup-config{function-group-state=[MachineFG.Restart, MachineFG.Shutdown, MachineFG.Startup, MachineFG.Verify, MachineFG.Fallback], resource-group=DefaultResourceGroup, startup-config=server}
    process state machine processStatMachine: type=ProcessStateMachine
  startup config set state_manager_startup_configs
    startup config server: scheduling-policy=SCHED_OTHER, scheduling-priority=12, termination-behavior=PROCESS-IS-NOT-SELF-TERMINATING, timeout={enter-timeout-value=8.0, exit-timeout-value=5.0}

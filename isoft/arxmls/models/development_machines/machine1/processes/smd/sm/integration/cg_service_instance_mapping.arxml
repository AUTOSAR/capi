AUTOSAR XML (schema 00049)
package /iSOFT/Machine1/core/sm/ServiceInstanceToPortPrototypeMapping
  service instance to port prototype mapping SomeipCGRequiredDiagnosticResetServerInstance: port-prototype=state_manager.CgServerRDiagnosticResetServer, process-design=state_manager_instance_design, process=state_manager, service-instance=SomeipRequiredDiagnosticResetServerInstance
  service instance to port prototype mapping SomeipCGRequiredPowerModeServerInstance: port-prototype=state_manager.CgServerRPowerModeServer, process-design=state_manager_instance_design, process=state_manager, service-instance=SomeipRequiredPowerModeServerInstance
package /iSOFT/Machine1/core/sm/SomeipServiceInstanceToMachineMapping
  someip service instance to machine mapping RequiredInstanceToMachineMapping: communication-connector=CommunicationConnector1, service-instance=[SomeipRequiredDiagnosticResetServerInstance, SomeipRequiredPowerModeServerInstance], tcp-port=32001, udp-port=32001

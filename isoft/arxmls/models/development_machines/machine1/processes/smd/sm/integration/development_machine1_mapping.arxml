AUTOSAR XML (schema 00049)
package /ISOFT/PlatformComponents/sm/mapping1
  persistency port prototype to key value storage mapping CalibrationDataDatabaseToPortMapping: port-prototype=state_manager.CalibrationDataPRPort, process=state_manager, key-value-storage=CalibrationDataDatabase
  persistency port prototype to key value storage mapping UpdateSessionStatusDatabaseToPortMapping: port-prototype=state_manager.UpdateSessionStatusPRPort, process=state_manager, key-value-storage=UpdateSessionStatusDatabase
  8 x dlt log channel to process mapping, all with process=state_manager:
    LogChannelToProcessMapping{1..8}: dlt-log-channel=sm_{1..8}
  process to machine mapping set process_to_machine_set
    process to machine mapping item: machine=Machine1, non-os-module-instantiation=StateManagementModuleInstantiation, process=state_manager
  someip service instance to machine mapping state_manager_instance_RoutineService_Provided_toMachine: communication-connector=CommunicationConnector1, service-instance=[state_manager_instance_UpdateRequest_Provided1, state_manager_instance_TriggerInOut_State_Provided1, state_manager_instance_TriggerIn_State_Provided1, state_manager_instance_TriggerOut_State_Provided1, state_manager_instance_ShellRequest_Provided1], tcp-port=32000, udp-port=32000
  5 x service instance to port prototype mapping, all with process-design=state_manager_instance_design, process=state_manager:
    state_manager_instance_TriggerInOut_State_Provided_toPort: port-prototype=state_manager.TriggerInOut_State, service-instance=state_manager_instance_TriggerInOut_State_Provided1
    state_manager_instance_TriggerIn_State_Provided_toPort: port-prototype=state_manager.TriggerIn_State, service-instance=state_manager_instance_TriggerIn_State_Provided1
    state_manager_instance_TriggerOut_State_Provided_toPort: port-prototype=state_manager.TriggerOut_State, service-instance=state_manager_instance_TriggerOut_State_Provided1
    state_manager_instance_UpdateRequest_Provided_toPort: port-prototype=state_manager.UpdateRequest, service-instance=state_manager_instance_UpdateRequest_Provided1
    state_manager_instance_ShellRequest_Provided_toPort: port-prototype=state_manager.ShellRequest, service-instance=state_manager_instance_ShellRequest_Provided1

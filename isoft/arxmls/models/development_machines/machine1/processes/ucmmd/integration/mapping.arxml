AUTOSAR XML (schema 00049)
package /ara/ucm_master/mapping
  process to machine mapping set DevelopmentMachineMappings
    process to machine mapping VehiclePackageManagerToMachineMapping: machine=Machine1, process=ucmm
  someip service instance to machine mapping ProvidedInstanceToMachineMapping: communication-connector=CommunicationConnector1, service-instance=[ProvidedSomeIpVehicleDriverApplicationInstance1, ProvidedSomeIpVehicleStateManagerInstance1, ProvidedSomeIpVehiclePackageManagementInstance1], tcp-port=32000, udp-port=32000
  service instance to port prototype mapping ProvidedVehicleDriverApplicationInstanceToPortMapping: port-prototype=ucmm_root.VehicleDriverApplicationPPort, process-design=ucmm_design, process=ucmm, service-instance=ProvidedSomeIpVehicleDriverApplicationInstance1
  service instance to port prototype mapping ProvidedVehiclePackageManagementInstanceToPortMapping: port-prototype=ucmm_root.VehiclePackageManagementPPort, process-design=ucmm_design, process=ucmm, service-instance=ProvidedSomeIpVehiclePackageManagementInstance1
  service instance to port prototype mapping ProvidedVehicleStateManagerInstanceToPortMapping: port-prototype=ucmm_root.VehicleStateManagerPPort, process-design=ucmm_design, process=ucmm, service-instance=ProvidedSomeIpVehicleStateManagerInstance1
  someip service instance to machine mapping RequiredInstanceToMachineMapping: communication-connector=CommunicationConnector1, service-instance=RequiredSomeIpPackageManagementInstance1, tcp-port=32001, udp-port=32001
  service instance to port prototype mapping RequiredPackageManagementInstanceToPortMapping: port-prototype=ucmm_root.PackageManagementRPort, process-design=ucmm_design, process=ucmm, service-instance=RequiredSomeIpPackageManagementInstance1
  persistency port prototype to key value storage mapping SwPackageTransferStatusDatabaseToPortMapping: port-prototype=ucmm_root.SwPackageTransferStatusPRPort, process=ucmm, key-value-storage=SwPackageTransferStatusDatabase
  persistency port prototype to key value storage mapping CampaignHistoryDatabaseToPortMapping: port-prototype=ucmm_root.CampaignHistoryPRPort, process=ucmm, key-value-storage=CampaignHistoryDatabase
  dlt log channel to process mapping dltLogChannelToProcessMapping: dlt-log-channel=ucmm_dlt, process=ucmm

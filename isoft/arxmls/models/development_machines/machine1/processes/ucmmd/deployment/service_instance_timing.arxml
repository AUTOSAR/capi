AUTOSAR XML (schema 00049)
package /ara/ucm_master/timing1
  someip sd client service instance config SomeIpClientServiceInstanceConfig: initial-find-behavior={initial-delay-max-value=0.1, initial-delay-min-value=0.01, initial-repetitions-base-delay=0.2, initial-repetitions-max=3}, service-find-time-to-live=8
  someip sd server service instance config SomeIpServerServiceInstanceConfig: initial-offer-behavior={initial-delay-max-value=0.1, initial-delay-min-value=0.01, initial-repetitions-base-delay=0.2, initial-repetitions-max=3}, offer-cyclic-delay=2.0, request-response-delay={max-value=1.5, min-value=1.5}, service-offer-time-to-live=8

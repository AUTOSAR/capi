AUTOSAR XML (schema 00049)
package /ara/ucm_master/instances
  provided someip service instance ProvidedSomeIpVehiclePackageManagementInstance1: service-interface-deployment=VehiclePackageManagementSomeIp, sd-server-config=SomeIpServerServiceInstanceConfig, service-instance-id=100
    someip provided event group RequestedPackage_provided_eventgroup: event-group=RequestedPackage_eventgroup, multicast-threshold=0
    someip provided event group SafetyState_provided_eventgroup: event-group=SafetyState_eventgroup, multicast-threshold=0
    someip provided event group TransferState_provided_eventgroup: event-group=TransferState_eventgroup, multicast-threshold=0
  required someip service instance RequiredSomeIpPackageManagementInstance1: service-interface-deployment=PackageManagementSomeIp, required-minor-version=0, required-service-instance-id=ANY, sd-client-config=SomeIpClientServiceInstanceConfig
    someip required event group CurrentStatus_required_eventgroup: event-group=CurrentStatus_eventgroup

AUTOSAR XML (schema 00049)
package /ISOFT/Development
  machine Machine1
    iam module instantiation IamModuleInstantiation: grant=[ucmm_ucmfieldgrant, ucmm_ucmfindservicegrant, ucmm_ucmofferservicegrant1, ucmm_ucmofferservicegrant2, ucmm_ucmofferservicegrant3]
package /ISOFT/Development/iam
  com field grant ucmm_ucmfieldgrant: service-instance=RequiredSomeIpPackageManagementInstance1, role=GETTER, service-deployment=CurrentStatus
  com find service grant ucmm_ucmfindservicegrant: design=ucmm_ucmfindservicegrantdesign, service-instance=RequiredSomeIpPackageManagementInstance1
  com offer service grant ucmm_ucmofferservicegrant1: design=ucmm_ucmofferservicegrantdesign1, service-instance=ProvidedSomeIpVehicleDriverApplicationInstance1
  com offer service grant ucmm_ucmofferservicegrant2: design=ucmm_ucmofferservicegrantdesign2, service-instance=ProvidedSomeIpVehiclePackageManagementInstance1
  com offer service grant ucmm_ucmofferservicegrant3: design=ucmm_ucmofferservicegrantdesign3, service-instance=ProvidedSomeIpVehicleStateManagerInstance1

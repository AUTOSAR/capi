AUTOSAR XML (schema 00049)
package /ISOFT/PlatformComponents/Persistency
  persistency key value storage kvStorage_keySlot: maximum-allowed-size=1024000, minimum-sustained-size=4096, redundancy-handlings=persistency-redundancy-m-out-of-n={scope=PERSISTENCY-REDUNDANCY-HANDLING-SCOPE-STORAGE, m=3, n=5}, update-strategy=KEEP-EXISTING, uri=cryptod/kv_per

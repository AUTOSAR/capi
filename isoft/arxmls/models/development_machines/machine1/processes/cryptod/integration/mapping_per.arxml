AUTOSAR XML (schema 00049)
package /ISOFT/PlatformComponents/Persistency
  persistency port prototype to key value storage mapping kvStorage_mapping_crypto_Slot: port-prototype=cryptod_swc_root.prPort_kvStorage_keySlot, process=cryptod_proc, key-value-storage=kvStorage_keySlot

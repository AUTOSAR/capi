AUTOSAR XML (schema 00049)
package /ISOFT/PlatformComponents/crypto/crypto_daemon_mapping1
  process to machine mapping set processToMachineMappingSet_cryptod
    process to machine mapping item: machine=Machine1, process=cryptod_proc
  dlt log channel to process mapping dltLogChannelToProcessMapping_4: dlt-log-channel=crypto_dlt, process=cryptod_proc

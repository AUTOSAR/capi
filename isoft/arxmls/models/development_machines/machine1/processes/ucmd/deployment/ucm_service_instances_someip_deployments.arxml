AUTOSAR XML (schema 00049)
package /ara/ucm/instance
  provided someip service instance ProvidedSomeIpPackageManagementInstance1: service-interface-deployment=PackageManagementSomeIp, sd-server-config=SomeipServerServiceInstanceConfig, service-instance-id=100
    someip provided event group CurrentStatus_provided_eventgroup: event-group=CurrentStatus_eventgroup, multicast-threshold=0
  required someip service instance RequiredSomeIpUpdateRequestInstance1: service-interface-deployment=SSC_UpdateRequest, required-minor-version=0, required-service-instance-id=100, sd-client-config=SomeipSdClientServiceInstanceConfig

AUTOSAR XML (schema 00049)
package /ISOFT/Development
  machine Machine1
    iam module instantiation IamModuleInstantiation: grant=[ucm_ota_ucmm_fieldgrant, ucm_ota_ucmm_offerservicegrant]
package /ISOFT/Development/iam
  com field grant ucm_ota_ucmm_fieldgrant: service-instance=ProvidedSomeIpPackageManagementInstance1, role=GETTER, service-deployment=CurrentStatus
  com offer service grant ucm_ota_ucmm_offerservicegrant: design=ucm_ota_ucmm_offerservicegrantdesign, service-instance=ProvidedSomeIpPackageManagementInstance1

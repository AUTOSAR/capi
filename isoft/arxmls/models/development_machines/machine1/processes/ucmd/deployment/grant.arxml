AUTOSAR XML (schema 00049)
package /ISOFT/Development
  machine Machine1
    iam module instantiation IamModuleInstantiation: grant=[ucm_sm_findservicegrant, ucm_sm_methodgrant1, ucm_sm_methodgrant2, ucm_sm_methodgrant3, ucm_sm_methodgrant4, ucm_sm_methodgrant5, ucm_sm_methodgrant6]
package /ISOFT/Development/iam
  com find service grant ucm_sm_findservicegrant: design=ucm_sm_findservicegrantdesign, service-instance=RequiredSomeIpUpdateRequestInstance1
  6 x com method grant, all with service-instance=RequiredSomeIpUpdateRequestInstance1:
    ucm_sm_methodgrant1: design=ucm_sm_methodgrantdesign1, service-deployment=SM_StartUpdateSession
    ucm_sm_methodgrant2: design=ucm_sm_methodgrantdesign2, service-deployment=SM_StopUpdateSession
    ucm_sm_methodgrant3: design=ucm_sm_methodgrantdesign3, service-deployment=SM_ResetMachine
    ucm_sm_methodgrant4: design=ucm_sm_methodgrantdesign4, service-deployment=SM_PrepareUpdate
    ucm_sm_methodgrant5: design=ucm_sm_methodgrantdesign5, service-deployment=SM_VerifyUpdate
    ucm_sm_methodgrant6: design=ucm_sm_methodgrantdesign6, service-deployment=SM_PrepareRollback

AUTOSAR XML (schema 00049)
package /ara/ucm/PersistencyKeyValueDatabases1
  persistency key value storage SwPackageTransferStatusDatabase: maximum-allowed-size=4194304, minimum-sustained-size=4096, redundancy-handlings=persistency-redundancy-m-out-of-n={scope=PERSISTENCY-REDUNDANCY-HANDLING-SCOPE-STORAGE, m=3, n=5}, update-strategy=KEEP-EXISTING, uri=ucm/per_kv

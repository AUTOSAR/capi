AUTOSAR XML (schema 00049)
package /ISOFT/Development
  machine Machine1

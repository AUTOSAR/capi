AUTOSAR XML (schema 00049)
package /ISOFT/PlatformComponents/log
  process dlt_daemon_proc: design=daemon_proc_design, executable=logd, state-dependent-startup-config{function-group-state=[MachineFG.Restart, MachineFG.Startup, MachineFG.Verify], resource-group=DefaultResourceGroup, startup-config=server}
    process state machine processStatMachine: type=ProcessStateMachine
  startup config set daemon_startup_configs
    startup config server: scheduling-policy=SCHED_OTHER, scheduling-priority=12, termination-behavior=PROCESS-IS-NOT-SELF-TERMINATING, timeout={enter-timeout-value=5.0, exit-timeout-value=5.0}
    startup config verify: scheduling-policy=SCHED_OTHER, scheduling-priority=12, termination-behavior=PROCESS-IS-NOT-SELF-TERMINATING

AUTOSAR XML (schema 00049)
package /ISOFT/PlatformComponents/log/daemon_mapping
  process to machine mapping set process_to_machine_set
    process to machine mapping item: machine=Machine1, process=dlt_daemon_proc

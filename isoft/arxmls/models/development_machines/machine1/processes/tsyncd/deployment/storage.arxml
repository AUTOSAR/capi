AUTOSAR XML (schema 00049)
package /ISOFT/PlatformComponents/tsync/PersistencyStorage
  persistency key value storage storage_timesync_provider_kv: maximum-allowed-size=40960, minimum-sustained-size=4096, update-strategy=KEEP-EXISTING, uri=tsync/uri_storage_timesync_provider_kv
    persistency key value pair storage_timesync_provider_kv_pair: update-strategy=KEEP-EXISTING, init-value=0.0;0;UTC, value-data-type=String
  persistency file storage storage_timesync_offsetprovider_file: maximum-allowed-size=40960, minimum-sustained-size=4096, redundancy-handlings=persistency-redundancy-hash={algorithm-family=CRC_32P4, length=32}, update-strategy=KEEP-EXISTING, uri=tsync/file_tsync_per
    persistency file storage_timesync_offsetprovider_file_perfile: update-strategy=KEEP-EXISTING, content-uri=tsync/timesync_offsetprovider_perfile, file-name=timesync_offsetprovider_perfile

AUTOSAR XML (schema 00049)
package /ISOFT/PlatformComponents/tsync/tsync_daemon_mapping1
  process to machine mapping set process_to_machine_set
    process to machine mapping item: machine=Machine1, process=tsync_daemon_proc1
  dlt log channel to process mapping dltLogChannelToProcessMapping_2: dlt-log-channel=tsync_dlt, process=tsync_daemon_proc1
  persistency port prototype to file storage mapping storage_timesync_offsetprovider_file_mapping: port-prototype=root_swc.timesync_offsetprovider_file_port, process=tsync_daemon_proc1, file-storage=storage_timesync_offsetprovider_file
  persistency port prototype to key value storage mapping storage_timesync_provider_kv_mapping: port-prototype=root_swc.timesync_provider_port, process=tsync_daemon_proc1, key-value-storage=storage_timesync_provider_kv

AUTOSAR XML (schema 00049)
package /ISOFT/PlatformComponents/tsync
  process tsync_daemon_proc1: design=tsync_daemon_proc_design, executable=tsyncd, state-dependent-startup-config{function-group-state=[MachineFG.Restart, MachineFG.Startup, MachineFG.Verify], resource-group=DefaultResourceGroup, startup-config=normal}
    process state machine processStatMachine: type=ProcessStateMachine
  startup config set tsync_daemon_startup_configs1
    startup config tsync_daemon: scheduling-policy=SCHED_OTHER, scheduling-priority=12, termination-behavior=PROCESS-IS-NOT-SELF-TERMINATING, timeout={enter-timeout-value=5.0, exit-timeout-value=5.0}
    startup config verify: scheduling-policy=SCHED_OTHER, scheduling-priority=12, termination-behavior=PROCESS-IS-NOT-SELF-TERMINATING, timeout={enter-timeout-value=5.0, exit-timeout-value=5.0}
    startup config normal: scheduling-policy=SCHED_OTHER, scheduling-priority=12, termination-behavior=PROCESS-IS-NOT-SELF-TERMINATING, timeout={enter-timeout-value=5.0, exit-timeout-value=5.0}

AUTOSAR XML (schema 00049)
package /ISOFT/PlatformComponents/cryptohsm/cryptohsm_daemon_mapping1
  process to machine mapping set processToMachineMappingSet_cryptohsmd
    process to machine mapping item: machine=Machine1, process=cryptohsmd_proc
  dlt log channel to process mapping dltLogChannelToProcessMapping_5: dlt-log-channel=cryptohsm_dlt, process=cryptohsmd_proc

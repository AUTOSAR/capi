AUTOSAR XML (schema 00049)
package /ISOFT/PlatformComponents/cryptohsm
  process cryptohsmd_proc: design=cryptohsm_proc_design, executable=cryptohsmd, state-dependent-startup-config{function-group-state=[MachineFG.Restart, MachineFG.Startup, MachineFG.Verify], resource-group=DefaultResourceGroup, startup-config=normal}
    process state machine processStatMachine: type=ProcessStateMachine
  startup config set cryptohsm_startup_config
    startup config normal: scheduling-policy=SCHED_OTHER, scheduling-priority=12, termination-behavior=PROCESS-IS-NOT-SELF-TERMINATING

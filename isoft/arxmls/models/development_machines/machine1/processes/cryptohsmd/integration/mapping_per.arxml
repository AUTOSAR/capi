AUTOSAR XML (schema 00049)
package /ISOFT/PlatformComponents/Persistency
  persistency port prototype to key value storage mapping kvStorage_mapping_cryptohsm_Slot: port-prototype=cryptohsmd_swc_root.prPort_kvStorage_hsmKeySlot, process=cryptohsmd_proc, key-value-storage=kvStorage_hsmKeySlot

AUTOSAR XML (schema 00049)
package /iSOFT/Machine1/core/cg/DiagnosticReset/Provided
  provided someip service instance SomeipProvidedDiagnosticResetServerInstance: service-interface-deployment=DiagnosticResetServer, sd-server-config=cgd_DiagnosticReset_Server_InstanceConfig, service-instance-id=100
    someip provided event group ProvidedEventGroupDiagnosticResetServerRespones: event-group=EventGroupDiagnosticResetServer, multicast-threshold=10
package /iSOFT/Machine1/core/cg/DiagnosticReset/Required
  required someip service instance SomeipRequiredDiagnosticResetClientInstance: service-interface-deployment=DiagnosticResetClient, required-service-instance-id=ANY, sd-client-config=cgd_DiagnosticReset_Client_InstanceConfig
    someip required event group RequiredEventGroupDiagnosticResetClientRespones: event-group=EventGroupDiagnosticResetClient, sd-client-event-group-timing-config=cgd_DiagnosticReset_Client_EventGroup_Config
package /iSOFT/Machine1/core/cg/PowerMode/Provided
  provided someip service instance SomeipProvidedPowerModeServerInstance: service-interface-deployment=PowerModeServer, sd-server-config=cgd_PowerMode_Server_InstanceConfig, service-instance-id=100
    someip provided event group ProvidedEventGroupPowerModeServerRespones: event-group=EventGroupPowerModeServer, multicast-threshold=10
package /iSOFT/Machine1/core/cg/PowerMode/Required
  required someip service instance SomeipRequiredPowerModeClientInstance: service-interface-deployment=PowerModeClient, required-service-instance-id=ANY, sd-client-config=cgd_PowerMode_Client_InstanceConfig
    someip required event group RequiredEventGroupPowerModeClientRespones: event-group=EventGroupPowerModeClient, sd-client-event-group-timing-config=cgd_PowerMode_Client_EventGroup_Config

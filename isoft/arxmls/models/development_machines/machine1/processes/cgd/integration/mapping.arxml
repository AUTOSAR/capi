AUTOSAR XML (schema 00049)
package /ISOFT/PlatformComponents/cg/cgd_mapping
  dlt log channel to process mapping dltLogChannelToProcessMapping_2: dlt-log-channel=cgd_dlt, process=cgd_proc
  process to machine mapping set process_to_machine_set
    process to machine mapping item: machine=Machine1, process=cgd_proc

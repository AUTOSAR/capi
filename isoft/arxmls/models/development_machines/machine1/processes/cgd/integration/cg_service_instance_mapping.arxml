AUTOSAR XML (schema 00049)
package /iSOFT/Machine1/core/cg/ServiceInstanceToPortPrototypeMapping
  4 x service instance to port prototype mapping, all with process-design=cgd_proc_design, process=cgd_proc:
    SomeipCGProvidedDiagnosticResetServerInstance: port-prototype=root_swc.CgServerPDiagnosticResetServer, service-instance=SomeipProvidedDiagnosticResetServerInstance
    SomeipCGProvidedPowerModeServerInstance: port-prototype=root_swc.CgServerPPowerModeServer, service-instance=SomeipProvidedPowerModeServerInstance
    SomeipCGRequiredDiagnosticResetClientInstance: port-prototype=root_swc.CgServerRDiagnosticResetClient, service-instance=SomeipRequiredDiagnosticResetClientInstance
    SomeipCGRequiredPowerModeClientInstance: port-prototype=root_swc.CgServerRPowerModeClient, service-instance=SomeipRequiredPowerModeClientInstance
package /iSOFT/Machine1/core/cg/SomeipServiceInstanceToMachineMapping
  someip service instance to machine mapping ProvidedInstanceToMachineMapping: communication-connector=CommunicationConnector1, service-instance=[SomeipProvidedDiagnosticResetServerInstance, SomeipProvidedPowerModeServerInstance], tcp-port=32000, udp-port=32000
  someip service instance to machine mapping RequiredInstanceToMachineMapping: communication-connector=CommunicationConnector1, service-instance=[SomeipRequiredDiagnosticResetClientInstance, SomeipRequiredPowerModeClientInstance], tcp-port=32001, udp-port=32001

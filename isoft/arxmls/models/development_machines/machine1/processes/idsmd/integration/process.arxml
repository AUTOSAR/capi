AUTOSAR XML (schema 00049)
package /ISOFT/Idsm/Processes
  process idsm_process1: design=idsm_daemon_design, executable=idsmd, pre-mapping=false, state-dependent-startup-config{execution-dependencys=[processStatMachine.Running, processStatMachine.Running, processStatMachine.Running], function-group-state=[MachineFG.Restart, MachineFG.Startup, MachineFG.Verify], resource-group=DefaultResourceGroup, startup-config=config}
    process state machine processStatMachine: type=ProcessStateMachine
package /ISOFT/Idsm/StartupConfigSets
  startup config set idsm_startup_configs
    startup config config: process-arguments=[-s, runok], scheduling-policy=SCHED_OTHER, scheduling-priority=12, termination-behavior=PROCESS-IS-NOT-SELF-TERMINATING, timeout={enter-timeout-value=5.0, exit-timeout-value=5.0}

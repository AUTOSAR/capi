AUTOSAR XML (schema 00049)
package /ISOFT/Idsm/ProcessToMachineMappingSets
  dlt log channel to process mapping idsmd_process_log_channel: dlt-log-channel=idsmd_dlt, process=idsm_process1
  dlt log channel to process mapping idsmd_process_proto_log_channel: dlt-log-channel=idsp_dlt, process=idsm_process1
  process to machine mapping set processToMachineMappingSet_idsm
    process to machine mapping processToMachineMapping_idsm: machine=Machine1, process=idsm_process1

AUTOSAR XML (schema 00049)
package /ISOFT/Idsm/Deployment
  ids design IdsDesign_1n: elements=Idsm_Instance_1
  idsm properties IdsmProperties_1
    rate-limitation-filters:
      idsm rate limitation RateLimit_auth: max-events-in-interval=24, time-interval=12.0
    traffic-limitation-filters:
      idsm traffic limitation TrafficLimit_auth: max-bytes-in-interval=20480, time-interval=12.0
  idsm instance Idsm_Instance_1: idsm-instance-id=1, idsm-module-instantiation=IdsmModuleInstantiation, rate-limitation-filters=RateLimit_auth, signature-support-ap=crypto-primitive=RSA, timestamp-format=noAutosar, traffic-limitation-filters=TrafficLimit_auth

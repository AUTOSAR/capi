AUTOSAR XML (schema 00049)
package /ISOFT/Idsm/CryptoKeySlotToPortPrototypeMapping
  crypto key slot to port prototype mapping IdsmProcessKeySlot: key-slot=key_slot_idsm, port-prototype=rootSwComponentPrototype_idsmd.idsm_signature, process=idsm_process1

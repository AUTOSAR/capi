AUTOSAR XML (schema 00049)
package /ISOFT/PlatformComponents/Persistency
  persistency file storage fileStorage_cert: maximum-allowed-size=102400, minimum-sustained-size=4096, redundancy-handlings=persistency-redundancy-hash={scope=PERSISTENCY-REDUNDANCY-HANDLING-SCOPE-ELEMENT, algorithm-family=CRC_32P4, length=32}, update-strategy=KEEP-EXISTING, uri=cryptox509d/file_per

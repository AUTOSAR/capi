AUTOSAR XML (schema 00049)
package /ISOFT/PlatformComponents/Persistency
  persistency port prototype to file storage mapping fileStorage_mapping_crypto_cert: port-prototype=cryptox509d_swc_root.prPort_fileStorage_cert, process=cryptox509d_proc, file-storage=fileStorage_cert

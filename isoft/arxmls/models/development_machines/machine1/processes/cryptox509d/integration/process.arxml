AUTOSAR XML (schema 00049)
package /ISOFT/PlatformComponents/cryptox509
  process cryptox509d_proc: design=cryptox509_proc_design, executable=cryptox509d, state-dependent-startup-config{function-group-state=[MachineFG.Restart, MachineFG.Startup, MachineFG.Verify], resource-group=DefaultResourceGroup, startup-config=normal}
    process state machine processStatMachine: type=ProcessStateMachine
  startup config set cryptox509_startup_config
    startup config normal: scheduling-policy=SCHED_OTHER, scheduling-priority=12, termination-behavior=PROCESS-IS-NOT-SELF-TERMINATING

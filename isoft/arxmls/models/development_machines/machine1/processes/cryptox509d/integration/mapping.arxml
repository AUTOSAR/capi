AUTOSAR XML (schema 00049)
package /ISOFT/PlatformComponents/cryptox509/crypto_daemon_mappingx509
  process to machine mapping set processToMachineMappingSet_cryptox509d
    process to machine mapping item: machine=Machine1, process=cryptox509d_proc
  dlt log channel to process mapping dltLogChannelToProcessMappingcryptox509d: dlt-log-channel=x509_dlt, process=cryptox509d_proc

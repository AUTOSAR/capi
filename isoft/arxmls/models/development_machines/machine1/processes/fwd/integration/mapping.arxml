AUTOSAR XML (schema 00049)
package /ISOFT/PlatformComponents/fw/fwd_mapping
  dlt log channel to process mapping dltLogChannelToProcessMapping_1: dlt-log-channel=fwd_dlt, process=fwdaemon_proc
  process to machine mapping set process_to_machine_set
    process to machine mapping item: machine=Machine1, process=fwdaemon_proc

AUTOSAR XML (schema 00049)
package /ISOFT/Idsm/Design
  security event context mapping application SecurityEventContextMappingApplication_firewall_daemon: filter-chains=SecurityEventFilterChain_fw, idsm-instances=Idsm_Instance_1, affected-application=AP
    mapped-security-events:
      security event context props SecurityEventContextProps_fw: default-reporting-mode=DETAILED, persistent-storage=false, security-events=SecurityEventDefinition_fw, sensor-instance-id=0
  security event filter chain SecurityEventFilterChain_fw
    one every n SampleFileter_fw: n=1
package /ISOFT/Idsm/Design/SecurityEventMapping
  security event mapping SecurityEventMapping_fw: id=1, process=fwdaemon_proc, reporting-port-prototype=fw_root_swc.rPort_fw
package /ISOFT/Idsm/Design/SecurityEventReportToSecurityEventDefinitionMapping
  security event report to security event definition mapping SecurityEventReportToSecurityEventDefinitionMapping_fw: reported-security-event=rPort_fw, security-event-definition=SecurityEventDefinition_fw

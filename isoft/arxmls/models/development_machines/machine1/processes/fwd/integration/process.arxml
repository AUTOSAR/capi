AUTOSAR XML (schema 00049)
package /ISOFT/PlatformComponents/fw
  process fwdaemon_proc: design=fwd_proc_design, executable=fwd, function-cluster-affiliation=ISOFT_UCM, state-dependent-startup-config{function-group-state=[MachineFG.Restart, MachineFG.Startup, MachineFG.Verify, MachineFG.Fallback], resource-group=DefaultResourceGroup, startup-config=server}
    process state machine processStatMachine: type=ProcessStateMachine
  startup config set fwdaemon_startup_configs
    startup config server: scheduling-policy=SCHED_OTHER, scheduling-priority=12, termination-behavior=PROCESS-IS-NOT-SELF-TERMINATING
    startup config verify: scheduling-policy=SCHED_OTHER, scheduling-priority=12, termination-behavior=PROCESS-IS-NOT-SELF-TERMINATING

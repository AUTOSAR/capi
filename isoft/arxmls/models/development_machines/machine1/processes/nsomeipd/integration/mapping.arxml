AUTOSAR XML (schema 00049)
package /ISOFT/PlatformComponents/com/nsomeip_routing_mapping
  process to machine mapping set process_to_machine_set
    process to machine mapping item: machine=Machine1, process=nsomeip_routing_proc
  dlt log channel to process mapping dltLogChannelToProcessMapping_2: dlt-log-channel=route_dlt, process=nsomeip_routing_proc

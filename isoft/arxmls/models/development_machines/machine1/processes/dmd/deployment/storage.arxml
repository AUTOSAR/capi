AUTOSAR XML (schema 00049)
package /ISOFT/PlatformComponents/diag/PersistencyKeyValueStorage
  persistency key value storage dmd: maximum-allowed-size=1073741824, minimum-sustained-size=4096, update-strategy=KEEP-EXISTING, uri=dmd/DiagnosticStorage
  persistency key value storage doip: maximum-allowed-size=1048576, minimum-sustained-size=4096, update-strategy=KEEP-EXISTING, uri=dmd/DoIpStorage

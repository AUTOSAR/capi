AUTOSAR XML (schema 00049)
package /ISOFT/PlatformComponents/diag/DltLogChannelToProcessMapping
  dlt log channel to process mapping diag_dlt: dlt-log-channel=diag_dlt, process=dmd
package /ISOFT/PlatformComponents/diag/PersistencyPortPrototypeToKeyValueStorageMapping
  persistency port prototype to key value storage mapping dmd: port-prototype=root.DiagnosticStorage, process=dmd, key-value-storage=dmd
  persistency port prototype to key value storage mapping doip: port-prototype=root.DoIpStorage, process=dmd, key-value-storage=doip
package /ISOFT/PlatformComponents/diag/ProcessToMachineMappingSet
  process to machine mapping set dmd
    process to machine mapping dmd: machine=Machine1, non-os-module-instantiation=doip, process=dmd

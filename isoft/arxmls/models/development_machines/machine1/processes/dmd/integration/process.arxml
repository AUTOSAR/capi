AUTOSAR XML (schema 00049)
package /ISOFT/PlatformComponents/diag/Process
  process dmd: design=dmd, executable=dmd, state-dependent-startup-config{function-group-state=[MachineFG.Restart, MachineFG.Startup, MachineFG.Verify, MachineFG.Fallback], resource-group=DefaultResourceGroup, startup-config=normal}
    process state machine processStatMachine: type=ProcessStateMachine
package /ISOFT/PlatformComponents/diag/StartupConfigSet
  startup config set dmd
    startup config normal: scheduling-policy=SCHED_OTHER, scheduling-priority=12, termination-behavior=PROCESS-IS-NOT-SELF-TERMINATING, timeout={enter-timeout-value=10.0, exit-timeout-value=10.0}

AUTOSAR XML (schema 00049)
package /ISOFT/PlatformComponents/phm/mapping1
  process to machine mapping set process_to_machine_set
    process to machine mapping phm_mapping1: machine=Machine1, process=phmd_process1
  dlt log channel to process mapping dltLogChannelToProcessMapping: dlt-log-channel=phm_dlt, process=phmd_process1

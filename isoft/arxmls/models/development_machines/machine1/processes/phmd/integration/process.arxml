AUTOSAR XML (schema 00049)
package /ISOFT/PlatformComponents/phm
  process phmd_process1: design=phm_daemon_design, executable=phmd, state-dependent-startup-config{execution-dependency=processStatMachine.Running, function-group-state=[MachineFG.Restart, MachineFG.Startup, MachineFG.Verify, MachineFG.Fallback], resource-group=DefaultResourceGroup, startup-config=config}
    process state machine processStatMachine: type=ProcessStateMachine
  startup config set phm_daemon_startup_set1
    startup config config: scheduling-policy=SCHED_OTHER, scheduling-priority=12, termination-behavior=PROCESS-IS-NOT-SELF-TERMINATING, timeout={enter-timeout-value=5.0, exit-timeout-value=5.0}

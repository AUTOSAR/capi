AUTOSAR XML (schema 00049)
package /ClientApp
  process design ClientDesign: executable=clientd
package /ClientApp/exe
  executable clientd: category=APPLICATION_LEVEL, logging-behavior=USES-LOGGING, reporting-behavior=REPORTS-EXECUTION-STATE
    root sw component prototype client: application-type=client
package /ClientApp/swc
  adaptive application sw component type client
    require port helloworld_RPort: required-interface=ServiceHelloWorld

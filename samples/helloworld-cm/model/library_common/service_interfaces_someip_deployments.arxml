AUTOSAR XML (schema 00049)
package /SomeipDeployments
  someip service interface deployment ServiceHelloWorld: service-interface=ServiceHelloWorld, service-interface-id=101, service-interface-version={major-version=1, minor-version=0}
    someip event deployment testEvent: event=testEvent, event-id=0x0001, transport-protocol=UDP
    someip method deployment EchoMethod: method=EchoMethod, method-id=32000, transport-protocol=UDP
    someip event group Eventgroup1: event-group-id=1, event=testEvent

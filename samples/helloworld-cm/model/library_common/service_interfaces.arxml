AUTOSAR XML (schema 00049)
package /HelloWorldErrors
  ap application error domain GenericErrors: value=45
    namespaces:
      symbol props hello
      symbol props world
      symbol props cm
  ap application error GenericFailure: error-code=12, error-domain=GenericErrors  # Generic failure.
  ap application error InvalidConfigString: error-code=5, error-domain=SpecificErrors  # Configuration string is invalid.
  ap application error InvalidParameter: error-code=6, error-domain=SpecificErrors  # Parameter is invalid.
  ap application error domain SpecificErrors: value=44
    namespaces:
      symbol props hello
      symbol props world
      symbol props cm
package /HelloWorldServiceInterfaces
  service interface ServiceHelloWorld: major-version=1, minor-version=0
    namespaces:
      symbol props hello
      symbol props world
      symbol props cm
    events:
      data testEvent: type=ByteArray
    methods:
      operation EchoMethod: possible-ap-error=[GenericFailure, InvalidConfigString]
        arg msg: type=String, direction=IN
        arg echo: type=String, direction=OUT

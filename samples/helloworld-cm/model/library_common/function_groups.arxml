AUTOSAR XML (schema 00049)
package /FunctionGroups/HelloWorld_CM
  mode declaration group HelloWorldGroup: initial-mode=Off
    4 x mode:
      Driving
      Off
      Parking
      Verify
  function group set FunctionGroupsSet
    function-groups:
      mode declaration group prototype HelloWorldGroup: type=HelloWorldGroup

AUTOSAR XML (schema 00049)
package /ServerDeployment2
  process to machine mapping set mappingSet
    process to machine mapping ServerMapping: machine=Machine2, process=server_process
  dlt log channel to process mapping dltLogChannelToProcessMapping2_server_default: dlt-log-channel=default, process=server_process
  dlt log channel to process mapping dltLogChannelToProcessMapping2_server_com: dlt-log-channel=com, process=server_process
  dlt log channel to process mapping dltLogChannelToProcessMapping2_server_nai: dlt-log-channel=nai, process=server_process
  someip service instance to machine mapping ServiceHelloWorld_ProvidedServiceInstance_toMachine: communication-connector=CommunicationConnector1, service-instance=ProvidedInstanceServiceHelloWorld, udp-port=5001
  process server_process: design=ServerDesign, executable=serverd, state-dependent-startup-config{function-group-state=[HelloWorldGroup.Driving, HelloWorldGroup.Parking], resource-group=DefaultResourceGroup, startup-config=server_config}
    process state machine processStatMachine: type=ProcessStateMachine
  startup config set startup_set
    startup config server_config: environment-variables=tag-with-optional-value={key=proxy, value=192.168.1.2}, scheduling-policy=RR, scheduling-priority=12, termination-behavior=PROCESS-IS-NOT-SELF-TERMINATING
  service instance to port prototype mapping ServiceHelloWorld_ProvidedServiceInstance_toPort: port-prototype=server.helloworld_PPort, process-design=ServerDesign, process=server_process, service-instance=ProvidedInstanceServiceHelloWorld
package /Grant
  com offer service grant offerservicegrant: service-instance=ProvidedInstanceServiceHelloWorld
  com event grant testeventgrant: service-instance=ProvidedInstanceServiceHelloWorld, service-deployment=testEvent

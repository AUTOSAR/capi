AUTOSAR XML (schema 00049)
package /ISOFT/Development
  machine Machine2
    module-instantiations:
      log and trace instantiation helloworld_server_log
        dlt log channel default: application-id=server, context-id=#DFT, log-trace-default-log-level=DEBUG, log-trace-file-path=/var/redirected/, log-trace-log-modes=[CONSOLE, FILE, NETWORK]
        dlt log channel com: application-id=server, context-id=#COM, log-trace-default-log-level=DEBUG, log-trace-file-path=/var/redirected/, log-trace-log-modes=[CONSOLE, FILE, NETWORK]
        dlt log channel nai: application-id=server, context-id=#NAI, log-trace-default-log-level=DEBUG, log-trace-file-path=/var/redirected/, log-trace-log-modes=[CONSOLE, FILE, NETWORK]

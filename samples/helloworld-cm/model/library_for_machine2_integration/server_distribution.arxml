AUTOSAR XML (schema 00049)
package /ISOFT/Development/SoftwareClusters2/VER_100
  software cluster CMDemo_server: category=APPLICATION_LAYER, claimed-function-group=HelloWorldGroup, contained-ar-element=serverd, contained-process=server_process, type-approval=e1*2024/123*4567*89, vendor-id=1, version=1.1.0

AUTOSAR XML (schema 00049)
package /ClientDeployment
  process to machine mapping set mappingSet
    process to machine mapping ClientMapping: machine=Machine1, process=client_process
  dlt log channel to process mapping dltLogChannelToProcessMapping1_client_default: dlt-log-channel=default, process=client_process
  dlt log channel to process mapping dltLogChannelToProcessMapping1_client_com: dlt-log-channel=com, process=client_process
  dlt log channel to process mapping dltLogChannelToProcessMapping1_client_nai: dlt-log-channel=nai, process=client_process
  someip service instance to machine mapping ServiceHelloWorld_RequiredServiceInstance_toMachine: communication-connector=CommunicationConnector1, service-instance=RequiredInstanceServiceHelloWorld
  process client_process: design=ClientDesign, executable=clientd, state-dependent-startup-config{function-group-state=[HelloWorldGroup.Driving, HelloWorldGroup.Parking], resource-group=DefaultResourceGroup, startup-config=client_config}
    process state machine processStatMachine: type=ProcessStateMachine
  startup config set startup_set
    startup config client_config: environment-variables=tag-with-optional-value={key=proxy, value=192.168.1.2}, scheduling-policy=RR, scheduling-priority=12, termination-behavior=PROCESS-IS-SELF-TERMINATING
  service instance to port prototype mapping ServiceHelloWorld_RequiredServiceInstance_toPort: port-prototype=client.helloworld_RPort, process-design=ClientDesign, process=client_process, service-instance=RequiredInstanceServiceHelloWorld
package /Grant
  com find service grant findservicegrant: service-instance=RequiredInstanceServiceHelloWorld
  com method grant echomethodgrant: service-instance=RequiredInstanceServiceHelloWorld, service-deployment=EchoMethod

AUTOSAR XML (schema 00049)
package /ara/phm/Interfaces
  phm health channel interface hc_testunit
    namespaces:
      symbol props ara
      symbol props phm
      symbol props health_channels
    5 x phm health channel status:
      kTestHigh: status-id=3
      kTestLow: status-id=1, triggers-recovery-notification=false
      kTestOk: status-id=2
      kTestVeryHigh: status-id=4, triggers-recovery-notification=true
      kTestVeryLow: status-id=0, triggers-recovery-notification=true
  phm health channel interface tyre_pressure
    namespaces:
      symbol props ara
      symbol props phm
      symbol props health_channels
    5 x phm health channel status:
      kHigh: status-id=3
      kLow: status-id=1, triggers-recovery-notification=false
      kOk: status-id=2
      kVeryHigh: status-id=4, triggers-recovery-notification=true
      kVeryLow: status-id=0, triggers-recovery-notification=true
  phm health channel interface vol
    namespaces:
      symbol props ara
      symbol props phm
      symbol props health_channels
    phm health channel status kHigh: category=lll, status-id=3, triggers-recovery-notification=true
    phm health channel status kLow: status-id=2, triggers-recovery-notification=false
    phm health channel status kOk: category=lll, status-id=1, triggers-recovery-notification=true

AUTOSAR XML (schema 00049)
package /ara/sm/PHMSupervisionRecoveryNotifications
  phm supervision recovery notification interface engine
  phm supervision recovery notification interface wheel
  phm supervision recovery notification interface sv_testunit
package /ara/sm/PHMHealthChannelRecoveryNotifications
  phm health channel recovery notification interface tyre_pressure
  phm health channel recovery notification interface voltage_pressure
  phm health channel recovery notification interface hc_testunit

AUTOSAR XML (schema 00049)
package /ara/phm/Interfaces
  phm supervised entity interface sv_testunit
    namespaces:
      symbol props ara
      symbol props phm
      symbol props supervised_entities
    phm checkpoint kTestAlive: checkpoint-id=1
  phm supervised entity interface engine
    namespaces:
      symbol props ara
      symbol props phm
      symbol props supervised_entities
    6 x phm checkpoint:
      kAlive: checkpoint-id=4
      kInitializing: checkpoint-id=1
      kInitializingFinished: checkpoint-id=3
      kStartup: checkpoint-id=2
      tdeadlineA: checkpoint-id=5
      tdeadlineB: checkpoint-id=6
  phm supervised entity interface wheel
    namespaces:
      symbol props ara
      symbol props phm
      symbol props supervised_entities
    phm checkpoint kFinished: checkpoint-id=2
    phm checkpoint kStart: checkpoint-id=1
